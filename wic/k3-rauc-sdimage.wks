## wic/k3-rauc-sdimage.wks
```
part --source bootimg-partition --fstype=vfat --label boot0 --ondisk mmc --active --align 1024 --offset 8192 --fixed-size 128
part --source bootimg-partition --fstype=vfat --label boot1 --ondisk mmc --active --fixed-size 128
part --source archive --sourceparams="file=config-partition.tar.gz" --fstype=ext4 --label config --ondisk mmc --fixed-size 64
part / --source rootfs --fstype=ext4 --label root0 --ondisk mmc --use-uuid
part / --source rootfs --fstype=ext4 --label root1 --ondisk mmc --use-uuid
```

## wic/k3-sdimage.wks
```
# short-description: Create SD card image with 2 partitions
# long-description: Creates a partitioned SD card image for TI platforms.
# Boot files are located in the first vfat partition with extra reserved space.

part /boot --source bootimg-partition --ondisk mmcblk0 --fstype=vfat --label boot --active --align 1024 --fixed-size 128 --use-uuid
part / --source rootfs --ondisk mmcblk0 --fstype=ext4 --label root --align 1024 --use-uuid
```

## wic/rk3288-rauc-sdimage.wks
```
# short-description: Create a Phytec RK3288 disk image (SD card)
# long-description: Creates a partitioned disk image for Phytec RK3288 BSPs
# boards that the user can directly dd to an SD card and boot.
# This image contains twice boot and rootfs partitions for a redundance system.

part SPL     --source rawcopy --sourceparams="file=u-boot-spl-dtb.bin.rksd" --ondisk mmc --no-table --align 32
part U-BOOT --source rawcopy --sourceparams="file=u-boot.bin" --ondisk mmc --no-table --align 64

include rauc-sdimage.wks.inc

bootloader --timeout=0
```

## wic/rk3288-sdimage.wks
```
# short-description: Create a Phytec RK3288 disk image (SD card)
# long-description: Creates a partitioned disk image for Phytec RK3288 BSPs
# boards that the user can directly dd to an SD card and boot.

part SPL     --source rawcopy --sourceparams="file=u-boot-spl-dtb.bin.rksd" --ondisk mmc --no-table --align 32
part --source bootimg_partition --fstype=vfat --label boot --ondisk mmc --active --align 4096 --size ${WKS_BOOTIMAGESIZE}
part / --source rootfs --fstype=ext4 --label root --ondisk mmc --align 1024 --use-uuid

bootloader --timeout=0
```
