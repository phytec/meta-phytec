## files/wic/imx7-sdimage.wks
```
# short-description: Create a PHYTEC i.MX7 disk image (SD card)
# long-description: Creates a partitioned disk image for PHYTEC i.MX7 BSPs
# boards that the user can directly dd to an SD card and boot.

part u-boot --source rawcopy --sourceparams="file=u-boot-with-spl.imx" --ondisk mmcblk --no-table --align ${BOOTLOADER_SEEK}

part /boot --source bootimg_partition --ondisk mmcblk --fstype=vfat --label boot --active --align 4096 --size ${WKS_BOOTIMAGESIZE}
part / --source rootfs --ondisk mmcblk --fstype=ext4 --label root --align 4096

bootloader --ptable msdos
```

## files/wic/imx8m-sdimage.wks
```
# short-description: Create a Phytec i.MX8M disk image (SD card)
# long-description: Creates a partitioned disk image for Phytec i.MX8M BSPs
# boards that the user can directly dd to an SD card and boot.

part U-BOOT --source rawcopy --sourceparams="file=imx-boot" --ondisk mmc --no-table --offset ${BOOTLOADER_SEEK}

part /boot --source bootimg_partition --fstype=vfat --label boot --ondisk mmc --use-uuid --active --align 4096 --size ${WKS_BOOTIMAGESIZE}
part / --source rootfs --fstype=ext4 --label root --ondisk mmc --align 1024 --use-uuid

bootloader --timeout=0
```

## files/wic/imx9-sdimage.wks
```
# short-description: Create a Phytec i.MX9* disk image (SD card)
# long-description: Creates a partitioned disk image for Phytec i.MX9* BSPs
# boards that the user can directly dd to an SD card and boot.

part U-BOOT --source rawcopy --sourceparams="file=imx-boot" --ondisk mmcblk --no-table --offset ${BOOTLOADER_SEEK}

part /boot --source bootimg_partition --fstype=vfat --label boot --ondisk mmcblk --use-uuid --active --align 8192 --size ${WKS_BOOTIMAGESIZE}
part / --source rootfs --fstype=ext4 --label root --ondisk mmcblk --align 8192 --use-uuid

bootloader --ptable msdos --timeout=0
```

## files/wic/k3-sdimage.wks
```
# short-description: Create SD card image with 2 partitions
# long-description: Creates a partitioned SD card image for TI platforms.
# Boot files are located in the first vfat partition with extra reserved space.

part /boot --source bootimg_partition --ondisk mmcblk0 --fstype=vfat --label boot --active --align 1024 --offset 8192 --fixed-size 128 --use-uuid
part / --source rootfs --ondisk mmcblk0 --fstype=ext4 --label root --align 1024 --use-uuid
```

## meta-phyimx6/conf/machine/phyflex-imx6-4.conf
```bitbake
#@TYPE: Machine
#@NAME: phyflex-imx6-4
#@DESCRIPTION: PFL-A-02-55237E0.A3/PBA-B-01 (i.MX6 Quad, 4GB RAM on two banks, 16MB NOR) [hide]
#from http://www.phytec.de

require conf/machine/include/phyimx6.inc

SOC_FAMILY_append := ":mx6q"

# Kernel
KERNEL_DEVICETREE = "imx6q-phytec-pbab01.dtb"
KERNEL_DEFAULT_DEFCONFIG = "imx_v6_v7_defconfig"

# Barebox Config
BAREBOX_BIN = "images/barebox-phytec-pbab01-4gib.img"
BAREBOX_DEFAULT_ENV = "arch/arm/boards/phytec-phyflex-imx6/defaultenv-phyflex-imx6"

# touchscreen, the rdk has one attached
MACHINE_FEATURES += "touchscreen pci can alsa"

# Other nandchip
#  nand: NAND device: Manufacturer ID: 0x2c, Chip ID: 0x48 (Micron MT29F32G08AFACAWP), 2048MiB, page size: 4096, OOB size: 224
MKUBIFS_ARGS = "-F -m 4096 -e 516096 -c 8083"
UBINIZE_ARGS = "-m 4096 -p 512KiB -s 4096 -O 4096"
```

## meta-phyimx6/conf/machine/phyflex-imx6-9.conf
```bitbake
#@TYPE: Machine
#@NAME: phyflex-imx6-8
#@DESCRIPTION: non-standard/PBA-B-01 (i.MX6 Solo, 256MB RAM on one bank, no NOR) [hide]
#from http://www.phytec.de

require conf/machine/include/phyimx6.inc

SOC_FAMILY_append := ":mx6q"

# Kernel
KERNEL_DEVICETREE = "imx6dl-phytec-pbab01-nonor.dtb"
KERNEL_DEFAULT_DEFCONFIG = "imx_v6_v7_defconfig"

# Barebox Config
BAREBOX_BIN = "images/barebox-phytec-pbab01s-256mb-1bank.img"
BAREBOX_DEFAULT_ENV = "arch/arm/boards/phytec-phyflex-imx6/defaultenv-phyflex-imx6"

# touchscreen, the rdk has one attached
MACHINE_FEATURES += "touchscreen pci can alsa"
```

## meta-phyintern/conf/layer.conf
```bitbake
# We have a conf and classes directory, add to BBPATH
BBPATH .= ":${LAYERDIR}"

# We have a recipes directory, add to BBFILES
BBFILES += "${LAYERDIR}/recipes-*/*/*.bb \
	    ${LAYERDIR}/recipes-*/*/*.bbappend"

BBFILE_COLLECTIONS += "phyDev"
BBFILE_PATTERN_phyDev = "^${LAYERDIR}/"
BBFILE_PRIORITY_phyDev = "30"
LAYERVERSION_phyDev = "1"

# Layer dependencies
LAYERDEPENDS_phyDev = "phytec phyam335x"

#global development setting
DL_DIR ?= "/home/share/yocto_downloads"
SSTATE_DIR ?= "/home/share/yocto_sstate/1.7"
#CCACHE = "ccache"
#INHERIT += "ccache"
#CCACHE_DIR = "/home/mueller-klieser/.ccache"
#CCACHE_DISABLE = "0"

# Developer settings
DEV_BUILD = "True"
DEV_USER = "${USER}"
TFTP_ROOT = "/tftpboot"
NFS_ROOT = "/nfsroot"
SDCARD_MOUNT = "/media/${USER}"
SDCARD_BOOTPART = "/boot"
SDCARD_ROOTFSPART = "/rootfs"
BAREBOX_BOOTSRC = "net"
#IMAGE_INSTALL_append = " task-native-sdk iperf"
```

## meta-phyintern/conf/local.conf.sample
```bitbake
BSP_VERSION = "UNASSIGNED"
MACHINE = "UNASSIGNED"

DISTRO = "yogurt"

# You can disable and enable FSTYPES as you wish. e.g. 'ext4'.
IMAGE_FSTYPES += "sdcard"
IMAGE_FSTYPES += "tar.gz"
IMAGE_FSTYPES += "ubifs"

# That are the default values of bitbake.  Adapt these to your workspace and
# host preferences.
#DL_DIR = "${TOPDIR}/downloads"
#SSTATE_DIR = "${TOPDIR}/sstate-cache"


PACKAGE_CLASSES = "package_rpm"
#SDKMACHINE ?= "x86_64"
EXTRA_IMAGE_FEATURES = "debug-tweaks ssh-server-openssh"

USER_CLASSES ?= "buildstats image-mklibs image-prelink"

# Define preferred provider for jpeg to avoid warning.
PREFERRED_PROVIDER_jpeg = "jpeg"

OE_TERMINAL = "auto"
PATCHRESOLVE = "noop"
BB_DISKMON_DIRS = "\
    STOPTASKS,${TMPDIR},1G,100K \
    STOPTASKS,${DL_DIR},1G,100K \
    STOPTASKS,${SSTATE_DIR},1G,100K \
    ABORT,${TMPDIR},100M,1K \
    ABORT,${DL_DIR},100M,1K \
    ABORT,${SSTATE_DIR},100M,1K"

INHERIT += "phytec-mirrors"

CONF_VERSION = "1"
```

## recipes-bsp/u-boot/u-boot-imx/boot.its
```
/dts-v1/;
/ {
    description = "boot script";
    images {
	default = "script";
        script {
            data = /incbin/("./boot.cmd");
            type = "script";
        };
    };
};
```

## scripts/lib/wic/canned-wks/am335x-emmc-production.wks
```
# short-description: Create a Phytec AM335x bootpartition image
# long-description: Creates a vfat partitioned disk image containing bootloader
# and kernel images for Phytec AM335x BSPs boards. They are meant to update the vfat
# partition of a sdcard or emmc.

part --source bootimg-partition --fstype=vfat --label boot --ondisk mmc --active --align 4096 --size 10

bootloader --timeout=0
```

## scripts/lib/wic/canned-wks/am335x-update-sdimage.wks
```
# short-description: Create a Phytec AM335x disk image (SD card)
# long-description: Creates a partitioned disk image for Phytec AM335x BSPs
# boards that the user can directly dd to an SD card and boot.
# This image contains twice boot and rootfs partitions for a redundance system.

include rauc-sdimage.wks.inc

bootloader --timeout=0
```

## scripts/lib/wic/canned-wks/imx6-rauc-sdimage.wks
```
# short-description: Create a Phytec i.MX6 disk image (SD card)
# long-description: Creates a partitioned disk image for Phytec i.MX6 BSPs
# boards that the user can directly dd to an SD card and boot.
# This image contains twice boot and rootfs partitions for a redundance system.

part BAREBOX --source rawcopy --sourceparams="file=${BAREBOX_BINARY},skip=1024" --ondisk mmc --no-table --align ${BOOTLOADER_SEEK}

include rauc-sdimage.wks.inc

bootloader --timeout=0
```

## scripts/lib/wic/canned-wks/imx6-secureboot-sdimage.wks
```
# short-description: Create a Phytec i.MX6 disk image (SD card)
# long-description: Creates a partitioned disk image for Phytec i.MX6 BSPs
# boards that the user can directly dd to an SD card and boot.

part BAREBOX --source rawcopy --sourceparams="file=barebox-s.bin,skip=1024" --ondisk mmc --no-table --align 1

part --source bootimg-partition --fstype=vfat --label boot --ondisk mmc --active --align 4096 --size 80
part / --source rootfs --fstype=ext4 --label root --ondisk mmc --align 1024 --use-uuid
part /userdata --ondisk mmcblk --fstype=ext4 --label secrets --align 4096 --size 10
bootloader --timeout=0
```

## scripts/lib/wic/canned-wks/imx6-update-sdimage.wks
```
# short-description: Create a Phytec i.MX6 disk image (SD card)
# long-description: Creates a partitioned disk image for Phytec i.MX6 BSPs
# boards that the user can directly dd to an SD card and boot.
# This image contains twice boot and rootfs partitions for a redundance system.

part BAREBOX --source rawcopy --sourceparams="file=barebox.bin,skip=1024" --ondisk mmc --no-table --align 1

part --source bootimg-partition --fstype=vfat --label boot --ondisk mmc --active --align 4096 --size 20
part / --source rootfs --fstype=ext4 --label root --ondisk mmc --align 1024 --use-uuid
part --source bootimg-partition --fstype=vfat --label boot2 --ondisk mmc --active --align 4096 --size 20
part / --source rootfs --fstype=ext4 --label root2 --ondisk mmc --align 1024 --use-uuid

bootloader --timeout=0
```

## scripts/lib/wic/canned-wks/imx7-sdimage.wks
```
# short-description: Create a PHYTEC i.MX7 disk image (SD card)
# long-description: Creates a partitioned disk image for PHYTEC i.MX7 BSPs
# boards that the user can directly dd to an SD card and boot.

part u-boot --source rawcopy --sourceparams="file=u-boot-with-spl.imx" --ondisk mmcblk --no-table --align 1
part /boot --source bootimg-partition --ondisk mmcblk --fstype=vfat --label boot --active --align 4096 --size 16
part / --source rootfs --ondisk mmcblk --fstype=ext4 --label root --align 4096

bootloader --ptable msdos
```

## scripts/lib/wic/canned-wks/imx8m-binman-sdimage.wks
```
# short-description: Create a Phytec i.MX8MN disk image (SD card)
# long-description: Creates a partitioned disk image for Phytec i.MX8M BSPs
# boards that the user can directly dd to an SD card and boot.

part u-boot --source rawcopy --sourceparams="file=flash.bin" --ondisk mmc --no-table --offset ${IMX_BOOT_SEEK}
part u-boot-itb --source rawcopy --sourceparams="file=u-boot.itb" --ondisk mmcblk --no-table --offset 384
part --source bootimg-partition --fstype=vfat --label boot --ondisk mmc --active --offset 4096 --size 20
part / --source rootfs --fstype=ext4 --label root --ondisk mmc --align 1024 --use-uuid

bootloader --timeout=0
```

## scripts/lib/wic/canned-wks/imx8m-rauc-sdimage.wks
```
# short-description: Create a PHYTEC i.MX8M disk image (SD card)
# long-description: Creates a partitioned disk image for PHYTEC i.MX8M BSPs that
# the user can directly dd to an SD card and boot. This image contains two boot
# and rootfs partitions for a redundant system.

part U-BOOT --source rawcopy --sourceparams="file=imx-boot" --ondisk mmc --no-table --align 33

part --source bootimg-partition --fstype=vfat --label boot0 --ondisk mmc --active --align 4096 --size 20
part / --source rootfs --fstype=ext4 --label root0 --ondisk mmc --align 1024 --use-uuid

part --source bootimg-partition --fstype=vfat --label boot1 --ondisk mmc --active --size 20
part / --source rootfs --fstype=ext4 --label root1 --ondisk mmc --align 1024 --use-uuid

bootloader --timeout=0
```

## scripts/lib/wic/canned-wks/imx8mn-mp-rauc-sdimage.wks
```
# short-description: Create a PHYTEC i.MX8MN/i.MX8MP disk image (SD card)
# long-description: Creates a partitioned disk image for PHYTEC i.MX8M BSPs that
# the user can directly dd to an SD card and boot. This image contains two boot
# and rootfs partitions for a redundant system.

part U-BOOT --source rawcopy --sourceparams="file=imx-boot" --ondisk mmc --no-table --align 32

part --source bootimg-partition --fstype=vfat --label boot0 --ondisk mmc --active --align 8192 --size 20
part / --source rootfs --fstype=ext4 --label root0 --ondisk mmc --use-uuid
part --source bootimg-partition --fstype=vfat --label boot1 --ondisk mmc --active --size 20
part / --source rootfs --fstype=ext4 --label root1 --ondisk mmc --use-uuid
```

## scripts/lib/wic/canned-wks/imx8mn-sdimage.wks
```
# short-description: Create a Phytec i.MX8MN disk image (SD card)
# long-description: Creates a partitioned disk image for Phytec i.MX8M BSPs
# boards that the user can directly dd to an SD card and boot.

part U-BOOT --source rawcopy --sourceparams="file=imx-boot" --ondisk mmc --no-table --align 32

part --source bootimg-partition --fstype=vfat --label boot --ondisk mmc --active --align 4096 --size 20
part / --source rootfs --fstype=ext4 --label root --ondisk mmc --align 1024 --use-uuid

bootloader --timeout=0
```

## scripts/lib/wic/canned-wks/rk3288-update-sdimage.wks
```
# short-description: Create a Phytec RK3288 disk image (SD card)
# long-description: Creates a partitioned disk image for Phytec RK3288 BSPs
# boards that the user can directly dd to an SD card and boot.
# This image contains twice boot and rootfs partitions for a redundance system.

part SPL     --source rawcopy --sourceparams="file=u-boot-spl-dtb.bin.rksd" --ondisk mmc --no-table --align 32
part BAREBOX --source rawcopy --sourceparams="file=barebox.bin.u-boot" --ondisk mmc --no-table --align 128

part --source bootimg-partition --fstype=vfat --label boot --ondisk mmc --active --align 4096 --size 20
part / --source rootfs --fstype=ext4 --label root --ondisk mmc --align 1024 --use-uuid
part --source bootimg-partition --fstype=vfat --label boot2 --ondisk mmc --active --align 4096 --size 20
part / --source rootfs --fstype=ext4 --label root2 --ondisk mmc --align 1024 --use-uuid

bootloader --timeout=0
```

## wic/am335x-emmc-production.wks
```
# short-description: Create a Phytec AM335x bootpartition image
# long-description: Creates a vfat partitioned disk image containing bootloader
# and kernel images for Phytec AM335x BSPs boards. They are meant to update the vfat
# partition of a sdcard or emmc.

part --source bootimg_partition --fstype=vfat --label boot --ondisk mmc --active --align 4096 --size ${WKS_BOOTIMAGESIZE}

bootloader --timeout=0
```

## wic/am335x-sdimage.wks
```
# short-description: Create a Phytec AM335x disk image (SD card)
# long-description: Creates a partitioned disk image for Phytec AM335x BSPs
# boards that the user can directly dd to an SD card and boot.

part --source bootimg_partition --fstype=vfat --label boot --mkfs-extraopts "-g 255/63 -a" --ondisk mmc --active --align 4096 --size ${WKS_BOOTIMAGESIZE}
part / --source rootfs --fstype=ext4 --label root --ondisk mmc --align 1024 --use-uuid

bootloader --timeout=0
```

## wic/imx7-rauc-sdimage.wks
```
# short-description: Create a PHYTEC i.MX7 disk image (SD card)
# long-description: Creates a partitioned disk image for PHYTEC i.MX7 BSPs that
# the user can directly dd to an SD card and boot. This image contains two boot
# and rootfs partitions for a redundant system.

part u-boot --source rawcopy --sourceparams="file=u-boot-with-spl.imx" --ondisk mmcblk --no-table --align ${BOOTLOADER_SEEK}

include rauc-sdimage.wks.inc

bootloader --timeout=0
```

## wic/imx8m-binman-sdimage.wks
```
# short-description: Create a Phytec i.MX8MN disk image (SD card)
# long-description: Creates a partitioned disk image for Phytec i.MX8M BSPs
# boards that the user can directly dd to an SD card and boot.

part u-boot --source rawcopy --sourceparams="file=flash.bin" --ondisk mmc --no-table --offset ${BOOTLOADER_SEEK}
part --source bootimg-partition --fstype=vfat --label boot --ondisk mmc --active --offset 4096 --size ${WKS_BOOTIMAGESIZE}
part / --source rootfs --fstype=ext4 --label root --ondisk mmc --align 1024 --use-uuid

bootloader --timeout=0
```

## wic/imx8m-rauc-sdimage.wks
```
# short-description: Create a PHYTEC i.MX8M disk image (SD card)
# long-description: Creates a partitioned disk image for PHYTEC i.MX8M BSPs that
# the user can directly dd to an SD card and boot. This image contains two boot
# and rootfs partitions for a redundant system.

part U-BOOT --source rawcopy --sourceparams="file=imx-boot" --ondisk mmc --no-table --align ${BOOTLOADER_SEEK}

include rauc-sdimage.wks.inc

bootloader --timeout=0
```
