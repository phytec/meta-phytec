## conf/machine/phyboard-lynx-am62pxx-1-k3r5.conf
```bitbake
#@TYPE: Machine
#@NAME: phyboard-lynx-am62pxx-1-k3r5
#@DESCRIPTION: PHYTEC phyBOARD Lynx AM62Px, HS-FS (R5F)
#@ARTICLENUMBERS: PCM-081.A0

require conf/machine/include/phyk3r5.inc

MACHINEOVERRIDES =. "k3r5-am62pxx:phyboard-lynx:"

SPL_BINARY = "tiboot3-am62px-hs-fs-phycore-som.bin"

UBOOT_MACHINE = "phycore_am62px_r5_defconfig"
```

## conf/machine/phyboard-lynx-am62pxx-1.conf
```bitbake
#@TYPE: Machine
#@NAME: phyboard-lynx-am62pxx-1
#@DESCRIPTION: PHYTEC phyBOARD Lynx AM62Px, HS-FS
#@ARTICLENUMBERS: KPB-08137-001.A0, PCM-081.A1

require conf/machine/include/phyam62pxx.inc

MACHINEOVERRIDES =. ":phyboard-lynx:"

MACHINE_FEATURES += "can emmc gpu wifi bluetooth"

KERNEL_DEVICETREE = " \
    ti/k3-am62p5-phyboard-lynx.dtb \
    ${KERNEL_OVERLAYS} \
"

UBOOT_MACHINE = "phycore_am62px_a53_defconfig"
```

## conf/machine/phyboard-lyra-am62axx-1-k3r5.conf
```bitbake
#@TYPE: Machine
#@NAME: phyboard-lyra-am62axx-1-k3r5
#@DESCRIPTION: PHYTEC phyBOARD-Lyra AM62Ax, GP (R5F)
#@ARTICLENUMBERS: KPB-07524-ALPHA.A0, PCL-075.A0

require conf/machine/include/phyam62axx-k3r5.inc

MACHINEOVERRIDES =. "k3r5-am62axx:phyboard-lyra:"

SPL_BINARY = "tiboot3-am62ax-gp-phycore-som.bin"

UBOOT_MACHINE = ""
# Last config in the list is default
UBOOT_CONFIG = "usbdfu sd"
UBOOT_CONFIG[sd] = "phycore_am62ax_r5_defconfig,sdcard"
UBOOT_CONFIG[usbdfu] = "phycore_am62ax_r5_usbdfu_defconfig"
```

## conf/machine/phyboard-lyra-am62axx-1.conf
```bitbake
#@TYPE: Machine
#@NAME: phyboard-lyra-am62axx-1
#@DESCRIPTION: PHYTEC phyBOARD-Lyra AM62Ax, GP
#@ARTICLENUMBERS: KPB-07524-ALPHA.A0, PCL-075.A0

include conf/machine/include/phyam62axx.inc

MACHINEOVERRIDES =. ":phyboard-lyra:"

MACHINE_FEATURES += "camera can emmc wifi bluetooth"

KERNEL_DEVICETREE = " \
    ti/k3-am62a7-phyboard-lyra-rdk.dtb \
    ${KERNEL_OVERLAYS} \
"

UBOOT_MACHINE = "phycore_am62ax_a53_defconfig"
```

## conf/machine/phyboard-lyra-am62axx-2-k3r5.conf
```bitbake
#@TYPE: Machine
#@NAME: phyboard-lyra-am62axx-2-k3r5
#@DESCRIPTION: PHYTEC phyBOARD-Lyra AM62Ax, HS-FS (R5F)
#@ARTICLENUMBERS: PBA-C-24.A3, PCL-075.A1

require conf/machine/include/phyam62axx-k3r5.inc

MACHINEOVERRIDES =. "k3r5-am62axx:phyboard-lyra:"

SPL_BINARY = "tiboot3-am62ax-hs-fs-phycore-som.bin"

UBOOT_MACHINE = ""
# Last config in the list is default
UBOOT_CONFIG = "ethboot usbdfu sd"
UBOOT_CONFIG[sd] = "phycore_am62ax_r5_defconfig,sdcard"
UBOOT_CONFIG[usbdfu] = "phycore_am62ax_r5_usbdfu_defconfig"
UBOOT_CONFIG[ethboot] = "phycore_am62ax_r5_ethboot_defconfig"
```

## conf/machine/phyboard-lyra-am62axx-2.conf
```bitbake
#@TYPE: Machine
#@NAME: phyboard-lyra-am62axx-2
#@DESCRIPTION: PHYTEC phyBOARD-Lyra AM62Ax, HS-FS
#@ARTICLENUMBERS: PBA-C-24.A3, PCL-075.A1

include conf/machine/include/phyam62axx.inc

MACHINEOVERRIDES =. ":phyboard-lyra:"

MACHINE_FEATURES += "camera can emmc wifi bluetooth"

KERNEL_DEVICETREE = " \
    ti/k3-am62a7-phyboard-lyra-rdk.dtb \
    ${KERNEL_OVERLAYS} \
"

UBOOT_MACHINE = "phycore_am62ax_a53_defconfig"
```

## conf/machine/phyboard-lyra-am62xx-1-k3r5.conf
```bitbake
#@TYPE: Machine
#@NAME: phyboard-lyra-am62xx-1-k3r5
#@DESCRIPTION: DEPRECATED PHYTEC phyBOARD-Lyra AM62x, 2GiB RAM (R5F)
#@ARTICLENUMBERS: PBA-C-24.A1, PCM-071.A0

require conf/machine/include/k3r5.inc

MACHINEOVERRIDES =. "k3r5:am62xx:"

SYSFW_SOC = "am62x"
SYSFW_CONFIG = "evm"
SYSFW_SUFFIX = "gp"

UBOOT_MACHINE = "phycore_am62x_r5_defconfig"

PREFERRED_PROVIDER_virtual/kernel = "linux-dummy"
PREFERRED_PROVIDER_virtual/bootloader = "u-boot-ti"
```

## conf/machine/phyboard-lyra-am62xx-1.conf
```bitbake
#@TYPE: Machine
#@NAME: phyboard-lyra-am62xx-1
#@DESCRIPTION: DEPRECATED PHYTEC phyBOARD-Lyra AM62x, 2GiB RAM, GP
# The Rev 0 SOM has no PMIC - This image applies a device tree that uses fixed regulators.
#@ARTICLENUMBERS: PBA-C-24.A1, PCM-071.A0

include conf/machine/include/phyam62xx.inc

MACHINE_FEATURES += "can emmc gpu wifi bluetooth lwb5p"

KERNEL_DEVICETREE = " \
    ti/k3-am625-phyboard-lyra-deprecated-rev0-som.dtb \
    ti/k3-am62-phyboard-lyra-gpio-fan.dtbo \
    ti/k3-am62-phyboard-lyra-m2-lwb5p.dtbo \
    ti/k3-am62-phyboard-lyra-oldi-lcd185.dtbo \
    ti/k3-am62-phyboard-lyra-vm016-mipi.dtbo \
    ti/k3-am62-phyboard-lyra-x17-spi0.dtbo \
"

PREFERRED_RPROVIDER_wpa-supplicant = "summit-supplicant-lwb"
PREFERRED_RPROVIDER_wpa-supplicant-cli = "summit-supplicant-lwb-cli"
PREFERRED_RPROVIDER_wpa-supplicant-passphrase = "summit-supplicant-lwb-passphrase"
PREFERRED_RPROVIDER_wireless-regdb-static = "wireless-regdb"

UBOOT_MACHINE = "phycore_am62x_a53_defconfig"
```

## conf/machine/phyboard-lyra-am62xx-2-k3r5.conf
```bitbake
#@TYPE: Machine
#@NAME: phyboard-lyra-am62xx-2-k3r5
#@DESCRIPTION: PHYTEC phyBOARD-Lyra AM62x, 1-4 GB RAM, GP (R5F)
#@ARTICLENUMBERS: KPB-07124-001.A1, PCM-071.A1

require conf/machine/include/phyam62xx-k3r5.inc

MACHINEOVERRIDES =. "k3r5-am62xx:phyboard-lyra:"

SPL_BINARY = "tiboot3-am62x-gp-phycore-som.bin"

UBOOT_MACHINE = ""
# Last config in the list is default
UBOOT_CONFIG = "${@oe.utils.conditional("PREFERRED_PROVIDER_virtual/bootloader", "u-boot-phytec-ti", "ethboot usbdu sd", "sd", d)}"
UBOOT_CONFIG[sd] = "phycore_am62x_r5_defconfig,sdcard"
UBOOT_CONFIG[usbdfu] = "phycore_am62x_r5_usbdfu_defconfig"
UBOOT_CONFIG[ethboot] = "phycore_am62x_r5_ethboot_defconfig"
```

## conf/machine/phyboard-lyra-am62xx-2.conf
```bitbake
#@TYPE: Machine
#@NAME: phyboard-lyra-am62xx-2
#@DESCRIPTION: PHYTEC phyBOARD-Lyra AM62x, 1-4 GB RAM, GP
#@ARTICLENUMBERS: KPB-07124-001.A1, PCM-071.A1

include conf/machine/include/phyam62xx.inc

MACHINEOVERRIDES =. ":phyboard-lyra:"

MACHINE_FEATURES += "camera can emmc gpu wifi bluetooth"

KERNEL_DEVICETREE = " \
    ti/k3-am625-phyboard-lyra-rdk.dtb \
    ${KERNEL_OVERLAYS} \
"

UBOOT_MACHINE = "phycore_am62x_a53_defconfig"
```

## conf/machine/phyboard-lyra-am62xx-3-k3r5.conf
```bitbake
#@TYPE: Machine
#@NAME: phyboard-lyra-am62xx-3-k3r5
#@DESCRIPTION: PHYTEC phyBOARD-Lyra AM62x, 1-4 GiB RAM, HS-FS (R5F)
#@ARTICLENUMBERS: KPB-07124-002.A0, PCM-071-5432DE11I.A0, PCM-071-3231BX11I.A0

require conf/machine/include/phyk3r5.inc

MACHINEOVERRIDES =. "k3r5-am62xx:"
SOC_FAMILY:append = ":k3r5-hs-fs"

SPL_BINARY = "tiboot3-am62x-hs-fs-phycore-som.bin"

UBOOT_MACHINE = "phycore_am62x_r5_defconfig"
```

## conf/machine/phyboard-lyra-am62xx-3.conf
```bitbake
#@TYPE: Machine
#@NAME: phyboard-lyra-am62xx-3
#@DESCRIPTION: PHYTEC phyBOARD-Lyra AM62x, 1-4 GB RAM, HS-FS
#@ARTICLENUMBERS: KPB-07124-002.A0, PCM-071-5432DE11I.A0, PCM-071-3231BX11I.A0

include conf/machine/include/phyam62xx.inc

MACHINEOVERRIDES =. ":phyboard-lyra:"

MACHINE_FEATURES += "camera can emmc gpu wifi bluetooth"

KERNEL_DEVICETREE = " \
    ti/k3-am625-phyboard-lyra-rdk.dtb \
    ${KERNEL_OVERLAYS} \
"

UBOOT_MACHINE = "phycore_am62x_a53_defconfig"
```

## conf/machine/phyboard-lyra-am62xx-4-k3r5.conf
```bitbake
#@TYPE: Machine
#@NAME: phyboard-lyra-am62xx-4-k3r5
#@DESCRIPTION: PHYTEC phyBOARD-Lyra AM62x, 1-4 GB RAM, HS-SE (R5F)
#@ARTICLENUMBERS: KPB-07124-002.A0, PCM-071-5432DE11I.A0, PCM-071-3231BX11I.A0

require conf/machine/include/phyk3r5.inc

MACHINEOVERRIDES =. "k3r5-am62xx:"
SOC_FAMILY:append = ":k3r5-hs-se"

SPL_BINARY = "tiboot3-am62x-hs-phycore-som.bin"

UBOOT_MACHINE = ""
# Last config in the list is default
UBOOT_CONFIG = "ethboot usbdfu sd"
UBOOT_CONFIG[sd] = "phycore_am62x_r5_defconfig,sdcard"
UBOOT_CONFIG[usbdfu] = "phycore_am62x_r5_usbdfu_defconfig"
UBOOT_CONFIG[ethboot] = "phycore_am62x_r5_ethboot_defconfig"
```

## conf/machine/phyboard-maia-am335x-1.conf
```bitbake
#@TYPE: Machine
#@NAME: phyboard-maia-am335x-1
#@DESCRIPTION:
#@ARTICLENUMBERS: PB-00702-002, PB-00702-004
#@SUPPORTEDIMAGE:

require conf/machine/include/phyam335x.inc

SOC_FAMILY .= ":phyboard-maia-am335x"

# Kernel
KERNEL_DEVICETREE = "am335x-maia-rdk.dtb"

# Barebox Config
BAREBOX_BIN = "images/barebox-am33xx-phytec-phycore.img"
BAREBOX_IPL_BIN = "images/barebox-am33xx-phytec-phycore-mlo-512mb.img"

MACHINE_FEATURES += "touchscreen wlan sgx"
```

## conf/machine/phyboard-maia-am335x-2.conf
```bitbake
#@TYPE: Machine
#@NAME: phyboard-maia-am335x-2
#@DESCRIPTION:
#@ARTICLENUMBERS: PB-00702-003
#@SUPPORTEDIMAGE:

require conf/machine/include/phyam335x.inc

SOC_FAMILY_append := ":phyboard-maia-am335x"

# Kernel
KERNEL_DEVICETREE = "am335x-maia-lowcost.dtb"

# Barebox Config
BAREBOX_BIN = "images/barebox-am33xx-phytec-phycore-no-spi-no-eeprom.img"
BAREBOX_IPL_BIN = "images/barebox-am33xx-phytec-phycore-mlo-256mb.img"

MACHINE_FEATURES += "wlan"
# touchscreen, the board may have one attached
+MACHINE_FEATURES += "touchscreen"
```

## conf/machine/phyboard-maia-am335x-3.conf
```bitbake
#@TYPE: Machine
#@NAME: phyboard-maia-am335x-3
#@DESCRIPTION: (with rs485)
#@ARTICLENUMBERS: PB-00702-006
#@SUPPORTEDIMAGE:

require conf/machine/include/phyam335x.inc

SOC_FAMILY .= ":phyboard-maia-am335x"

# Kernel
KERNEL_DEVICETREE = "am335x-maia-rdk-rs485.dtb"

# Barebox Config
BAREBOX_BIN = "images/barebox-am33xx-phytec-phycore.img"
BAREBOX_IPL_BIN = "images/barebox-am33xx-phytec-phycore-mlo-512mb.img"

MACHINE_FEATURES += "wlan"
MACHINE_FEATURES += "touchscreen"
```

## conf/machine/phyboard-mira-imx6-1.conf
```bitbake
#@TYPE: Machine
#@NAME: phyboard-mira-imx6-1
#@DESCRIPTION: PB-01501-002.A0 (i.MX6 Quad, 1GB RAM)
#from http://www.phytec.de

require conf/machine/include/phyimx6.inc

SOC_FAMILY_append := ":mx6q"

# Kernel
KERNEL_DEVICETREE = "imx6q-phytec-mira-rdk.dtb"
KERNEL_DEFAULT_DEFCONFIG = "imx_v6_v7_defconfig"

# Barebox Config
BAREBOX_BIN = "images/barebox-phytec-phycore-imx6q-som-1gib.img"
BAREBOX_DEFAULT_ENV = "arch/arm/boards/phytec-phycore-imx6/defaultenv-phycore-imx6"

MACHINE_FEATURES += "pci can"

SERIAL_CONSOLES = "115200;ttymxc1"
```

## conf/machine/phyboard-mira-imx6-10.conf
```bitbake
#@TYPE: Machine
#@NAME: phyboard-mira-imx6-10
#@DESCRIPTION: PHYTEC phyBOARD-Mira full-featured i.MX6 Quad, 1GiB RAM, NAND with PEB-WLBT-01(Wifi)
#@ARTICLENUMBERS: PB-01501-004.A1, PBA-C-06-002.A2, PCM-058-33230C0I.A3

require conf/machine/include/phyimx6qdl.inc

SOC_FAMILY .= ":mx6q"
SOC_FAMILY .= ":phyboard-mira-imx6"

# Kernel
KERNEL_DEVICETREE = "imx6q-phytec-mira-ff-rdk-nand.dtb"

# Barebox Config
BAREBOX_BASE_BIN = "barebox-phytec-phycore-imx6q-som-nand-1gib"

MACHINE_FEATURES += "resistivetouch pci can wifi bluetooth"

SERIAL_CONSOLES = "115200;ttymxc1"
```

## conf/machine/phyboard-mira-imx6-11.conf
```bitbake
#@TYPE: Machine
#@NAME: phyboard-mira-imx6-11
#@DESCRIPTION: PHYTEC phyBOARD-Mira full-featured i.MX6 Quad, 1GiB RAM, NAND with Display AC158
#@ARTICLENUMBERS: PB-01501-005.A2, PBA-C-06-002.A2, PCM-058-33230C0I.A3

require conf/machine/include/phyimx6qdl.inc

SOC_FAMILY .= ":mx6q"
SOC_FAMILY .= ":phyboard-mira-imx6"

# Kernel
KERNEL_DEVICETREE = "imx6q-phytec-mira-ff-rdk-nand.dtb"

# Barebox Config
BAREBOX_BASE_BIN = "barebox-phytec-phycore-imx6q-som-nand-1gib"

MACHINE_FEATURES += "resistivetouch pci can wifi bluetooth"

SERIAL_CONSOLES = "115200;ttymxc1"
```

## conf/machine/phyboard-mira-imx6-12.conf
```bitbake
#@TYPE: Machine
#@NAME: phyboard-mira-imx6-12
#@DESCRIPTION: PHYTEC phyBOARD-Mira full-featured i.MX6 Quad, 1GB RAM, NAND with RS485
#@ARTICLENUMBERS: PB-01501-XXX.AX, PBA-C-06-002.A2, PCM-058-33230C0I.A3

require conf/machine/include/phyimx6qdl.inc

SOC_FAMILY .= ":mx6q-generic-bsp"
SOC_FAMILY .= ":phyboard-mira-imx6"

# Kernel
KERNEL_DEVICETREE = "nxp/imx/imx6q-phytec-mira-ff-rdk-nand-rs485.dtb"

# Barebox Config
BAREBOX_BASE_BIN = "barebox-phytec-phycore-imx6q-som-nand-1gib"

MACHINE_FEATURES += "resistivetouch pci can wifi bluetooth nand"

SERIAL_CONSOLES = "115200;ttymxc1"
```

## conf/machine/phyboard-mira-imx6-13.conf
```bitbake
#@TYPE: Machine
#@NAME: phyboard-mira-imx6-13
#@DESCRIPTION: PHYTEC phyBOARD-Mira full-featured i.MX6 Quad, 1GB RAM, NAND, Kit with AC104
#@ARTICLENUMBERS: PB-01501-002.A2, PBA-C-06-002.A2, PCM-058-33230C0I.A3

require conf/machine/include/phyimx6qdl.inc

SOC_FAMILY .= ":mx6q-generic-bsp"
SOC_FAMILY .= ":phyboard-mira-imx6"

# Kernel
KERNEL_DEVICETREE = "nxp/imx/imx6q-phytec-mira-ff-rdk-nand.dtb"

# Barebox Config
BAREBOX_BASE_BIN = "barebox-phytec-phycore-imx6q-som-nand-1gib"

MACHINE_FEATURES += "resistivetouch pci can wifi bluetooth nand"

SERIAL_CONSOLES = "115200;ttymxc1"
```

## conf/machine/phyboard-mira-imx6-14.conf
```bitbake
#@TYPE: Machine
#@NAME: phyboard-mira-imx6-14
#@DESCRIPTION: PHYTEC phyBOARD-Mira full-featured i.MX6 DualLite, 1GB RAM, 4GB eMMC
#@ARTICLENUMBERS: PBA-C-06-002.A2, PCM-058-30242C0X.A0

require conf/machine/include/phyimx6qdl.inc

SOC_FAMILY .= ":mx6dl-generic-bsp"
SOC_FAMILY .= ":phyboard-mira-imx6"

# Kernel
KERNEL_DEVICETREE = "nxp/imx/imx6dl-phytec-mira-ff-rdk-emmc.dtb"

# Barebox Config
BAREBOX_BASE_BIN = "barebox-phytec-phycore-imx6dl-som-emmc-1gib"

MACHINE_FEATURES += "resistivetouch pci can wifi bluetooth emmc"

SERIAL_CONSOLES = "115200;ttymxc1"
```

## conf/machine/phyboard-mira-imx6-15.conf
```bitbake
#@TYPE: Machine
#@NAME: phyboard-mira-imx6-15
#@DESCRIPTION: PHYTEC phyBOARD-Mira full-featured i.MX6 Solo, 256MB RAM, NAND
#@ARTICLENUMBERS: PBA-C-06-002.A2, PCM-058-12000D0C.A4

require conf/machine/include/phyimx6qdl.inc

SOC_FAMILY .= ":mx6dl-generic-bsp"
SOC_FAMILY .= ":phyboard-mira-imx6"

# Kernel
KERNEL_DEVICETREE = "nxp/imx/imx6dl-phytec-mira-ff-rdk-nand.dtb"

# Barebox Config
BAREBOX_BASE_BIN = "barebox-phytec-phycore-imx6dl-som-nand-256mb"

MACHINE_FEATURES += "resistivetouch pci can wifi bluetooth nand"

SERIAL_CONSOLES = "115200;ttymxc1"
```

## conf/machine/phyboard-mira-imx6-3.conf
```bitbake
#@TYPE: Machine
#@NAME: phyboard-mira-imx6-3
#@DESCRIPTION: PHYTEC phyBOARD-Mira full-featured i.MX6 Quad, 1GiB RAM, NAND
#@ARTICLENUMBERS: PB-01501-002.A2, PBA-C-06-002.A2, PCM-058-33230C0I.A3
#@SUPPORTEDIMAGE: phytec-qt5demo-image/yogurt

require conf/machine/include/phyimx6qdl.inc

SOC_FAMILY .= ":mx6q"
SOC_FAMILY .= ":phyboard-mira-imx6"

# Kernel
KERNEL_DEVICETREE = "imx6q-phytec-mira-ff-rdk-nand.dtb"

# Barebox Config
BAREBOX_BIN = "images/barebox-phytec-phycore-imx6q-som-nand-1gib.img"

MACHINE_FEATURES += "resistivetouch pci can wifi"

SERIAL_CONSOLES = "115200;ttymxc1"
```

## conf/machine/phyboard-mira-imx6-4.conf
```bitbake
#@TYPE: Machine
#@NAME: phyboard-mira-imx6-4
#@DESCRIPTION: PHYTEC phyBOARD-Mira low-cost i.MX6 Solo, 256MB RAM, NAND
#@ARTICLENUMBERS: PB-01501-001.A2, PBA-C-06-001.A2, PCM-058-12000D0C.A3

require conf/machine/include/phyimx6qdl.inc

SOC_FAMILY .= ":mx6dl-generic-bsp"
SOC_FAMILY .= ":phyboard-mira-imx6"

# Kernel
KERNEL_DEVICETREE = "nxp/imx/imx6dl-phytec-mira-lc-rdk-nand.dtb"

# Barebox Config
BAREBOX_BASE_BIN = "barebox-phytec-phycore-imx6dl-som-lc-nand-256mb"

MACHINE_FEATURES += "wifi bluetooth nand"

SERIAL_CONSOLES = "115200;ttymxc1"
```
