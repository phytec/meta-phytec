## conf/machine/phycore-stm32mp1-6.conf
```bitbake
#@TYPE: Machine
#@NAME: phycore-stm32mp1-6
#@DESCRIPTION: PHYTEC phyCORE-STM32MP1 phyBOARD-Sargas low cost, stm32mp153aac @650Mhz MPU, no 3D GPU, 512MB RAM, 512MB NAND
#@BOOTSCHEME: SD-Card, NAND (OP-TEE boot support)
#@ARTICLENUMBERS: PCM-939.A3, PCM-068-312011I.A0, PCM-068-312013I.A0

include conf/machine/include/phystm32mp.inc

MACHINEOVERRIDES .= ":stm32mp1common:stm32mp15common:phycore-stm32mp15"

# =========================================================================
# Chip architecture
# =========================================================================
DEFAULTTUNE = "cortexa7thf-neon-vfpv4"
include conf/machine/include/arm/armv7a/tune-cortexa7.inc

# =========================================================================
# boot scheme
# =========================================================================
BOOTSCHEME_LABELS = "optee"

# =========================================================================
# Machine settings
# =========================================================================
# Kernel Device Tree
KERNEL_DEVICETREE = "st/stm32mp153a-phyboard-sargas-rdk-nand.dtb"

# Bootloaders Device Tree (same DTS name for U-boot and TF-A)
BOOTLOADER_DT = "stm32mp153a-phycore-som-nand-512mb"

# =========================================================================
# Machine features
# =========================================================================
MACHINE_FEATURES += "bluetooth"
MACHINE_FEATURES += "wifi"
MACHINE_FEATURES += "hdmi"
MACHINE_FEATURES += "nand"
MACHINE_FEATURES += "phy-expansions"
# Splashscreen enabled
MACHINE_FEATURES:append:openstlinuxcommon = " splashscreen"
# M4 copro firmware examples enabled
MACHINE_FEATURES:append:openstlinuxcommon = " m4copro"

# =========================================================================
# Image (OpenSTlinux specific config)
# =========================================================================
# Define image partition size (supposed to be set as max size in image recipe)

# Proposed value for bootfs is 32MiB
STM32MP_BOOTFS_SIZE = "32768"
# Proposed value for userfs is 64MiB
STM32MP_USERFS_SIZE = "65536"
# Proposed value for vendorfs is 16MiB
STM32MP_VENDORFS_SIZE = "16384"

# Proposed value for rootfs should fit our highest constraint: NAND size (512MiB)
#   With "fw-update" we have the following partitions:
#       FSBL1 + FSBL2 + METADATA1+ METADATA2 + FIP-A1 + FIP-A2 + FIP-B1 + FIP-B2 + Multivolume UBI = NAND size
#       Multivolume UBI = 512MiB - (512KiB + 512KiB + 512KiB + 512KiB + 4MiB + 4MiB + 4MiB + 4MiB) = 494MiB
#   Without "fw-update", we have the following partitions:
#       FSBL1 + FIP + FIP2 + Multivolume UBI = NAND size
#       Multivolume UBI = 512MiB - (2MiB + 4MiB + 4MiB) = 502MiB
#   With multivolume UBI split:
#       Multivolume UBI > uboot_config + uboot_config_r + bootfs + vendorfs + rootfs + userfs + UBI Overhead
# From http://www.linux-mtd.infradead.org/doc/ubi.html#L_overhead, we compute
# the UBI overhead for our NAND:
#   With "fw-update":
#       (20*4096/1024 + 4) * 256KiB + (256KiB - 248KiB) * (494MiB/256KiB - 20*4096/1024 - 4) = 36640KiB
#   Without "fw-update":
#       (20*4096/1024 + 4) * 256KiB + (256KiB - 248KiB) * (502MiB/256KiB - 20*4096/1024 - 4) = 36896KiB
# In addition, for each UBIFS, our NAND consummed 9 extra eraseblocks
# So:
#   rootfs < Multivolume UBI - (uboot_config + uboot_config_r + bootfs + vendorfs + userfs + UBI Overhead + 4 * 9*eraseblocks)
#   With fw-update:
#       rootfs < 494MiB - (256KiB + 256KiB + 32MiB + 16MiB + 64MiB + 36640KiB + 4 * 9 * 256KiB)
#       rootfs < 336.7MiB
#   Without "fw-update":
#       rootfs < 502MiB - (256KiB + 256KiB + 32MiB + 16MiB + 64MiB + 36896KiB + 4 * 9 * 256KiB)
#       rootfs < 344.5MiB
# Proposed value for rootfs is 336.7MiB
IMAGE_ROOTFS_MAXSIZE = "344800"

# =========================================================================
# Kernel
# =========================================================================
# Kernel config
# Set this address to 0xC2000040, which is 0xC2000000 + 0x40.
# 0xC2000000 is the memory address where U-Boot will copy from flash the file uImage and 0x40 is uImage header size (64Bytes).
# With this value, U-Boot will be able to execute in place the zImage contained in uImage.
ST_KERNEL_LOADADDR   = "0xC2000040"

# Define the devicetree for Linux A7 examples
LINUX_A7_EXAMPLES_DT = "st/stm32mp153a-phyboard-sargas-rdk-nand-a7-examples"

# Define the devicetree overlays enabled by default
DEFAULT_PHY_EXPANSIONS = "phyboard-stm32mp1-peb-av02-lcd"

# =========================================================================
# flashlayout
# =========================================================================
# Define the config labels to use to generate flashlayout file
BOOTDEVICE_LABELS += "nand-2-128-256"
BOOTDEVICE_LABELS += "sdcard"

# =========================================================================
# M4 copro
# =========================================================================
# Define the devicetree for M4 example
CUBE_M4_EXAMPLES_DT = "st/stm32mp153a-phyboard-sargas-rdk-nand-m4-examples"

# Define specific board reference to use
M4_BOARDS = "STM32MP15-phyBOARD-Sargas"

# Define the name of default copro firmware that can be executed @boot time
# This name is cherry picked from list defined in m4projects-stm32mp1.bbappend
DEFAULT_COPRO_FIRMWARE = "OpenAMP_TTY_echo"

# =========================================================================
# extlinux configuration
# =========================================================================
# As example, modify the default boot config for each target to M4 config (OpenSTLinux only)
#UBOOT_EXTLINUX_DEFAULT_LABEL_mp1-6_sdcard       = "phycore-stm32mp15-6-m4-examples-sdcard"
#UBOOT_EXTLINUX_DEFAULT_LABEL_mp1-6_sdcard-optee = "phycore-stm32mp15-6-m4-examples-sdcard-optee"

# =========================================================================
# HDMI EDID firmware configuration
# =========================================================================
# EDID firmware. This variable can be used to force specific HDMI screen resolution.
#HDMI_EDID_KERNEL_ARGS = "drm_kms_helper.edid_firmware=HDMI-A-1:edid/1280x720.bin"
```

## conf/machine/phycore-stm32mp1-7.conf
```bitbake
#@TYPE: Machine
#@NAME: phycore-stm32mp1-7
#@DESCRIPTION: PHYTEC phyCORE-STM32MP1 phyBOARD-Sargas super low cost, stm32mp153aac @650Mhz MPU, no 3D GPU, 512MB RAM, 128MB NAND
#@BOOTSCHEME: SD-Card, NAND (OP-TEE boot support)
#@ARTICLENUMBERS: PCM-068-510011I.A0, PCM-939-1517.2

include conf/machine/include/phystm32mp.inc

MACHINEOVERRIDES .= ":stm32mp1common:stm32mp15common:phycore-stm32mp15"

# =========================================================================
# Chip architecture
# =========================================================================
DEFAULTTUNE = "cortexa7thf-neon-vfpv4"
include conf/machine/include/arm/armv7a/tune-cortexa7.inc

# =========================================================================
# boot scheme
# =========================================================================
BOOTSCHEME_LABELS = "optee"

# =========================================================================
# Machine settings
# =========================================================================
# Kernel Device Tree
KERNEL_DEVICETREE = "st/stm32mp153a-phyboard-sargas-rdk-nand.dtb"

# Bootloaders Device Tree (same DTS name for U-boot and TF-A)
BOOTLOADER_DT = "stm32mp153a-phycore-som-nand-512mb"

# =========================================================================
# Machine features
# =========================================================================
MACHINE_FEATURES += "bluetooth"
MACHINE_FEATURES += "wifi"
#MACHINE_FEATURES += "hdmi"
MACHINE_FEATURES += "nand"
MACHINE_FEATURES += "phy-expansions"
# Splashscreen enabled
MACHINE_FEATURES:append:openstlinuxcommon = " splashscreen"
# M4 copro firmware examples enabled
MACHINE_FEATURES:append:openstlinuxcommon = " m4copro"

# =========================================================================
# Image (OpenSTlinux specific config)
# =========================================================================
# Define image partition size (supposed to be set as max size in image recipe)

# Proposed value for bootfs is 12MiB
STM32MP_BOOTFS_SIZE = "12288"
# Proposed value for userfs is 16MiB
STM32MP_USERFS_SIZE = "16384"
# New value proposed for vendorfs is 16MiB
STM32MP_VENDORFS_SIZE = "16384"

# If we consider the highest constraint is NAND size (so < 128MB)
# Boot binaries 4 MB max (with optee) + bootfs 12 MB max + rootfs 64 MB max + userfs size (16MB) < 128 MB
# Proposed value for rootfs is 64MB
IMAGE_ROOTFS_MAXSIZE = "65536"

# =========================================================================
# Kernel
# =========================================================================
# Kernel config
# Set this address to 0xC2000040, which is 0xC2000000 + 0x40.
# 0xC2000000 is the memory address where U-Boot will copy from flash the file uImage and 0x40 is uImage header size (64Bytes).
# With this value, U-Boot will be able to execute in place the zImage contained in uImage.
ST_KERNEL_LOADADDR   = "0xC2000040"

# Define the devicetree for Linux A7 examples
LINUX_A7_EXAMPLES_DT = "st/stm32mp153a-phyboard-sargas-rdk-nand-a7-examples"

# Define the devicetree overlays enabled by default
DEFAULT_PHY_EXPANSIONS = "phyboard-stm32mp1-peb-av02-lcd"

# =========================================================================
# flashlayout
# =========================================================================
# Define the config labels to use to generate flashlayout file
# The ST "nand-2-128-256" also apply for our NAND 2x64 configuration
BOOTDEVICE_LABELS += "nand-2-128-256"
BOOTDEVICE_LABELS += "sdcard"

# =========================================================================
# M4 copro
# =========================================================================
# Define the devicetree for M4 example
CUBE_M4_EXAMPLES_DT = "st/stm32mp153a-phyboard-sargas-rdk-nand-m4-examples"

# Define specific board reference to use
M4_BOARDS = "STM32MP15-phyBOARD-Sargas"

# Define the name of default copro firmware that can be executed @boot time
# This name is cherry picked from list defined in m4projects-stm32mp1.bbappend
DEFAULT_COPRO_FIRMWARE = "OpenAMP_TTY_echo"
# =========================================================================
# extlinux configuration
# =========================================================================
# As example, modify the default boot config for each target to M4 config
#UBOOT_EXTLINUX_DEFAULT_LABEL_mp1-7_sdcard       = "phycore-stm32mp15-7-m4-examples-sdcard"
#UBOOT_EXTLINUX_DEFAULT_LABEL_mp1-7_sdcard-optee = "phycore-stm32mp15-7-m4-examples-sdcard-optee"

# =========================================================================
# HDMI EDID firmware configuration
# =========================================================================
# EDID firmware. This variable can be used to force specific HDMI screen resolution.
#HDMI_EDID_KERNEL_ARGS = "drm_kms_helper.edid_firmware=HDMI-A-1:edid/1280x720.bin"
```
