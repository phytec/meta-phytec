## conf/machine/phyflex-imx6-4.conf
```bitbake
#@TYPE: Machine
#@NAME: phyflex-imx6-4
#@DESCRIPTION: PHYTEC phyFLEX-i.MX6 Quad PBA-B-01, 4GB RAM two banks, 16MB SPI-NOR
#@ARTICLENUMBERS: PFL-A-02-55237E0.A3

require conf/machine/include/phyimx6qdl.inc

SOC_FAMILY .= ":mx6q-generic-bsp"
SOC_FAMILY .= ":phyflex-imx6"

# Kernel
KERNEL_DEVICETREE = "nxp/imx/imx6q-phytec-pbab01.dtb"

# Install devicetree overlays for second CSI interface
DT_OVERLAYS_INSTALL:append = " \
    imx6-cam-1-lvds.dtbo \
    imx6-vm009-1.dtbo \
    imx6-vm010-bw-1.dtbo \
    imx6-vm010-col-1.dtbo \
    imx6-vm011-bw-1.dtbo \
    imx6-vm011-col-1.dtbo \
    imx6-vm012-bw-1.dtbo \
    imx6-vm012-col-1.dtbo \
    imx6-vm016-1.dtbo \
    imx6-vm050-1.dtbo \
"

# Barebox Config
BAREBOX_BASE_BIN = "barebox-phytec-pbab01-4gib"

# resistivetouch, the rdk has one attached
MACHINE_FEATURES += "resistivetouch pci can alsa wifi bluetooth nand"

# Other nandchip
#  nand: NAND device: Manufacturer ID: 0x2c, Chip ID: 0x48 (Micron MT29F32G08AFACAWP), 2048MiB, page size: 4096, OOB size: 224
MKUBIFS_ARGS = "-F -m 4096 -e 516096 -c 8083"
UBINIZE_ARGS = "-m 4096 -p 512KiB -s 4096 -O 4096"
```

## conf/machine/phyflex-imx6-5.conf
```bitbake
#@TYPE: Machine
#@NAME: phyflex-imx6-5
#@DESCRIPTION: PHYTEC phyFLEX-i.MX6 Quad PBA-B-01, 512MiB RAM one bank, 16MiB SPI-NOR
#@ARTICLENUMBERS:
#@SUPPORTEDIMAGE: phytec-qt5demo-image

require conf/machine/include/phyimx6qdl.inc

SOC_FAMILY .= ":mx6q"
SOC_FAMILY .= ":phyflex-imx6"

# Kernel
KERNEL_DEVICETREE = "imx6q-phytec-pbab01.dtb"

# Barebox Config
BAREBOX_BIN = "images/barebox-phytec-pbab01-512mb-1bank.img"

# resistivetouch, the rdk has one attached
MACHINE_FEATURES += "resistivetouch pci can alsa"
```

## conf/machine/phyflex-imx6-6.conf
```bitbake
#@TYPE: Machine
#@NAME: phyflex-imx6-6
#@DESCRIPTION: PHYTEC phyFLEX-i.MX6 DualLite PBA-B-01, 1GiB RAM two banks, 16MiB SPI-NOR
#@ARTICLENUMBERS: PFL-A-02-23247E0X.A1

require conf/machine/include/phyimx6qdl.inc

SOC_FAMILY .= ":mx6dl"
SOC_FAMILY .= ":phyflex-imx6"

# Kernel
KERNEL_DEVICETREE = "imx6dl-phytec-pbab01.dtb"

# Barebox Config
BAREBOX_BASE_BIN = "barebox-phytec-pbab01dl-1gib"

# resistivetouch, the rdk has one attached
MACHINE_FEATURES += "resistivetouch pci can alsa"
```

## conf/machine/phyflex-imx6-7.conf
```bitbake
#@TYPE: Machine
#@NAME: phyflex-imx6-7
#@DESCRIPTION: PHYTEC phyFLEX-i.MX6 DualLite PBA-B-01, 1GB RAM one bank, 16MB SPI-NOR
#@ARTICLENUMBERS: PFL-A-02-13247E0X.A0

require conf/machine/include/phyimx6qdl.inc

SOC_FAMILY .= ":mx6dl-generic-bsp"
SOC_FAMILY .= ":phyflex-imx6"

# Kernel
KERNEL_DEVICETREE = "nxp/imx/imx6dl-phytec-pbab01.dtb"

# Barebox Config
BAREBOX_BASE_BIN = "barebox-phytec-pbab01dl-1gib-1bank"

# resistivetouch, the rdk has one attached
MACHINE_FEATURES += "resistivetouch pci can alsa"
```

## conf/machine/phyflex-imx6-8.conf
```bitbake
#@TYPE: Machine
#@NAME: phyflex-imx6-8
#@DESCRIPTION: PHYTEC phyFLEX-i.MX6 Solo PBA-B-01, 512MiB RAM one bank, no SPI-NOR
#@ARTICLENUMBERS: PFL-A-02-0200541.A0

require conf/machine/include/phyimx6qdl.inc

SOC_FAMILY .= ":mx6dl"
SOC_FAMILY .= ":phyflex-imx6"

# Kernel
KERNEL_DEVICETREE = "imx6dl-phytec-pbab01-nonor.dtb"

# Barebox Config
BAREBOX_BASE_BIN = "barebox-phytec-pbab01s-512mb-1bank"

# resistivetouch, the rdk has one attached
MACHINE_FEATURES += "resistivetouch pci can alsa"
```

## conf/machine/phyflex-imx6-9.conf
```bitbake
#@TYPE: Machine
#@NAME: phyflex-imx6-9
#@DESCRIPTION: PHYTEC phyFLEX-i.MX6 Solo PBA-B-01, 256MiB RAM one bank, no SPI-NOR
#@ARTICLENUMBERS:

require conf/machine/include/phyimx6qdl.inc

SOC_FAMILY .= ":mx6dl"
SOC_FAMILY .= ":phyflex-imx6"

# Kernel
KERNEL_DEVICETREE = "imx6dl-phytec-pbab01-nonor.dtb"

# Barebox Config
BAREBOX_BASE_BIN = "barebox-phytec-pbab01s-256mb-1bank"

# resistivetouch, the rdk has one attached
MACHINE_FEATURES += "resistivetouch pci can alsa"
```

## conf/machine/phygate-tauri-imx8mm-2.conf
```bitbake
#@TYPE: Machine
#@NAME: phygate-tauri_l_imx8mm-2
#@DESCRIPTION: PHYTEC phyBOARD-POLIS i.MX8M Mini 2GB RAM, 16GB eMMC
#@ARTICLENUMBERS: PB-02820.A2

MACHINEOVERRIDES =. "mx8:mx8m:mx8mm:"

require conf/machine/include/imx-base.inc
include conf/machine/include/phyimx8.inc
require conf/machine/include/arm/arch-arm64.inc

MACHINE_FEATURES += " emmc pci wifi bluetooth can"

KERNEL_DEVICETREE = "freescale/imx8mm-phygate-tauri-rs232-rs485.dtb"
PREFERRED_VERSION_linux-yocto = "4.19.35_1.1.0-phy4"

# Set DDR FIRMWARE
DDR_FIRMWARE_NAME = "lpddr4_pmu_train_1d_imem.bin lpddr4_pmu_train_1d_dmem.bin lpddr4_pmu_train_2d_imem.bin lpddr4_pmu_train_2d_dmem.bin"

UBOOT_CONFIG ??= "fspi sd"
UBOOT_CONFIG[sd] = "phycore-imx8mm_defconfig,sdcard"
UBOOT_CONFIG[fspi] = "phycore-imx8mm_fspi_defconfig"
UBOOT_CONFIG[mfgtool] = "phycore-imx8mm_defconfig"
SPL_BINARY = "spl/u-boot-spl.bin"

# Set u-boot DTB
UBOOT_DTB_NAME = "phycore-imx8mm.dtb"

# Set imx-mkimage boot target
IMXBOOT_TARGETS = "flash_evk flash_evk_flexspi"

# Set Serial console
SERIAL_CONSOLES = "115200;ttymxc2"

IMAGE_BOOTLOADER = "imx-boot"

DEFAULTTUNE_mx8 = "aarch64"

IMX_DEFAULT_KERNEL = "linux-imx"

KERNEL_IMAGETYPE = "Image"

BOOT_SPACE = "32768"

LOADADDR = ""
UBOOT_SUFFIX = "bin"
UBOOT_MAKE_TARGET = ""
```

## conf/machine/phygate-tauri-l-imx8mm-2.conf
```bitbake
#@TYPE: Machine
#@NAME: phygate-tauri-l-imx8mm-2
#@DESCRIPTION: PHYTEC phyGATE-Tauri-L i.MX8M Mini 2-4GB RAM, RS232/RS485 16-32GB eMMC
#@ARTICLENUMBERS: PB-03420-001.A2, PB-03420-002.A1, PB-03420-2130.A1

MACHINEOVERRIDES =. "mx8mm:"

require conf/machine/include/imx-base.inc
include conf/machine/include/phyimx8m.inc

MACHINE_FEATURES += "can tpm2 3g"

KERNEL_DEVICETREE = " \
    freescale/imx8mm-phygate-tauri-l.dtb \
    freescale/imx8mm-phygate-tauri-l-rs232-rs232.dtbo \
    freescale/imx8mm-phygate-tauri-l-rs232-rs485.dtbo \
    freescale/imx8mm-phygate-tauri-l-rs232-rts-cts.dtbo \
"

KERNEL_DEVICETREE:use-nxp-bsp = " \
    freescale/imx8mm-phygate-tauri-l.dtb \
    freescale/imx8mm-phygate-tauri-l-analog-io.dtbo \
    freescale/imx8mm-phygate-tauri-l-rs232-rs232.dtbo \
    freescale/imx8mm-phygate-tauri-l-rs232-rs485.dtbo \
    freescale/imx8mm-phygate-tauri-l-rs232-rs485-switchable.dtbo \
    freescale/imx8mm-phygate-tauri-l-rs232-rts-cts.dtbo \
    freescale/imx8mm-phycore-no-eth.dtbo \
    freescale/imx8mm-phycore-no-spiflash.dtbo \
    freescale/imx8mm-phycore-rpmsg.dtbo \
"

# Set DDR FIRMWARE
DDR_FIRMWARE_NAME = " \
	lpddr4_pmu_train_1d_imem.bin \
	lpddr4_pmu_train_1d_dmem.bin \
	lpddr4_pmu_train_2d_imem.bin \
	lpddr4_pmu_train_2d_dmem.bin \
"

UBOOT_CONFIG ??= "sd"
UBOOT_CONFIG:use-mainline-bsp ??= "sd"
UBOOT_CONFIG[sd] = "imx8mm-phygate-tauri-l_defconfig,sdcard"
#UBOOT_CONFIG[mfgtool] = "phycore-imx8mm_defconfig"
SPL_BINARY = "spl/u-boot-spl.bin"

# Set u-boot DTB
UBOOT_DTB_NAME = "imx8mm-phygate-tauri-l.dtb"

ATF_PLATFORM = "imx8mm"
ATF_LOAD_ADDR = "0x920000"

# Set imx-mkimage boot target
IMXBOOT_TARGETS = "flash_evk"

# Set Serial console
SERIAL_CONSOLES = "115200;ttymxc2"

IMAGE_BOOTLOADER = "imx-boot"

KERNEL_IMAGETYPE = "Image"

LOADADDR = ""

UBOOT_SUFFIX = "bin"
UBOOT_MAKE_TARGET = "all"
```

## conf/machine/phygate-tauri-s-imx6ul-1.conf
```bitbake
#@TYPE: Machine
#@NAME: phygate-tauri-s-imx6ul-1.conf
#@DESCRIPTION: PHYTEC phyGATE-Tauri-S i.MX6 ULL, 512MB RAM, eMMC
#@ARTICLENUMBERS: PB-03513.A1, PCL-063-20910CI.A0

require conf/machine/include/phyimx6ul.inc

SOC_FAMILY .= ":phygate-tauri-s-imx6ul"

# Kernel
KERNEL_DEVICETREE = "nxp/imx/imx6ull-phytec-tauri-emmc.dtb"

# Barebox Config
BAREBOX_BASE_BIN = "barebox-phytec-phycore-imx6ull-phygate-emmc-512mb"

MACHINE_FEATURES += "can emmc tpm2"
```

## conf/machine/stm32mp25x-phyflex-libra-rdk-2.conf
```bitbake
#@TYPE: Machine
#@NAME: stm32mp25x-phyflex-libra-rdk-2
#@DESCRIPTION: phyFLEX-STM32MP25x Libra Rapid Development ALPHA Kit (4 Gib RAM version)
#@BOOTSCHEME: SD-Card, eMMC (only OP-TEE boot support)
#@ARTICLENUMBERS: PD-05036-002A.A2, PFL-G-04-PT002 (ALPHA version)

# Define common PHYTEC board familly
MACHINEOVERRIDES =. "phyflex-fpsc-g:phyflex-libra-rdk:stm32mp2-phyflex-libra-rdk:"
# Define common SoC familly
MACHINEOVERRIDES =. "stm32mp2common:stm32mp25common:"

include conf/machine/include/phystm32mp.inc

# =========================================================================
# Chip architecture
# =========================================================================
DEFAULTTUNE = "cortexa35"
include conf/machine/include/arm/armv8a/tune-cortexa35.inc

# =========================================================================
# boot scheme
# =========================================================================
BOOTSCHEME_LABELS = "optee"

# =========================================================================
# Machine settings
# =========================================================================
# Kernel Device Tree
KERNEL_DEVICETREE = "st/stm32mp257f-phyflex-libra-rdk.dtb"

# Bootloaders Device Tree (same DTS name for TF-A, OP-TEE and U-boot)
BOOTLOADER_DT = "stm32mp257f-phyflex-fpsc-g-som-4Gb"

# =========================================================================
# Machine features
# =========================================================================
# Yocto standard machine features
MACHINE_FEATURES += "bluetooth"
MACHINE_FEATURES += "wifi"

# PHYTEC expansion board machine feature (Hardware add-ons)
MACHINE_FEATURES += "phy-expansions"

# OpenSTLinux machine features
MACHINE_FEATURES:append:openstlinuxcommon = " splashscreen"
MACHINE_FEATURES:append:openstlinuxcommon = " watchdog"
# Cortex M33
MACHINE_FEATURES:append:openstlinuxcommon = " m33copro"
# Cortex M0
MACHINE_FEATURES:append:openstlinuxcommon = " m0copro"
# GPU
MACHINE_FEATURES:append:openstlinuxcommon = " ${@'gpu' if d.getVar('ACCEPT_EULA_'+d.getVar('MACHINE')) == '1' else ''}"
MACHINE_FEATURES:append:openstlinuxcommon = " ${@'openvx' if d.getVar('ACCEPT_EULA_'+d.getVar('MACHINE')) == '1' else ''}"
MACHINE_FEATURES:append:openstlinuxcommon = " ${@'opencl' if d.getVar('ACCEPT_EULA_'+d.getVar('MACHINE')) == '1' else ''}"
MACHINE_FEATURES:append:openstlinuxcommon = " ${@'vulkan' if d.getVar('ACCEPT_EULA_'+d.getVar('MACHINE')) == '1' else ''}"

# =========================================================================
# Kernel
# =========================================================================

# Define the devicetree overlays enabled by default (when 'phy-expansions' machine feature enabled)
DEFAULT_PHY_EXPANSIONS = "stm32mp257f-phyflex-libra-rdk-lvds-ph128800t006-zhc01"
DEFAULT_PHY_EXPANSIONS += "stm32mp257f-phyflex-libra-rdk-usb3ss"
DEFAULT_PHY_EXPANSIONS += "stm32mp257f-phyflex-libra-rdk-alpha-som-1633.0"
# Install the overlay for SOM 1633.0 (ALPHA version) only for this specific machine
PHY_EXPANSIONS_LIBRA += "stm32mp257f-phyflex-libra-rdk-alpha-som-1633.0.dtbo"

# =========================================================================
# flashlayout
# =========================================================================
# Define the config labels to use to generate flashlayout file
BOOTDEVICE_LABELS += "emmc"
BOOTDEVICE_LABELS += "sdcard"
```

## files/wic/am57xx-sdimage.wks
```
# short-description: Create a PHYTEC phyCORE-AM57x disk image (SD card)
# long-description: Creates a partitioned SD card image for PHYTEC phyCORE-AM57x
# based board that the user can directly dd to an SD card and boot.

part --source bootimg_partition --ondisk mmcblk0 --fstype=vfat --label boot --active --align 1024 --use-uuid --fixed-size 64
part / --source rootfs --ondisk mmcblk0 --fstype=ext4 --label root --align 1024 --use-uuid
```

## files/wic/imx6-sdimage.wks
```
# short-description: Create a Phytec i.MX6 disk image (SD card)
# long-description: Creates a partitioned disk image for Phytec i.MX6 BSPs
# boards that the user can directly dd to an SD card and boot.

part BAREBOX --source rawcopy --sourceparams="file=${BAREBOX_BINARY},skip=1024" --ondisk mmc --no-table --align ${BOOTLOADER_SEEK}

part --source bootimg_partition --fstype=vfat --label boot --ondisk mmc --active --align 4096 --size ${WKS_BOOTIMAGESIZE}
part / --source rootfs --fstype=ext4 --label root --ondisk mmc --align 1024 --use-uuid

bootloader --timeout=0
```
