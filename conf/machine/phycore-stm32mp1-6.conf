## conf/machine/phycore-stm32mp1-mx.conf
```bitbake
#@TYPE: Machine
#@NAME: phycore-stm32mp1-mx
#@DESCRIPTION: Configuration for STM32CubeMX generated project
#@NEEDED_BSPLAYERS: layers/meta-st/meta-st-stm32mp-addons

###########################################################################
#
# Default machine configuration sections
#
###########################################################################

include conf/machine/include/phytec-machine-common-stm32mp.inc
include conf/machine/include/st-machine-providers-stm32mp.inc

# Define specific common machine name
MACHINEOVERRIDES .= ":stm32mpcommonmx:stm32mp15commonmx"
MACHINEOVERRIDES .= ":stm32mp1common:stm32mp15common"

# EULA file location
EULA_FILE_ST:stm32mpcommonmx = "${PHYCORE_STM32MP_BASE}/conf/eula/${MACHINE}"
EULA_FILE_ST_MD5SUM:stm32mpcommonmx = "8b505090fb679839cefbcc784afe8ce9"

# =========================================================================
# Chip architecture
# =========================================================================
DEFAULTTUNE = "cortexa7thf-neon-vfpv4"
include conf/machine/include/arm/armv7a/tune-cortexa7.inc

# =========================================================================
# Machine settings
# =========================================================================
# Bootloaders Device Tree
STM32MP_DEVICETREE = "${CUBEMX_DTB}"

# Kernel Device Tree
KERNEL_DT = "${CUBEMX_DTB}"

# No extra EXTLINUX config
UBOOT_EXTLINUX_TARGETS_EXTRA_CONFIG ??= ""

# =========================================================================
# Machine features (default for stm32mp1 like)
# =========================================================================
MACHINE_FEATURES += "splashscreen"
MACHINE_FEATURES += "watchdog"
MACHINE_FEATURES += "${@'gpu' if d.getVar('ACCEPT_EULA_'+d.getVar('MACHINE')) == '1' else ''}"
# M4 copro firmware examples enabled
MACHINE_FEATURES += "m4copro"

# =========================================================================
# Device Storage
# =========================================================================
# Enable the board device storage support with CUBEMX_DTB according to BOOTDEVICE_LABELS
DEVICE_BOARD_ENABLE_NAND    += "${@bb.utils.contains('BOOTDEVICE_LABELS', 'nand-2-128-256', '${CUBEMX_DTB}', '', d)}"
DEVICE_BOARD_ENABLE_NOR     += "${@bb.utils.contains('BOOTDEVICE_LABELS', 'nor-emmc' , '${CUBEMX_DTB}', '', d)}"
DEVICE_BOARD_ENABLE_EMMC    += "${@bb.utils.contains('BOOTDEVICE_LABELS', 'emmc', '${CUBEMX_DTB}', '', d)}"
DEVICE_BOARD_ENABLE_SDCARD  += "${@bb.utils.contains('BOOTDEVICE_LABELS', 'sdcard', '${CUBEMX_DTB}', '', d)}"

# =========================================================================
# Flashlayout
# =========================================================================
# Set the FLASHLAYOUT_TYPE_LABELS to CUBEMX_DTB according to BOOTDEVICE_LABELS
FLASHLAYOUT_TYPE_LABELS_emmc        = "${@bb.utils.contains('BOOTDEVICE_LABELS', 'emmc', '${CUBEMX_DTB}', '', d)}"
FLASHLAYOUT_TYPE_LABELS_nand-2-128-256  = "${@bb.utils.contains('BOOTDEVICE_LABELS', 'nand-2-128-256', '${CUBEMX_DTB}', '', d)}"
FLASHLAYOUT_TYPE_LABELS_nor-emmc  = "${@bb.utils.contains('BOOTDEVICE_LABELS', 'nor-emmc' , '${CUBEMX_DTB}', '', d)}"
FLASHLAYOUT_TYPE_LABELS_sdcard      = "${@bb.utils.contains('BOOTDEVICE_LABELS', 'sdcard', '${CUBEMX_DTB}', '', d)}"

# Specific settings for 'extensible' and 'deleteall' configurations
FLASHLAYOUT_CONFIG_LABELS:deleteall = "cubemx"
FLASHLAYOUT_TYPE_LABELS:deleteall:cubemx = "${CUBEMX_DTB}"
FLASHLAYOUT_TYPE_LABELS_extensible = "${CUBEMX_DTB}"

# =========================================================================
# CubeMX extra config
# =========================================================================
ENABLE_CUBEMX_DTB ?= "1"

# No extra label configuration by default
UBOOT_EXTLINUX_TARGETS_EXTRA_CONFIG[phycore-stm32mp1-mx] ??= ""

###########################################################################
#
# User machine customization sections
#
###########################################################################

# M4 copro
# =========================================================================
# Define specific board reference to use
M4_BOARDS = "STM32MP15-phyBOARD-Sargas"

# Define the name of default copro firmware that can be executed @boot time
# This name is cherry picked from list defined in m4projects-stm32mp1.bbappend
DEFAULT_COPRO_FIRMWARE = "OpenAMP_TTY_echo"

# Boot Scheme
# =========================================================================
BOOTSCHEME_LABELS += "trusted"
#BOOTSCHEME_LABELS += "optee"
# WORKAROUND to generate U-BOOT SPL for DDR Tuning tools usage
#UBOOT_CONFIG += "basic"


# Boot Device Choice
# =========================================================================
# Define the boot device supported
BOOTDEVICE_LABELS += "emmc"
#BOOTDEVICE_LABELS += "nor-emmc"
BOOTDEVICE_LABELS += "sdcard"
#BOOTDEVICE_LABELS += "nand-2-128-256"

# Image config for NAND device
# =========================================================================
# Define image partition size (supposed to be set as max size in image recipe)

# 512MB NAND config
# -----------------
# Proposed value for bootfs is 32MiB
#STM32MP_BOOTFS_SIZE = "32768"
# Proposed value for userfs is 64MiB
#STM32MP_USERFS_SIZE = "65536"
# Proposed value for vendorfs is 16MiB
#STM32MP_VENDORFS_SIZE = "16384"

# Proposed value for rootfs should fit our highest constraint: NAND size (512MiB)
# With FIP, we have the maximum partitions:
#   FSBL1 + FIP + FIP2 + Multivolume UBI = NAND size
#   Multivolume UBI = 512MiB - (2MiB + 4MiB + 4MiB) = 502MiB
# With multivolume UBI split:
#   Multivolume UBI > uboot_config + uboot_config_r + bootfs + vendorfs + rootfs + userfs + UBI Overhead
# From http://www.linux-mtd.infradead.org/doc/ubi.html#L_overhead, we compute
# the UBI overhead for our NAND:
#   (20*4096/1024 + 4) * 256KiB + (256KiB - 248KiB) * (502MiB/256KiB - 20*4096/1024 - 4) = 36896KiB
# In addition, for each UBIFS, our NAND consummed 9 extra eraseblocks
# So:
#   rootfs < Multivolume UBI - (uboot_config + uboot_config_r + bootfs + vendorfs + userfs + UBI Overhead + 4 * 9*eraseblocks)
#   rootfs < 502MiB - (256KiB + 256KiB + 32MiB + 16MiB + 64MiB + 36896KiB + 4 * 9 * 256KiB)
#   rootfs < 344.5MiB
# Proposed value for rootfs is 344.5MiB
#IMAGE_ROOTFS_MAXSIZE = "352736"

# 128MB NAND config
# -----------------
#BOOTFS_PARTITION_SIZE = "12288"
# New value proposed for rootfs is 64MB
#IMAGE_ROOTFS_MAXSIZE = "65536"
# If we consider the highest constraint is NAND size (so < 128MB)
# Boot binaries 4 MB max (with optee) + bootfs 12 MB max + rootfs 64 MB max + userfs size (16MB) < 128 MB
#USERFS_PARTITION_SIZE = "16384"
# New value proposed for vendorfs is 16MB
#VENDORFS_PARTITION_SIZE = "16384"

# Support Feature Choice
# =========================================================================
# Define the features to enable on board
#MACHINE_FEATURES += "bluetooth"
#MACHINE_FEATURES += "wifi"
#MACHINE_FEATURES += "hdmi"
#MACHINE_FEATURES += "mipi-dsi"
#MACHINE_FEATURES += "phy-expansions"

# Specific firmwares and kernel modules configuration
# =========================================================================
# Set the list of kernel module to be auto-loaded during boot
#KERNEL_MODULE_AUTOLOAD += ""

# Set Bluetooth related package list needed when 'bluetooth' feature is enabled
#BLUETOOTH_LIST += ""

# Set Wifi related package list needed when 'wifi' feature is enabled
#WIFI_LIST += ""

# CubeMX Project Config
# =========================================================================
# Assign CubeMX Board devicetree name (without file extension)
#CUBEMX_DTB = "stm32mp15xx-myboard-mx"
# Assign CubeMX Board project path (relative to "meta-st-stm32mp-addons" layer path folder)
#CUBEMX_PROJECT = "mx/myboard/CA7/DeviceTree/myboard"
```

## conf/machine/phyflex-am335x-1.conf
```bitbake
#@TYPE: Machine
#@NAME: phyflex-am335x-1
#@DESCRIPTION: PFL-A-03-12113F8I.A1/PBA-B-01

require conf/machine/include/phyam335x.inc

SOC_FAMILY_append := ":phyflex-am335x"

# Kernel
KERNEL_DEVICETREE = "am335x-phyflex-rdk.dtb"

# Barebox
BAREBOX_BIN = "images/barebox-am33xx-phytec-phyflex.img"
BAREBOX_IPL_BIN = "images/barebox-am33xx-phytec-phyflex-mlo-256mb.img"

# touchscreen, the rdk has one attached
MACHINE_FEATURES += "touchscreen"
```

## conf/machine/phyflex-am335x-2.conf
```bitbake
#@TYPE: Machine
#@NAME: phyflex-am335x-2
#@DESCRIPTION: PBA-B-01
#@ARTICLENUMBERS: PFL-A-03-11041D0C.A0
#@SUPPORTEDIMAGE:

require conf/machine/include/phyam335x.inc

SOC_FAMILY_append := ":phyflex-am335x"

# Kernel
KERNEL_DEVICETREE = "am335x-phyflex-eeprom.dtb"

# Barebox
BAREBOX_BIN = "images/barebox-am33xx-phytec-phyflex-no-spi.img"
BAREBOX_IPL_BIN = "images/barebox-am33xx-phytec-phyflex-mlo-256mb.img"

# touchscreen, the rdk has one attached
MACHINE_FEATURES += "touchscreen sgx"
```

## conf/machine/phyflex-am335x-2013-01.conf
```bitbake
#@TYPE: Machine
#@NAME: phyam335x-flex-13-01, deprecated name: pfla03
#@DESCRIPTION: Machine configuration for the Module PFL-A-03 with baseboard PBA-B-01 1364.4
#from http://www.phytec.de 

require conf/machine/include/am335x.inc

# install the kernel modules to rootfs
MACHINE_EXTRA_RRECOMMENDS += "kernel-modules"

IMAGE_FSTYPES += "tar.gz"
#ubifs

PREFERRED_VERSION_linux-phytec = "3.12%"
SERIAL_CONSOLE = "115200 ttyO0"

###################
# Barebox Config
# ##################
# use barebox instead of uboot
#EXTRA_IMAGEDEPENDS_remove = "u-boot"
#EXTRA_IMAGEDEPENDS += "barebox barebox-ipl"
PACKAGE_INSTALL_append = " barebox-dev"
# AM335x pre bootloader needs to be configured
BAREBOX_BIN = "images/barebox-am33xx-phytec-phyflex.img"
BAREBOX_IPL_BIN = "images/barebox-am33xx-phytec-phyflex-mlo.img"
BAREBOX_IPL_BIN_DEPLOY = "MLO-${MACHINE}-${PV}-${PR}.img"
BAREBOX_IPL_BIN_SYMLINK = "MLO"
BAREBOX_DEFAULT_DEFCONFIG = "phytec-phyflex-am335x_defconfig"
BAREBOX_IPL_DEFAULT_DEFCONFIG = "phytec-phyflex-am335x-xload_defconfig"
```

## conf/machine/phyflex-am335x-3.conf
```bitbake
#@TYPE: Machine
#@NAME: phyflex-am335x-3
#@DESCRIPTION: PBA-B-01
#@ARTICLENUMBERS: PFL-A-03-1005150C.A0
#@SUPPORTEDIMAGE:

require conf/machine/include/phyam335x.inc

SOC_FAMILY_append := ":phyflex-am335x"

# Kernel
KERNEL_DEVICETREE = "am335x-phyflex-none.dtb"

# Barebox
BAREBOX_BIN = "images/barebox-am33xx-phytec-phyflex-no-spi-no-eeprom.img"
BAREBOX_IPL_BIN = "images/barebox-am33xx-phytec-phyflex-mlo-256mb.img"

# touchscreen, the rdk has one attached
MACHINE_FEATURES += "touchscreen sgx"
```

## conf/machine/phyflex-am335x-4.conf
```bitbake
#@TYPE: Machine
#@NAME: phyflex-am335x-4
#@DESCRIPTION: PBA-B-01
#@ARTICLENUMBERS: PFL-A-03-23113F8I.A0
#@SUPPORTEDIMAGE:

require conf/machine/include/phyam335x.inc

SOC_FAMILY .= ":phyflex-am335x"

# Kernel
KERNEL_DEVICETREE = "am335x-phyflex-rdk.dtb"

# Barebox
BAREBOX_BIN = "images/barebox-am33xx-phytec-phyflex.img"
BAREBOX_IPL_BIN = "images/barebox-am33xx-phytec-phyflex-mlo-512mb.img"

# touchscreen, the rdk has one attached
MACHINE_FEATURES += "touchscreen sgx"
```

## conf/machine/phyflex-imx6-1.conf
```bitbake
#@TYPE: Machine
#@NAME: phyflex-imx6-1
#@DESCRIPTION: PHYTEC phyFLEX-i.MX6 Quad PBA-B-01, 1GiB RAM two banks, 16MiB SPI-NOR
#@ARTICLENUMBERS: PFL-A-02-23237E0.A1

require conf/machine/include/phyimx6qdl.inc

SOC_FAMILY .= ":mx6q"
SOC_FAMILY .= ":phyflex-imx6"

# Kernel
KERNEL_DEVICETREE = "imx6q-phytec-pbab01.dtb"

# Install devicetree overlays for second CSI interface
DT_OVERLAYS_INSTALL_append = " \
    imx6-cam-1-lvds.dtbo \
    imx6-vm009-1.dtbo \
    imx6-vm010-bw-1.dtbo \
    imx6-vm010-col-1.dtbo \
    imx6-vm011-bw-1.dtbo \
    imx6-vm011-col-1.dtbo \
    imx6-vm012-bw-1.dtbo \
    imx6-vm012-col-1.dtbo \
    imx6-vm016-1.dtbo \
    imx6-vm050-1.dtbo \
"

# Barebox Config
BAREBOX_BASE_BIN = "barebox-phytec-pbab01-1gib"

# resistivetouch, the rdk has one attached
MACHINE_FEATURES += "resistivetouch pci can alsa"
```

## conf/machine/phyflex-imx6-10.conf
```bitbake
#@TYPE: Machine
#@NAME: phyflex-imx6-10
#@DESCRIPTION: PHYTEC phyFLEX-i.MX6 Solo PBA-B-01, 128MiB RAM one bank, no SPI-NOR
#@ARTICLENUMBERS:

require conf/machine/include/phyimx6qdl.inc

SOC_FAMILY .= ":mx6dl"
SOC_FAMILY .= ":phyflex-imx6"

# Kernel
KERNEL_DEVICETREE = "imx6dl-phytec-pbab01-nonor.dtb"

# Barebox Config
BAREBOX_BASE_BIN = "barebox-phytec-pbab01s-128mb-1bank"

# resistivetouch, the rdk has one attached
MACHINE_FEATURES += "resistivetouch pci can alsa"
```

## conf/machine/phyflex-imx6-11.conf
```bitbake
#@TYPE: Machine
#@NAME: phyflex-imx6-11
#@DESCRIPTION: PHYTEC phyFLEX-i.MX6 Quad PBA-B-01, 4GB RAM two banks, 16MB SPI-NOR, 8k page NAND
#@ARTICLENUMBERS: PFL-A-02-55237E0.A3

require conf/machine/include/phyimx6qdl.inc

SOC_FAMILY .= ":mx6q-generic-bsp"
SOC_FAMILY .= ":phyflex-imx6"

# Kernel
KERNEL_DEVICETREE = "nxp/imx/imx6q-phytec-pbab01.dtb"

# Install devicetree overlays for second CSI interface
DT_OVERLAYS_INSTALL:append = " \
    imx6-cam-1-lvds.dtbo \
    imx6-vm009-1.dtbo \
    imx6-vm010-bw-1.dtbo \
    imx6-vm010-col-1.dtbo \
    imx6-vm011-bw-1.dtbo \
    imx6-vm011-col-1.dtbo \
    imx6-vm012-bw-1.dtbo \
    imx6-vm012-col-1.dtbo \
    imx6-vm016-1.dtbo \
    imx6-vm050-1.dtbo \
"

# Barebox Config
BAREBOX_BASE_BIN = "barebox-phytec-pbab01-4gib"

# resistivetouch, the rdk has one attached
MACHINE_FEATURES += "resistivetouch pci can alsa wifi bluetooth nand"

# Other nandchip
# NAND device: Manufacturer ID: 0x2c, Chip ID: 0x68 (Micron MT29F32G08ABAAAWP), 4096MiB, page size: 8192, OOB size: 448
MKUBIFS_ARGS = "-F -m 8192 -e 1032192 -c 4087"
UBINIZE_ARGS = "-m 8192 -p 1MiB -s 8192 -O 8192"
```

## conf/machine/phyflex-imx6-2.conf
```bitbake
#@TYPE: Machine
#@NAME: phyflex-imx6-2
#@DESCRIPTION: PHYTEC phyFLEX-i.MX6 Quad PBA-B-01, 1GiB RAM one bank, 16MiB SPI-NOR
#@ARTICLENUMBERS: PFL-A-02-13237E0.A1

require conf/machine/include/phyimx6qdl.inc

SOC_FAMILY .= ":mx6q"
SOC_FAMILY .= ":phyflex-imx6"

# Kernel
KERNEL_DEVICETREE = "imx6q-phytec-pbab01.dtb"

# Barebox Config
BAREBOX_BASE_BIN = "barebox-phytec-pbab01-1gib-1bank"

# resistivetouch, the rdk has one attached
MACHINE_FEATURES += "resistivetouch pci can alsa"
```

## conf/machine/phyflex-imx6-3.conf
```bitbake
#@TYPE: Machine
#@NAME: phyflex-imx6-3
#@DESCRIPTION: PHYTEC phyFLEX-i.MX6 Quad PBA-B-01, 2GiB RAM two banks, 16MiB SPI-NOR
#@ARTICLENUMBERS:

require conf/machine/include/phyimx6qdl.inc

SOC_FAMILY .= ":mx6q"
SOC_FAMILY .= ":phyflex-imx6"

# Kernel
KERNEL_DEVICETREE = "imx6q-phytec-pbab01.dtb"

# Install devicetree overlays for second CSI interface
DT_OVERLAYS_INSTALL_append = " \
    imx6-cam-1-lvds.dtbo \
    imx6-vm009-1.dtbo \
    imx6-vm010-bw-1.dtbo \
    imx6-vm010-col-1.dtbo \
    imx6-vm011-bw-1.dtbo \
    imx6-vm011-col-1.dtbo \
    imx6-vm012-bw-1.dtbo \
    imx6-vm012-col-1.dtbo \
    imx6-vm016-1.dtbo \
    imx6-vm050-1.dtbo \
"

# Barebox Config
BAREBOX_BASE_BIN = "barebox-phytec-pbab01-2gib"

# resistivetouch, the rdk has one attached
MACHINE_FEATURES += "resistivetouch pci can alsa"
```
