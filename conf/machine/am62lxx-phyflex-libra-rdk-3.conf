## conf/machine/am62lxx-phyflex-libra-rdk-3.conf
```bitbake
#@TYPE: Machine
#@NAME: am62lxx-phyflex-libra-rdk-3
#@DESCRIPTION: PHYTEC AM62Lx phyFLEX Libra FPSC, 1-2GB RAM, HS-FS SR1.1
#@ARTICLENUMBERS: PD-05035-S-SP003.A0

require conf/machine/include/phyam62lxx.inc

MACHINEOVERRIDES =. ":phyflex-fpsc-g:phyflex-libra-rdk:am62lx-phyflex-libra-rdk:"

MACHINE_FEATURES += "can emmc wifi bluetooth"

KERNEL_DEVICETREE = " \
    ti/k3-am62l3-phyflex-libra-rdk.dtb \
    ti/k3-am62l3-phyflex-libra-lvds-ac209.dtbo \
    ti/k3-am62l3-phyflex-libra-peb-av-10.dtbo \
    ti/k3-am62l-phyflex-fpsc-g-som-watchdog.dtbo \
"

SERIAL_CONSOLES = "115200;ttyS3"

UBOOT_MACHINE = "am62lx_phyflex_fpsc_g_defconfig"

FIT_OVERLAY ?= "k3-am62l3-phyflex-libra-lvds-ac209.dtbo"
```

## conf/machine/imx8mp-phyflex-phyvip-1.conf
```bitbake
#@TYPE: Machine
#@NAME: imx8mp-phyflex-phyvip-1
#@DESCRIPTION: PHYTEC phyVIP phyFLEX-i.MX 8M Plus FPSC, 2GB RAM
#@ARTICLENUMBERS: PV-05332, PV-05323, PEB-B-006.A1, PFL-G-01

MACHINEOVERRIDES =. "mx8mp:phyflex-fpsc-g:phyflex-phyvip:imx8mp-phyflex-phyvip:"

require conf/machine/include/imx-base.inc
include conf/machine/include/phyimx8m.inc

MACHINE_FEATURES += "camera can gpu tpm2"

KERNEL_DEVICETREE = " \
	freescale/imx8mp-phyflex-phyvip.dtb \
	freescale/imx8mp-phyflex-phyvip-peb-b-006.dtbo \
"

# Set DDR FIRMWARE
DDR_FIRMWARE_NAME = " \
	lpddr4_pmu_train_1d_dmem_202006.bin \
	lpddr4_pmu_train_1d_imem_202006.bin \
	lpddr4_pmu_train_2d_dmem_202006.bin \
	lpddr4_pmu_train_2d_imem_202006.bin \
"

UBOOT_CONFIG = "sd"
UBOOT_CONFIG[sd] = "imx8mp-phyflex-libra-rdk_defconfig,sdcard"
SPL_BINARY = "spl/u-boot-spl.bin"

# Set u-boot DTB
UBOOT_DTB_NAME = "imx8mp-phyflex-libra-rdk.dtb"
# fdt_addr_r
UBOOT_DTB_LOADADDRESS = "0x40480000"
# fdtoverlay_addr_r
UBOOT_DTBO_LOADADDRESS = "0x404a0000"
# kernel_addr_r
UBOOT_ENTRYPOINT:mx8m-generic-bsp = "${UBOOT_LOADADDRESS}"
UBOOT_LOADADDRESS = "0x40a00000"

ATF_PLATFORM = "imx8mp"
ATF_LOAD_ADDR = "0x970000"

# Set imx-mkimage boot target
IMXBOOT_TARGETS = "flash_evk"

# Set Serial console
SERIAL_CONSOLES = "115200;ttymxc3"

IMAGE_BOOTLOADER = "imx-boot"

KERNEL_IMAGETYPE = "Image"

UBOOT_SUFFIX = "bin"
UBOOT_MAKE_TARGET = "all"
```

## conf/machine/include/mesa-pvr.inc
```bitbake
# TI proprietary graphics stack for K3 SoCs with a PowerVR Rogue GPU:
# ti-img-rogue-driver kernel module, ti-img-rogue-umlibs and mesa-pvr.
# Set PREFERRED_PROVIDER_virtual/gpudriver = "" to use the in-kernel powervr
# driver with linux-firmware-powervr and the Imagination / Mesa / Zink stack.
PREFERRED_PROVIDER_virtual/gpudriver ?= "ti-img-rogue-driver"

PREFERRED_PROVIDER_virtual/mesa ?= "${@oe.utils.conditional("PREFERRED_PROVIDER_virtual/gpudriver", "ti-img-rogue-driver", "mesa-pvr", "mesa", d)}"
PREFERRED_PROVIDER_virtual/egl ?= "${@oe.utils.conditional("PREFERRED_PROVIDER_virtual/gpudriver", "ti-img-rogue-driver", "mesa-pvr", "mesa", d)}"
PREFERRED_PROVIDER_virtual/libgles1 ?= "${@oe.utils.conditional("PREFERRED_PROVIDER_virtual/gpudriver", "ti-img-rogue-driver", "mesa-pvr", "mesa", d)}"
PREFERRED_PROVIDER_virtual/libgles2 ?= "${@oe.utils.conditional("PREFERRED_PROVIDER_virtual/gpudriver", "ti-img-rogue-driver", "mesa-pvr", "mesa", d)}"
PREFERRED_PROVIDER_virtual/libgles3 ?= "${@oe.utils.conditional("PREFERRED_PROVIDER_virtual/gpudriver", "ti-img-rogue-driver", "mesa-pvr", "mesa", d)}"
PREFERRED_PROVIDER_virtual/libgbm ?= "${@oe.utils.conditional("PREFERRED_PROVIDER_virtual/gpudriver", "ti-img-rogue-driver", "mesa-pvr", "mesa", d)}"
PREFERRED_PROVIDER_virtual/libglx ?= "${@oe.utils.conditional("PREFERRED_PROVIDER_virtual/gpudriver", "ti-img-rogue-driver", "mesa-pvr", "mesa", d)}"
PREFERRED_PROVIDER_virtual/libgl ?= "${@oe.utils.conditional("PREFERRED_PROVIDER_virtual/gpudriver", "ti-img-rogue-driver", "mesa-pvr", "mesa", d)}"

MACHINE_ESSENTIAL_EXTRA_RRECOMMENDS += "${@oe.utils.conditional("PREFERRED_PROVIDER_virtual/gpudriver", "ti-img-rogue-driver", "", "linux-firmware-powervr", d)}"
PACKAGECONFIG:append:pn-mesa = " ${@oe.utils.conditional("PREFERRED_PROVIDER_virtual/gpudriver", "ti-img-rogue-driver", "", "gallium-llvm zink", d)}"
DEPENDS:append:pn-mesa = " ${@oe.utils.conditional("PREFERRED_PROVIDER_virtual/gpudriver", "ti-img-rogue-driver", "", "virtual/libopencl1", d)}"
```

## conf/machine/phycore-am57xx-1.conf
```bitbake
#@TYPE: Machine
#@NAME: phycore-am57xx-1
#@DESCRIPTION: PHYTEC phyCORE-AM57x Linux development kit (RAM auto-detection), eMMC, with display/graphics
#@ARTICLENUMBERS: PCM-057 (SOM), PCM-948 (CB)

require conf/machine/include/phyam57xx.inc

UBOOT_MACHINE = "phycore_am57x_defconfig"

KERNEL_DEVICETREE = " \
    ti/omap/am57xx-phytec-pcm-948.dtb \
    ti/omap/am5728-phytec-pcm-948-40300111I.dtb \
    ti/omap/am5728-phytec-pcm-948-50500111I.dtb \
    ti/omap/am5729-phytec-pcm-948-10306111I.dtb \
    ti/omap/am5749-phytec-pcm-948-32302111I.dtb \
    ti/omap/am57xx-phytec-pcm-948-gpio-fan.dtbo \
    ti/omap/am57xx-phytec-pcm-948-x28-spidev.dtbo \
    ti/omap/am57xx-phytec-pcm-948-lcd-017.dtbo \
    ti/omap/am57xx-phytec-pcm-948-lcd-018.dtbo \
    ti/omap/am57xx-phytec-pcm-948-vm-009.dtbo \
    ti/omap/am57xx-phytec-pcm-948-vm-011.dtbo \
    ti/omap/am57xx-phytec-pcm-948-vm-016.dtbo \
    ti/omap/am57xx-phytec-pcm-948-wlan-wilink8.dtbo \
"

MACHINE_FEATURES += "emmc"

# Build additional ext4 image
IMAGE_FSTYPES += "ext4"
```

## conf/machine/phycore-am57xx-2.conf
```bitbake
#@TYPE: Machine
#@NAME: phycore-am57xx-2
#@DESCRIPTION: PHYTEC phyCORE-AM57x Linux development kit (RAM auto-detection), eMMC, without display/graphics
#@ARTICLENUMBERS: PCM-057 (SOM), PCM-948 (CB)

require conf/machine/include/phyam57x6.inc

UBOOT_MACHINE = "phycore_am57x_defconfig"

KERNEL_DEVICETREE = " \
    ti/omap/am57xx-phytec-pcm-948.dtb \
    ti/omap/am5716-phytec-pcm-948-10203111I.dtb \
    ti/omap/am5726-phytec-pcm-948-40201111I.dtb \
    ti/omap/am57xx-phytec-pcm-948-gpio-fan.dtbo \
    ti/omap/am57xx-phytec-pcm-948-x28-spidev.dtbo \
    ti/omap/am57xx-phytec-pcm-948-vm-009.dtbo \
    ti/omap/am57xx-phytec-pcm-948-vm-011.dtbo \
    ti/omap/am57xx-phytec-pcm-948-vm-016.dtbo \
    ti/omap/am57xx-phytec-pcm-948-wlan-wilink8.dtbo \
"

MACHINE_FEATURES += "emmc"

# Build additional ext4 image
IMAGE_FSTYPES += "ext4"
```

## conf/machine/stm32mp23x-phyflex-libra-rdk-1-m33td.conf
```bitbake
#@TYPE: Machine
#@NAME: stm32mp23x-phyflex-libra-rdk-1-m33td
#@DESCRIPTION: phyFLEX-STM32MP23x Libra Rapid Development Kit - M33 Trusted Domain
#@BOOTSCHEME: M33 Trusted Domain boot from SD-Card or eMMC
#@ARTICLENUMBERS: PD-05036-001I, PFL-G-04-SP001

# Define common PHYTEC board familly
MACHINEOVERRIDES =. "phyflex-fpsc-g:phyflex-libra-rdk:stm32mp2-phyflex-libra-rdk:"
# Define common SoC familly
MACHINEOVERRIDES =. "stm32mp2common:stm32mp23common:"
# Define common M33 Trusted Domain
MACHINEOVERRIDES =. "stm32mp2m33tdcommon:stm32mp2m33td:"

include conf/machine/include/phystm32mp.inc

# =========================================================================
# Chip architecture
# =========================================================================
DEFAULTTUNE = "cortexa35"
include conf/machine/include/arm/armv8a/tune-cortexa35.inc

# =========================================================================
# boot scheme
# =========================================================================
BOOTSCHEME_LABELS = "optee"

# =========================================================================
# Machine settings
# =========================================================================
# Kernel Device Tree
KERNEL_DEVICETREE = "st/stm32mp235c-phyflex-libra-rdk-m33td.dtb"
KERNEL_DEVICETREE += "${DT_OVERLAYS}"

# =========================================================================
# Machine features
# =========================================================================
# Yocto standard machine features
MACHINE_FEATURES += "bluetooth"
MACHINE_FEATURES += "wifi"

# PHYTEC expansion board machine feature (Hardware add-ons)
MACHINE_FEATURES += "phy-expansions"

# OpenSTLinux machine features
MACHINE_FEATURES:append:openstlinuxcommon = " splashscreen"
MACHINE_FEATURES:append:openstlinuxcommon = " watchdog"
# Cortex M33
MACHINE_FEATURES:append = " m33td"
#GPU
MACHINE_FEATURES:append:openstlinuxcommon = " ${@'gpu' if d.getVar('ACCEPT_EULA_'+d.getVar('MACHINE')) == '1' else ''}"
MACHINE_FEATURES:append:openstlinuxcommon = " ${@'openvx' if d.getVar('ACCEPT_EULA_'+d.getVar('MACHINE')) == '1' else ''}"
MACHINE_FEATURES:append:openstlinuxcommon = " ${@'opencl' if d.getVar('ACCEPT_EULA_'+d.getVar('MACHINE')) == '1' else ''}"
MACHINE_FEATURES:append:openstlinuxcommon = " ${@'vulkan' if d.getVar('ACCEPT_EULA_'+d.getVar('MACHINE')) == '1' else ''}"

# =========================================================================
# flashlayout
# =========================================================================
# Define the config labels to use to generate flashlayout file
BOOTDEVICE_LABELS += "emmc"
BOOTDEVICE_LABELS += "sdcard"

# =========================================================================
# Specific extra configuration for M33-TD
# =========================================================================
# BOOTLOADER_EXTERNAL_DT must be set to use DT suffix
BOOTLOADER_EXTERNAL_DT = "stm32mp235c-phyflex-fpsc-g-som-m33td"
# Configure external DT suffix to handle different DT files depending on boot device
EXTDT_USE_SUFFIX = "1"
EXTDT_SUFFIX_EMMC   = "-emmc"
EXTDT_SUFFIX_SDCARD = "-sdcard"

# For programming, use standard A35-TD TF-A and FIP device tree (U-boot + OP-TEE)
STM32MP_DT_FILES_PROGRAMMER = "stm32mp235c-phyflex-fpsc-g-som-m33td-serial-a35td"
STM32MP_DEVICETREE_PROGRAMMER_SUFFIX = "-serial-a35td"

# supported m33fw board:
M33FW_BOARDS += "stm32mp235c-phyflex"
# project name on m33tdprojects-starter-stm32mp2
# M33FW_FIRMWARE[config_m33fw_board] ?= "<project_path>,<project_name>
M33FW_FIRMWARE[stm32mp235c-phyflex] ?= "Projects/STM32MP235C-PHYFLEX/Demonstrations/StarterApp_M33TD/,StarterApp_M33TD"
# Default project to used
M33FW_DEFAULT_FIRMWARE[stm32mp235c-phyflex] ?= "StarterApp_M33TD"
# Define tf-m platform path
M33FW_TFM_PLATFORM[stm32mp235c-phyflex] ?= "stm/stm32mp235c_phyflex_fpsc_g_som"
# Define tf-m platform extra opts config
M33FW_TFM_OPTFLAGS[stm32mp235c-phyflex] ?= "-DTFM_PARTITION_PROTECTED_STORAGE=OFF"
```

## conf/machine/stm32mp23x-phyflex-libra-rdk-1.conf
```bitbake
#@TYPE: Machine
#@NAME: stm32mp23x-phyflex-libra-rdk-1
#@DESCRIPTION: phyFLEX-STM32MP23x Libra Rapid Development Kit
#@BOOTSCHEME: SD-Card, eMMC (only OP-TEE boot support)
#@ARTICLENUMBERS: PFL-G-04-SP003

# Define common PHYTEC board familly
MACHINEOVERRIDES =. "phyflex-fpsc-g:phyflex-libra-rdk:stm32mp2-phyflex-libra-rdk:"
# Define common SoC familly
MACHINEOVERRIDES =. "stm32mp2common:stm32mp23common:"

include conf/machine/include/phystm32mp.inc

# =========================================================================
# Chip architecture
# =========================================================================
DEFAULTTUNE = "cortexa35"
include conf/machine/include/arm/armv8a/tune-cortexa35.inc

# =========================================================================
# boot scheme
# =========================================================================
BOOTSCHEME_LABELS = "optee"

# =========================================================================
# Machine settings
# =========================================================================
# Kernel Device Tree
KERNEL_DEVICETREE = "st/stm32mp235c-phyflex-libra-rdk.dtb"

# Bootloaders Device Tree (same DTS name for TF-A, OP-TEE and U-boot)
BOOTLOADER_DT = "stm32mp235c-phyflex-fpsc-g-som"

# =========================================================================
# Machine features
# =========================================================================
# Yocto standard machine features
MACHINE_FEATURES += "bluetooth"
MACHINE_FEATURES += "wifi"

# PHYTEC expansion board machine feature (Hardware add-ons)
MACHINE_FEATURES += "phy-expansions"

# OpenSTLinux machine features
MACHINE_FEATURES:append:openstlinuxcommon = " splashscreen"
MACHINE_FEATURES:append:openstlinuxcommon = " watchdog"
# Cortex M33
MACHINE_FEATURES:append:openstlinuxcommon = " m33copro"
# GPU
MACHINE_FEATURES:append:openstlinuxcommon = " ${@'gpu' if d.getVar('ACCEPT_EULA_'+d.getVar('MACHINE')) == '1' else ''}"
MACHINE_FEATURES:append:openstlinuxcommon = " ${@'openvx' if d.getVar('ACCEPT_EULA_'+d.getVar('MACHINE')) == '1' else ''}"
MACHINE_FEATURES:append:openstlinuxcommon = " ${@'opencl' if d.getVar('ACCEPT_EULA_'+d.getVar('MACHINE')) == '1' else ''}"
MACHINE_FEATURES:append:openstlinuxcommon = " ${@'vulkan' if d.getVar('ACCEPT_EULA_'+d.getVar('MACHINE')) == '1' else ''}"

# =========================================================================
# Kernel
# =========================================================================
# Define the devicetree overlays enabled by default (when 'phy-expansions' machine feature enabled)
DEFAULT_PHY_EXPANSIONS = "stm32mp2-phyflex-libra-rdk-lvds-ph128800t006-zhc01"

# =========================================================================
# Flashlayout
# =========================================================================
# Define the config labels to use to generate flashlayout file
BOOTDEVICE_LABELS += "emmc"
BOOTDEVICE_LABELS += "sdcard"

# ============================
# Supported M33 copro firmware
# ============================
M33FW_BOARDS ?= "stm32mp257f-phyflex"
# M33FW_FIRMWARE[config_m33fw_board] ?= "<project_path>,<project_name>"
M33FW_FIRMWARE[stm32mp257f-phyflex] ?= " \
    Projects/STM32MP257F-PHYFLEX/Applications/OpenAMP/OpenAMP_TTY_echo,OpenAMP_TTY_echo \
    Projects/STM32MP257F-PHYFLEX/Examples/GPIO/GPIO_EXTI,GPIO_EXTI \
"
# Default project to used
M33FW_DEFAULT_FIRMWARE[stm32mp257f-phyflex] ?= ""
# Define tf-m platform path
M33FW_TFM_PLATFORM[stm32mp257f-phyflex] ?= "stm/stm32mp257f_phyflex_fpsc_g_som"
# Define tf-m platform extra opts config
M33FW_TFM_OPTFLAGS[stm32mp257f-phyflex] ?= "-DTFM_PARTITION_PROTECTED_STORAGE=OFF"
```
