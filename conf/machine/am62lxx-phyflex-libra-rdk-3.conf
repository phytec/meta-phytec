## conf/machine/stm32mp25x-phyflex-libra-rdk-3-m33td.conf
```bitbake
#@TYPE: Machine
#@NAME: stm32mp25x-phyflex-libra-rdk-3-m33td
#@DESCRIPTION: phyFLEX-STM32MP25x Libra Rapid Development Kit - M33 Trusted Domain
#@BOOTSCHEME: M33 Trusted Domain boot from SD-Card or eMMC
#@ARTICLENUMBERS: PD-05036-001I, PD-05036-002I, PFL-G-04-SP001, PFL-G-04-SP002

# Define common PHYTEC board familly
MACHINEOVERRIDES =. "phyflex-fpsc-g:phyflex-libra-rdk:stm32mp2-phyflex-libra-rdk:"
# Define common SoC familly
MACHINEOVERRIDES =. "stm32mp2common:stm32mp25common:"
# Define common M33 Trusted Domain
MACHINEOVERRIDES =. "stm32mp2m33tdcommon:stm32mp2m33td:"

include conf/machine/include/phystm32mp.inc

# =========================================================================
# Chip architecture
# =========================================================================
DEFAULTTUNE = "cortexa35"
include conf/machine/include/arm/armv8a/tune-cortexa35.inc

# =========================================================================
# boot scheme
# =========================================================================
BOOTSCHEME_LABELS = "optee"

# =========================================================================
# Machine settings
# =========================================================================
# Kernel Device Tree
KERNEL_DEVICETREE = "st/stm32mp257f-phyflex-libra-rdk-m33td.dtb"

# =========================================================================
# Machine features
# =========================================================================
# Yocto standard machine features
MACHINE_FEATURES += "bluetooth"
MACHINE_FEATURES += "wifi"

# PHYTEC expansion board machine feature (Hardware add-ons)
MACHINE_FEATURES += "phy-expansions"

# OpenSTLinux machine features
MACHINE_FEATURES:append:openstlinuxcommon = " splashscreen"
MACHINE_FEATURES:append:openstlinuxcommon = " watchdog"
# Cortex M33
MACHINE_FEATURES:append = " m33td"
# Cortex M0
MACHINE_FEATURES:append:openstlinuxcommon = " m0copro"
#GPU
MACHINE_FEATURES:append:openstlinuxcommon = " ${@'gpu' if d.getVar('ACCEPT_EULA_'+d.getVar('MACHINE')) == '1' else ''}"
MACHINE_FEATURES:append:openstlinuxcommon = " ${@'openvx' if d.getVar('ACCEPT_EULA_'+d.getVar('MACHINE')) == '1' else ''}"
MACHINE_FEATURES:append:openstlinuxcommon = " ${@'opencl' if d.getVar('ACCEPT_EULA_'+d.getVar('MACHINE')) == '1' else ''}"
MACHINE_FEATURES:append:openstlinuxcommon = " ${@'vulkan' if d.getVar('ACCEPT_EULA_'+d.getVar('MACHINE')) == '1' else ''}"

# =========================================================================
# flashlayout
# =========================================================================
# Define the config labels to use to generate flashlayout file
BOOTDEVICE_LABELS += "emmc"
BOOTDEVICE_LABELS += "sdcard"

# =========================================================================
# Specific extra configuration for M33-TD
# =========================================================================
# BOOTLOADER_EXTERNAL_DT must be set to use DT suffix
BOOTLOADER_EXTERNAL_DT = "stm32mp257f-phyflex-fpsc-g-som-m33td"
# Configure external DT suffix to handle different DT files depending on boot device
EXTDT_USE_SUFFIX = "1"
EXTDT_SUFFIX_EMMC   = "-emmc"
EXTDT_SUFFIX_SDCARD = "-sdcard"

# For programming, use standard A35-TD TF-A and FIP device tree (U-boot + OP-TEE)
STM32MP_DT_FILES_PROGRAMMER = "stm32mp257f-phyflex-fpsc-g-som-m33td-serial-a35td"
STM32MP_DEVICETREE_PROGRAMMER_SUFFIX = "-serial-a35td"

# supported m33fw board:
M33FW_BOARDS += "stm32mp257f-phyflex"
# project name on m33tdprojects-starter-stm32mp2
# M33FW_FIRMWARE[config_m33fw_board] ?= "<project_path>,<project_name>
M33FW_FIRMWARE[stm32mp257f-phyflex] ?= "Projects/STM32MP257F-PHYFLEX/Demonstrations/StarterApp_M33TD/,StarterApp_M33TD"
# Default project to used
M33FW_DEFAULT_FIRMWARE[stm32mp257f-phyflex] ?= "StarterApp_M33TD"
# Define tf-m platform path
M33FW_TFM_PLATFORM[stm32mp257f-phyflex] ?= "stm/stm32mp257f_phyflex_fpsc_g_som"
# Define tf-m platform extra opts config
M33FW_TFM_OPTFLAGS[stm32mp257f-phyflex] ?= "-DTFM_PARTITION_PROTECTED_STORAGE=OFF"
```

## conf/machine/stm32mp25x-phyflex-libra-rdk-4-m33td.conf
```bitbake
#@TYPE: Machine
#@NAME: stm32mp25x-phyflex-libra-rdk-4-m33td
#@DESCRIPTION: phyFLEX-STM32MP25x Libra Rapid Development Kit (4Gib RAM/USB3 SS) - M33 Trusted Domain
#@BOOTSCHEME: M33 Trusted Domain boot from SD-Card or eMMC
#@ARTICLENUMBERS: PFL-G-04-SP002

# Define common PHYTEC board familly
MACHINEOVERRIDES =. "phyflex-fpsc-g:phyflex-libra-rdk:stm32mp2-phyflex-libra-rdk:"
# Define common SoC familly
MACHINEOVERRIDES =. "stm32mp2common:stm32mp25common:"
# Define common M33 Trusted Domain
MACHINEOVERRIDES =. "stm32mp2m33tdcommon:stm32mp2m33td:"

include conf/machine/include/phystm32mp.inc

# =========================================================================
# Chip architecture
# =========================================================================
DEFAULTTUNE = "cortexa35"
include conf/machine/include/arm/armv8a/tune-cortexa35.inc

# =========================================================================
# boot scheme
# =========================================================================
BOOTSCHEME_LABELS = "optee"

# =========================================================================
# Machine settings
# =========================================================================
# Kernel Device Tree
KERNEL_DEVICETREE = "st/stm32mp257f-phyflex-libra-rdk-m33td.dtb"
KERNEL_DEVICETREE += "${DT_OVERLAYS}"

# Bootloaders Device Tree (for MCUboot, TF-M, TF-A, OP-TEE and U-boot)
BOOTLOADER_DT = "stm32mp257f-phyflex-fpsc-g-som-4Gb-m33td"

# =========================================================================
# Machine features
# =========================================================================
# Yocto standard machine features
MACHINE_FEATURES += "bluetooth"
MACHINE_FEATURES += "wifi"

# PHYTEC expansion board machine feature (Hardware add-ons)
MACHINE_FEATURES += "phy-expansions"

# OpenSTLinux machine features
MACHINE_FEATURES:append:openstlinuxcommon = " splashscreen"
MACHINE_FEATURES:append:openstlinuxcommon = " watchdog"
# Cortex M33
MACHINE_FEATURES:append = " m33td"
# Cortex M0
MACHINE_FEATURES:append:openstlinuxcommon = " m0copro"
#GPU
MACHINE_FEATURES:append:openstlinuxcommon = " ${@'gpu' if d.getVar('ACCEPT_EULA_'+d.getVar('MACHINE')) == '1' else ''}"
MACHINE_FEATURES:append:openstlinuxcommon = " ${@'openvx' if d.getVar('ACCEPT_EULA_'+d.getVar('MACHINE')) == '1' else ''}"
MACHINE_FEATURES:append:openstlinuxcommon = " ${@'opencl' if d.getVar('ACCEPT_EULA_'+d.getVar('MACHINE')) == '1' else ''}"
MACHINE_FEATURES:append:openstlinuxcommon = " ${@'vulkan' if d.getVar('ACCEPT_EULA_'+d.getVar('MACHINE')) == '1' else ''}"

# =========================================================================
# Kernel
# =========================================================================
# Additional DT overlays to build and enable by default
PHY_EXPANSIONS_LIBRA += "st/overlays/stm32mp25-phyflex-libra-rdk-usb3ss.dtbo"
BOOTENV_OVERLAYS_APPEND += "conf-stm32mp25-phyflex-libra-rdk-usb3ss.dtbo"

# =========================================================================
# flashlayout
# =========================================================================
# Define the config labels to use to generate flashlayout file
BOOTDEVICE_LABELS += "emmc"
BOOTDEVICE_LABELS += "sdcard"

# =========================================================================
# Specific extra configuration for M33-TD
# =========================================================================
# BOOTLOADER_EXTERNAL_DT must be set to use DT suffix
BOOTLOADER_EXTERNAL_DT = "${BOOTLOADER_DT}"
# Configure external DT suffix to handle different DT files depending on boot device
EXTDT_USE_SUFFIX = "1"
EXTDT_SUFFIX_EMMC   = "-emmc"
EXTDT_SUFFIX_SDCARD = "-sdcard"

# For programming, use standard A35-TD TF-A and FIP device tree (U-boot + OP-TEE)
STM32MP_DT_FILES_PROGRAMMER = "stm32mp257f-phyflex-fpsc-g-som-4Gb-m33td-serial-a35td"
STM32MP_DEVICETREE_PROGRAMMER_SUFFIX = "-serial-a35td"

# supported m33fw board:
M33FW_BOARDS += "stm32mp257f-phyflex"
# project name on m33tdprojects-starter-stm32mp2
# M33FW_FIRMWARE[config_m33fw_board] ?= "<project_path>,<project_name>
M33FW_FIRMWARE[stm32mp257f-phyflex] ?= "Projects/STM32MP257F-PHYFLEX/Demonstrations/StarterApp_M33TD/,StarterApp_M33TD"
# Default project to used
M33FW_DEFAULT_FIRMWARE[stm32mp257f-phyflex] ?= "StarterApp_M33TD"
# Define tf-m platform path
M33FW_TFM_PLATFORM[stm32mp257f-phyflex] ?= "stm/stm32mp257f_phyflex_fpsc_g_som"
# Define tf-m platform extra opts config
M33FW_TFM_OPTFLAGS[stm32mp257f-phyflex] ?= "-DTFM_PARTITION_PROTECTED_STORAGE=OFF"
```
