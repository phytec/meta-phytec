## conf/machine/phyboard-mira-imx6-5.conf
```bitbake
#@TYPE: Machine
#@NAME: phyboard-mira-imx6-5
#@DESCRIPTION: PHYTEC phyBOARD-Mira full-featured i.MX6 Quad, 2GiB RAM, 8GiB eMMC
#@ARTICLENUMBERS: PBA-C-06-002.A2, PCM-058-40233C0I.A0

require conf/machine/include/phyimx6qdl.inc

SOC_FAMILY .= ":mx6q"
SOC_FAMILY .= ":phyboard-mira-imx6"

# Kernel
KERNEL_DEVICETREE = "imx6q-phytec-mira-ff-rdk-emmc.dtb"

# Barebox Config
BAREBOX_BASE_BIN = "barebox-phytec-phycore-imx6q-som-emmc-2gib"

MACHINE_FEATURES += "resistivetouch pci can wifi bluetooth emmc"

SERIAL_CONSOLES = "115200;ttymxc1"
```

## conf/machine/phyboard-mira-imx6-6.conf
```bitbake
#@TYPE: Machine
#@NAME: phyboard-mira-imx6-6
#@DESCRIPTION: PHYTEC phyBOARD-Mira low-cost i.MX6 Solo, 1GB RAM, 1GB NAND with PEB-WLBT-01(Wifi)
#@ARTICLENUMBERS: PCM-058-33000D0X.A0, PBA-C-06-001.A2

require conf/machine/include/phyimx6qdl.inc

SOC_FAMILY .= ":mx6dl-generic-bsp"
SOC_FAMILY .= ":phyboard-mira-imx6"

# Kernel
KERNEL_DEVICETREE = "nxp/imx/imx6dl-phytec-mira-lc-rdk-nand.dtb"

# Barebox Config
BAREBOX_BASE_BIN = "barebox-phytec-phycore-imx6dl-som-nand-1gib"

MACHINE_FEATURES += "wifi bluetooth nand"

SERIAL_CONSOLES = "115200;ttymxc1"
```

## conf/machine/phyboard-mira-imx6-7.conf
```bitbake
#@TYPE: Machine
#@NAME: phyboard-mira-imx6-7
#@DESCRIPTION: PHYTEC phyBOARD-Mira low-cost i.MX6 DualLite, 1GiB RAM, 4GiB eMMC
#@ARTICLENUMBERS: PBA-C-06-001.A2, PCM-058-30242C0X.A0

require conf/machine/include/phyimx6qdl.inc

SOC_FAMILY .= ":mx6dl"
SOC_FAMILY .= ":phyboard-mira-imx6"

# Kernel
KERNEL_DEVICETREE = "imx6dl-phytec-mira-lc-rdk-emmc.dtb"

# Barebox Config
BAREBOX_BASE_BIN = "barebox-phytec-phycore-imx6dl-som-lc-emmc-1gib"

MACHINE_FEATURES += "wifi bluetooth emmc"

SERIAL_CONSOLES = "115200;ttymxc1"
```

## conf/machine/phyboard-mira-imx6-8.conf
```bitbake
#@TYPE: Machine
#@NAME: phyboard-mira-imx6-8
#@DESCRIPTION: PHYTEC phyBOARD-Mira full-featured i.MX6 Quad, 1GiB RAM, eMMC
#@ARTICLENUMBERS: PBA-C-06-002.A2, PCM-058-302A3C0X.A0

require conf/machine/include/phyimx6qdl.inc

SOC_FAMILY .= ":mx6q"
SOC_FAMILY .= ":phyboard-mira-imx6"

# Kernel
KERNEL_DEVICETREE = "imx6q-phytec-mira-ff-rdk-emmc.dtb"

# Barebox Config
BAREBOX_BASE_BIN = "barebox-phytec-phycore-imx6q-som-emmc-1gib"

MACHINE_FEATURES += "resistivetouch pci can wifi bluetooth emmc"

SERIAL_CONSOLES = "115200;ttymxc1"
```

## conf/machine/phyboard-mira-imx6-9.conf
```bitbake
#@TYPE: Machine
#@NAME: phyboard-mira-imx6-9
#@DESCRIPTION: PHYTEC phyBOARD-Mira full-featured i.MX6 Quad Plus, 1GB RAM, NAND, SPI-NOR
#@ARTICLENUMBERS: PBA-C-06-002.A2, PCM-058-332B0C0I.A0

require conf/machine/include/phyimx6qdl.inc

SOC_FAMILY .= ":mx6q-generic-bsp"
SOC_FAMILY .= ":phyboard-mira-imx6"

# Kernel
KERNEL_DEVICETREE = "nxp/imx/imx6qp-phytec-mira-ff-rdk-nand.dtb"

# Barebox Config
BAREBOX_BASE_BIN = "barebox-phytec-phycore-imx6qp-som-nand-1gib"

MACHINE_FEATURES += "resistivetouch pci can wifi bluetooth nand"

SERIAL_CONSOLES = "115200;ttymxc1"
```

## conf/machine/phyboard-nash-imx93-1.conf
```bitbake
#@TYPE: Machine
#@NAME: phyboard-nash-imx93-1
#@DESCRIPTION: PHYTEC phyBOARD-Nash i.MX93, 2 GB RAM, eMMC
#@ARTICLENUMBERS: PB-04729-001, PCL-077-23231211I

MACHINEOVERRIDES =. "mx93:phyboard-nash:"

include conf/machine/include/imx-base.inc
include conf/machine/include/phyimx93.inc

MACHINE_FEATURES += "camera screen can alsa emmc tpm2 nxpiw612-sdio"
MACHINE_FEATURES:remove:use-mainline-bsp = " nxpiw612-sdio"

KERNEL_DEVICETREE = " \
    freescale/imx93-phyboard-nash.dtb \
    freescale/imx93-phyboard-nash-jtag.dtbo \
    freescale/imx93-phyboard-nash-peb-av-10.dtbo \
    freescale/imx93-phyboard-nash-peb-wlbt-07.dtbo \
    freescale/imx93-phyboard-nash-pwm-fan.dtbo \
    freescale/imx93-phyboard-nash-vm016.dtbo \
    freescale/imx93-phycore-npu.dtbo \
    freescale/imx93-phycore-rpmsg.dtbo \
"
KERNEL_DEVICETREE:use-mainline-bsp = " \
    freescale/imx93-phyboard-nash.dtb \
    freescale/imx93-phyboard-nash-peb-wlbt-07.dtbo \
    freescale/imx93-phycore-rpmsg.dtbo \
"

IMX_DEFAULT_BOOTLOADER = "u-boot-phytec-imx"

IMAGE_BOOTLOADER = "imx-boot"

UBOOT_CONFIG_BASENAME = "imx93-phycore"
UBOOT_DTB_NAME = "${KERNEL_DEVICETREE_BASENAME}.dtb"

LOADADDR = ""
UBOOT_SUFFIX = "bin"
UBOOT_MAKE_TARGET = ""

SPL_BINARY = "spl/u-boot-spl.bin"

UBOOT_CONFIG ??= "sd"
UBOOT_CONFIG[sd]   = "${UBOOT_CONFIG_BASENAME}_defconfig,sdcard"

# Set ATF platform name
ATF_PLATFORM = "imx93"

IMXBOOT_TARGETS = "flash_singleboot"

IMX_BOOT_SOC_TARGET = "iMX9"
IMX_BOOT_SEEK = "32"

# Set Serial console
SERIAL_CONSOLES = "115200;ttyLP0"

# Set DDR FIRMWARE
DDR_FIRMWARE_NAME = " \
    lpddr4_dmem_1d_v202201.bin \
    lpddr4_dmem_2d_v202201.bin \
    lpddr4_imem_1d_v202201.bin \
    lpddr4_imem_2d_v202201.bin \
"
```

## conf/machine/phyboard-nunki-imx6-1.conf
```bitbake
#@TYPE: Machine
#@NAME: phyboard-nunki-imx6-1
#@DESCRIPTION: PHYTEC phyBOARD-Nunki i.MX6 Quad, 1GB RAM, NAND
#@ARTICLENUMBERS: PB-02301-001.A0, PBA-C-11-001.A2, PCM-058-33230C0I.A3

require conf/machine/include/phyimx6qdl.inc

SOC_FAMILY .= ":mx6q-generic-bsp"
SOC_FAMILY .= ":phyboard-nunki-imx6"

# Kernel
KERNEL_DEVICETREE = "nxp/imx/imx6q-phytec-nunki-rdk-nand.dtb"

# Install devicetree overlays for second CSI interface
DT_OVERLAYS_INSTALL:append = " \
    imx6-cam-1-lvds.dtbo \
    imx6-vm009-1.dtbo \
    imx6-vm010-bw-1.dtbo \
    imx6-vm010-col-1.dtbo \
    imx6-vm011-bw-1.dtbo \
    imx6-vm011-col-1.dtbo \
    imx6-vm012-bw-1.dtbo \
    imx6-vm012-col-1.dtbo \
    imx6-vm016-1.dtbo \
    imx6-vm016-mipi-0.dtbo \
    imx6-vm050-1.dtbo \
"

# Barebox Config
BAREBOX_BASE_BIN = "barebox-phytec-phycore-imx6q-som-nand-1gib"

MACHINE_FEATURES += "resistivetouch pci can nand"

SERIAL_CONSOLES = "115200;ttymxc1"
```

## conf/machine/phyboard-polaris-imx8m-1.conf
```bitbake
#@TYPE: Machine
#@NAME: phyboard-polaris-imx8m-1
#@DESCRIPTION: PHYTEC phyBOARD-POLARIS i.MX8M Quad 1GB RAM, 4GB eMMC
#@ARTICLENUMBERS: PCL-066, PBA-CD-12

MACHINEOVERRIDES =. "mx8:mx8mq:"

require conf/machine/include/imx-base.inc
require conf/machine/include/arm/arch-arm64.inc

MACHINE_FEATURES += " pci wifi bluetooth"

MACHINE_SOCARCH_FILTER_append_mx8mq = "virtual/libopenvg virtual/libgles1 virtual/libgles2 virtual/egl virtual/mesa virtual/libgl virtual/libg2d"

KERNEL_DEVICETREE = "freescale/phytec-imx8mq-phyboard-polaris-rdk-emmc.dtb "

#IMAGE_M4LOADER = "imx-m4-demos"
#IMAGE_M4 = "imx8mq_m4_TCM_hello_world.bin imx8mq_m4_TCM_rpmsg_lite_pingpong_rtos_linux_remote.bin imx8mq_m4_TCM_rpmsg_lite_str_echo_rtos.bin"

UBOOT_CONFIG ??= "sd"
UBOOT_CONFIG[sd] = "pcl066_defconfig,sdcard"
UBOOT_CONFIG[mfgtool] = "pcl066_defconfig"
SPL_BINARY = "spl/u-boot-spl.bin"

# Set DDR FIRMWARE
DDR_FIRMWARE_NAME = "lpddr4_pmu_train_1d_imem.bin lpddr4_pmu_train_1d_dmem.bin lpddr4_pmu_train_2d_imem.bin lpddr4_pmu_train_2d_dmem.bin"

# Set u-boot DTB
UBOOT_DTB_NAME = "phytec-phycore-imx8mq.dtb"

# Set imx-mkimage boot target
IMXBOOT_TARGETS = "flash_evk_no_hdmi"

# Set Serial console
SERIAL_CONSOLE = "115200 ttymxc1"

IMAGE_BOOTLOADER = "imx-boot"

SDCARD_GENERATION_COMMAND = "generate_imx_sdcard"

DEFAULTTUNE_mx8 = "aarch64"

IMX_DEFAULT_KERNEL = "linux-imx"

BOOT_SPACE = "32768"

KERNEL_IMAGETYPE = "Image"
LOADADDR = ""
UBOOT_SUFFIX = "bin"
UBOOT_MAKE_TARGET = ""
IMX_BOOT_SEEK = "33"
```

## conf/machine/phyboard-polaris-imx8m-2.conf
```bitbake
#@TYPE: Machine
#@NAME: phyboard-polaris-imx8m-2
#@DESCRIPTION: PHYTEC phyBOARD-POLARIS i.MX8M Quad 1GB RAM, 4GB eMMC (deprecated)
#@ARTICLENUMBERS: PB-02419-010I.A1

MACHINEOVERRIDES =. "mx8:mx8m:mx8mq:"

include conf/machine/include/imx-base.inc
include conf/machine/include/phyimx8.inc
require conf/machine/include/arm/arch-arm64.inc

MACHINE_FEATURES += " emmc pci wifi bluetooth"

PREFERRED_RPROVIDER_linux-firmware-bcm43430 = "laird-sterling-etsi"

KERNEL_DEVICETREE = "freescale/imx8mq-phyboard-polaris-rdk-emmc-rev1.dtb freescale/imx8mq-phyboard-polaris-rdk-emmc-sterling-rev1.dtb"

# Set DDR FIRMWARE
DDR_FIRMWARE_NAME = "lpddr4_pmu_train_1d_imem.bin lpddr4_pmu_train_1d_dmem.bin lpddr4_pmu_train_2d_imem.bin lpddr4_pmu_train_2d_dmem.bin"

UBOOT_CONFIG ??= "sd"
UBOOT_CONFIG[sd] = "pcl066_defconfig,sdcard"
UBOOT_CONFIG[mfgtool] = "pcl066_defconfig"
SPL_BINARY = "spl/u-boot-spl.bin"

# Set u-boot DTB
UBOOT_DTB_NAME = "phytec-phycore-imx8mq.dtb"

# Set imx-mkimage boot target
IMXBOOT_TARGETS = "flash_evk"

# Set Serial console
SERIAL_CONSOLES = "115200;ttymxc0"

IMAGE_BOOTLOADER = "imx-boot"

DEFAULTTUNE_mx8 = "aarch64"

IMX_DEFAULT_KERNEL = "linux-imx"

KERNEL_IMAGETYPE = "Image"

LOADADDR = ""
UBOOT_SUFFIX = "bin"
UBOOT_MAKE_TARGET = ""
```

## conf/machine/phyboard-polaris-imx8m-3.conf
```bitbake
#@TYPE: Machine
#@NAME: phyboard-polaris-imx8m-3
#@DESCRIPTION: PHYTEC phyBOARD-POLARIS i.MX8M Quad 2GB RAM, 8GB eMMC, no 1.8v SD Card
#@ARTICLENUMBERS: PB-02419-100I.A0

MACHINEOVERRIDES =. "mx8mq:"

include conf/machine/include/imx-base.inc
include conf/machine/include/phyimx8m.inc

MACHINE_FEATURES += "alsa screen"

KERNEL_DEVICETREE = " \
	freescale/imx8mq-phyboard-polaris-rdk-emmc-no18vsdcard.dtb \
	freescale/imx8mq-phyboard-polaris-rdk-emmc-sterling.dtb \
"

# Set DDR FIRMWARE
DDR_FIRMWARE_NAME = " \
	lpddr4_pmu_train_1d_imem.bin \
	lpddr4_pmu_train_1d_dmem.bin \
	lpddr4_pmu_train_2d_imem.bin \
	lpddr4_pmu_train_2d_dmem.bin \
"

UBOOT_CONFIG ??= "sd"
UBOOT_CONFIG[sd] = "phycore-imx8mq_defconfig,sdcard"
SPL_BINARY = "spl/u-boot-spl.bin"

# Set u-boot DTB
UBOOT_DTB_NAME = "phycore-imx8mq.dtb"

# Set imx-mkimage boot target
IMXBOOT_TARGETS = "flash_evk"

# Set Serial console
SERIAL_CONSOLES = "115200;ttymxc0"

IMAGE_BOOTLOADER = "imx-boot"

KERNEL_IMAGETYPE = "Image"

UBOOT_SUFFIX = "bin"
UBOOT_MAKE_TARGET = ""
```

## conf/machine/phyboard-polis-imx8mm-1.conf
```bitbake
#@TYPE: Machine
#@NAME: phyboard-polis-imx8mm-1
#@DESCRIPTION: PHYTEC phyBOARD-POLIS i.MX8M Mini 2GB RAM, 16GB eMMC
#@ARTICLENUMBERS: PB-02820.A0

MACHINEOVERRIDES =. "mx8:mx8m:mx8mm:"

require conf/machine/include/imx-base.inc
require conf/machine/include/arm/arch-arm64.inc

MACHINE_FEATURES += " emmc pci wifi bluetooth can"

PREFERRED_PROVIDER_virtual/bootloader_mx8m = "u-boot-imx"

KERNEL_DEVICETREE = "freescale/phytec-imx8mm-phyboard-polis-rdk.dtb"

# Set DDR FIRMWARE
DDR_FIRMWARE_NAME = "lpddr4_pmu_train_1d_imem.bin lpddr4_pmu_train_1d_dmem.bin lpddr4_pmu_train_2d_imem.bin lpddr4_pmu_train_2d_dmem.bin"

UBOOT_CONFIG ??= "sd"
UBOOT_CONFIG[sd] = "phycore-imx8mm_defconfig,sdcard"
UBOOT_CONFIG[mfgtool] = "phycore-imx8mm_defconfig"
SPL_BINARY = "spl/u-boot-spl.bin"

# Set u-boot DTB
UBOOT_DTB_NAME = "phytec-phycore-imx8mm.dtb"

# Set imx-mkimage boot target
IMXBOOT_TARGETS = "flash_evk"

# Set Serial console
SERIAL_CONSOLES = "115200;ttymxc2"

IMAGE_BOOTLOADER = "imx-boot"

DEFAULTTUNE_mx8 = "aarch64"

IMX_DEFAULT_KERNEL = "linux-imx"

KERNEL_IMAGETYPE = "Image"

BOOT_SPACE = "32768"

LOADADDR = ""
UBOOT_SUFFIX = "bin"
UBOOT_MAKE_TARGET = ""

#WIC
IMAGE_CLASSES += "wic-helper"
IMAGE_CLASSES += "wic-imx8-helper"
IMAGE_BOOT_FILES = "Image ${@parse_dtbs(d)}"
WKS_FILES_mx8 ?= "imx8m-sdimage.wks.in"

# default images to build
IMAGE_FSTYPES_mx8 = "tar.gz wic"
```

## conf/machine/phyboard-polis-imx8mm-4.conf
```bitbake
#@TYPE: Machine
#@NAME: phyboard-polis-imx8mm-4
#@DESCRIPTION: PHYTEC phyBOARD-POLIS i.MX8M Mini 2GB RAM, 16GB eMMC, Audio
#@ARTICLENUMBERS: PB-02820.A2

MACHINEOVERRIDES =. "mx8:mx8m:mx8mm:"

require conf/machine/include/imx-base.inc
include conf/machine/include/phyimx8.inc
require conf/machine/include/tune-cortexa53.inc

MACHINE_FEATURES += "emmc pci wifi bluetooth can tpm2 alsa"

KERNEL_DEVICETREE = " \
	freescale/imx8mm-phyboard-polis-rdk.dtb \
	freescale/overlays/imx8mm-phyboard-polis-peb-eval-01.dtbo \
	freescale/overlays/imx8mm-phyboard-polis-peb-av-010.dtbo \
	freescale/overlays/imx8mm-phycore-rpmsg.dtbo \
	freescale/overlays/imx8mm-phycore-no-eth.dtbo \
	freescale/overlays/imx8mm-phycore-no-spiflash.dtbo \
	freescale/overlays/imx8mm-vm016.dtbo \
	freescale/overlays/imx8mm-vm016-fpdlink.dtbo \
	freescale/overlays/imx8mm-vm017.dtbo \
	freescale/overlays/imx8mm-vm017-fpdlink.dtbo \
	freescale/overlays/imx8mm-dual-vm017-fpdlink.dtbo \
"

# Set DDR FIRMWARE
DDR_FIRMWARE_NAME = " \
	lpddr4_pmu_train_1d_imem.bin \
	lpddr4_pmu_train_1d_dmem.bin \
	lpddr4_pmu_train_2d_imem.bin \
	lpddr4_pmu_train_2d_dmem.bin \
"

UBOOT_CONFIG ??= "fspi sd"
UBOOT_CONFIG[sd] = "phycore-imx8mm_defconfig,sdcard"
UBOOT_CONFIG[fspi] = "phycore-imx8mm_fspi_defconfig"
SPL_BINARY = "spl/u-boot-spl.bin"

# Set u-boot DTB
UBOOT_DTB_NAME = "phycore-imx8mm.dtb"

# Set imx-mkimage boot target
IMXBOOT_TARGETS = "flash_evk flash_evk_flexspi"

# Set Serial console
SERIAL_CONSOLES = "115200;ttymxc2"

IMAGE_BOOTLOADER = "imx-boot"

DEFAULTTUNE_mx8 = "aarch64"

IMX_DEFAULT_KERNEL = "linux-imx"

KERNEL_IMAGETYPE = "Image"

LOADADDR = ""
UBOOT_MAKE_TARGET = ""
```

## conf/machine/phyboard-polis-imx8mm-5.conf
```bitbake
#@TYPE: Machine
#@NAME: phyboard-polis-imx8mm-5
#@DESCRIPTION: PHYTEC phyBOARD-Polis i.MX8M Mini 1-4 GB RAM, Polis PL1532.2(a)/3/4
#@ARTICLENUMBERS: PB-02820-00I.A7

MACHINEOVERRIDES =. "mx8mm:"

require conf/machine/include/imx-base.inc
include conf/machine/include/phyimx8m.inc

MACHINE_FEATURES += "alsa camera can gpu screen tpm2"

KERNEL_DEVICETREE = " \
    freescale/imx8mm-phyboard-polis-rdk.dtb \
"
KERNEL_DEVICETREE:use-nxp-bsp = " \
    freescale/imx8mm-phyboard-polis-rdk.dtb \
    freescale/imx8mm-phyboard-polis-peb-av-10.dtbo \
    freescale/imx8mm-phyboard-polis-peb-eval-01.dtbo \
    freescale/imx8mm-phyboard-polis-vm016.dtbo \
    freescale/imx8mm-phyboard-polis-vm016-fpdlink-port0.dtbo \
    freescale/imx8mm-phyboard-polis-vm016-fpdlink-port1.dtbo \
    freescale/imx8mm-phyboard-polis-vm017.dtbo \
    freescale/imx8mm-phyboard-polis-vm017-fpdlink-port0.dtbo \
    freescale/imx8mm-phyboard-polis-vm017-fpdlink-port1.dtbo \
    freescale/imx8mm-phyboard-polis-vm020.dtbo \
    freescale/imx8mm-phyboard-polis-vm020-fpdlink-port0.dtbo \
    freescale/imx8mm-phyboard-polis-vm020-fpdlink-port1.dtbo \
    freescale/imx8mm-phycore-no-eth.dtbo \
    freescale/imx8mm-phycore-no-spiflash.dtbo \
    freescale/imx8mm-phycore-rpmsg.dtbo \
"

# Set DDR FIRMWARE
DDR_FIRMWARE_NAME = " \
    lpddr4_pmu_train_1d_imem.bin \
    lpddr4_pmu_train_1d_dmem.bin \
    lpddr4_pmu_train_2d_imem.bin \
    lpddr4_pmu_train_2d_dmem.bin \
"

UBOOT_CONFIG ??= "fspi sd"
UBOOT_CONFIG:use-mainline-bsp ??= "sd"
UBOOT_CONFIG[sd] = "phycore-imx8mm_defconfig,sdcard"
UBOOT_CONFIG[fspi] = "phycore-imx8mm_fspi_defconfig"
SPL_BINARY = "spl/u-boot-spl.bin"

# Set u-boot DTB
UBOOT_DTB_NAME = "imx8mm-phyboard-polis-rdk.dtb"

ATF_PLATFORM = "imx8mm"
ATF_LOAD_ADDR = "0x920000"

# Set imx-mkimage boot target
IMXBOOT_TARGETS = "flash_evk flash_evk_flexspi"

# Set Serial console
SERIAL_CONSOLES = "115200;ttymxc2"

IMAGE_BOOTLOADER = "imx-boot"

KERNEL_IMAGETYPE = "Image"

LOADADDR = ""

UBOOT_SUFFIX = "bin"
UBOOT_MAKE_TARGET = "all"
```
