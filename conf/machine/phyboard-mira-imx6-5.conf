## conf/machine/phyboard-polis-imx8mn-1.conf
```bitbake
#@TYPE: Machine
#@NAME: phyboard-polis-imx8mn-1
#@DESCRIPTION: PHYTEC phyBOARD-POLIS i.MX8M NANO SL 1GB RAM, 4GB eMMC, MIPI
#@ARTICLENUMBERS: PCL-069-0611010C

MACHINEOVERRIDES =. "mx8:mx8m:mx8mn:"

require conf/machine/include/imx-base.inc
include conf/machine/include/phyimx8.inc
require conf/machine/include/tune-cortexa53.inc

MACHINE_FEATURES += " emmc pci wifi bluetooth can tpm2"

KERNEL_DEVICETREE = " \
	freescale/imx8mn-phyboard-polis-dsi.dtb \
	freescale/overlays/imx8mn-phyboard-polis-peb-eval-01.dtbo \
	freescale/overlays/imx8mn-phyboard-polis-peb-av-010.dtbo \
	freescale/overlays/imx8mn-phycore-no-eth.dtbo \
	freescale/overlays/imx8mn-phycore-no-spiflash.dtbo \
"

# Set DDR FIRMWARE
DDR_FIRMWARE_NAME = " \
	lpddr4_pmu_train_1d_imem.bin \
	lpddr4_pmu_train_1d_dmem.bin \
	lpddr4_pmu_train_2d_imem.bin \
	lpddr4_pmu_train_2d_dmem.bin \
"

UBOOT_CONFIG ??= "sd"
UBOOT_CONFIG[sd] = "phycore-imx8mn_defconfig,sdcard"
SPL_BINARY = "spl/u-boot-spl.bin"

# Set u-boot DTB
UBOOT_DTB_NAME = "phycore-imx8mn.dtb"

# Set imx-mkimage boot target
IMXBOOT_TARGETS = "flash_evk"

# Set Serial console
SERIAL_CONSOLES = "115200;ttymxc2"

IMAGE_BOOTLOADER = "imx-boot"

DEFAULTTUNE_mx8 = "aarch64"

IMX_DEFAULT_KERNEL = "linux-imx"

KERNEL_IMAGETYPE = "Image"

LOADADDR = ""
UBOOT_MAKE_TARGET = ""
```

## conf/machine/phyboard-polis-imx8mn-2.conf
```bitbake
#@TYPE: Machine
#@NAME: phyboard-polis-imx8mn-2
#@DESCRIPTION: PHYTEC phyBOARD-Polis i.MX8M NANO SL 1GB RAM, MIPI, Polis PL1532.2(a)/PL1532.3
#@ARTICLENUMBERS: PB-02820-11C.A4

MACHINEOVERRIDES =. "mx8mn:"

require conf/machine/include/imx-base.inc
include conf/machine/include/phyimx8m.inc

MACHINE_FEATURES += "can tpm2"

KERNEL_DEVICETREE = " \
    freescale/imx8mn-phyboard-polis.dtb \
    freescale/overlays/imx8mn-phyboard-polis-peb-eval-01.dtbo \
    freescale/overlays/imx8mn-phycore-no-eth.dtbo \
    freescale/overlays/imx8mn-phycore-no-spiflash.dtbo \
"

# Set DDR FIRMWARE
DDR_FIRMWARE_NAME = " \
    lpddr4_pmu_train_1d_imem.bin \
    lpddr4_pmu_train_1d_dmem.bin \
    lpddr4_pmu_train_2d_imem.bin \
    lpddr4_pmu_train_2d_dmem.bin \
"

UBOOT_CONFIG ??= "sd"
UBOOT_CONFIG[sd] = "phycore-imx8mn_defconfig,sdcard"
SPL_BINARY = "spl/u-boot-spl.bin"

# Set u-boot DTB
UBOOT_DTB_NAME = "imx8mn-phyboard-polis.dtb"

ATF_PLATFORM = "imx8mn"
ATF_LOAD_ADDR = "0x960000"

# Set imx-mkimage boot target
IMXBOOT_TARGETS = "flash_evk"

# Set Serial console
SERIAL_CONSOLES = "115200;ttymxc2"

IMAGE_BOOTLOADER = "imx-boot"

KERNEL_IMAGETYPE = "Image"

UBOOT_MAKE_TARGET = ""
```

## conf/machine/phyboard-pollux-imx8mp-1.conf
```bitbake
#@TYPE: Machine
#@NAME: phyboard-pollux-imx8mp-1
#@DESCRIPTION: PHYTEC phyBOARD-POLLUX i.MX8M Plus Alpha
#@ARTICLENUMBERS: KPB-03123-Alpha.A0

MACHINEOVERRIDES =. "imx-boot-container:mx8:mx8m:mx8mp:"

require conf/machine/include/imx-base.inc
include conf/machine/include/phyimx8.inc
require conf/machine/include/tune-cortexa53.inc

IMAGE_CLASSES_remove = "wic-imx8-helper"

MACHINE_FEATURES += " emmc pci can"

KERNEL_DEVICETREE = "freescale/imx8mp-phyboard-pollux-rdk-rev0.dtb"

# Set DDR FIRMWARE
DDR_FIRMWARE_VERSION = "202006"
DDR_FIRMWARE_NAME = " \
	lpddr4_pmu_train_1d_dmem_${DDR_FIRMWARE_VERSION}.bin \
	lpddr4_pmu_train_1d_imem_${DDR_FIRMWARE_VERSION}.bin \
	lpddr4_pmu_train_2d_dmem_${DDR_FIRMWARE_VERSION}.bin \
	lpddr4_pmu_train_2d_imem_${DDR_FIRMWARE_VERSION}.bin \
"

UBOOT_CONFIG ??= "sd"
UBOOT_CONFIG[sd] ?= "phycore-imx8mp_rev0_defconfig,sdcard"
SPL_BINARY = "spl/u-boot-spl.bin"

# Set u-boot DTB
UBOOT_DTB_NAME ?= "phycore-imx8mp_rev0.dtb"

# Set ATF platform name and load address
ATF_PLATFORM = "imx8mp"
ATF_LOAD_ADDR = "0x970000"

IMX_EXTRA_FIRMWARE = "firmware-imx-8m"

# Set imx-mkimage boot target
IMXBOOT_TARGETS = "flash_evk"
IMX_BOOT_SOC_TARGET = "iMX8MP"

# Set Serial console
SERIAL_CONSOLES = "115200;ttymxc1"

DEFAULTTUNE_mx8 = "aarch64"

IMX_DEFAULT_KERNEL = "linux-imx"

KERNEL_IMAGETYPE = "Image"

LOADADDR = ""
UBOOT_SUFFIX = "bin"
UBOOT_MAKE_TARGET = "all"
IMX_BOOT_SEEK = "32"

IMAGE_BOOT_FILES_secureboot = "Image-signed oftree"
```

## conf/machine/phyboard-pollux-imx8mp-2.conf
```bitbake
#@TYPE: Machine
#@NAME: phyboard-pollux-imx8mp-2
#@DESCRIPTION: PHYTEC phyBOARD-Pollux i.MX8M Plus 1-4GB RAM, Pollux PL1552.1
#@ARTICLENUMBERS: PB-03123-001.A0, PCM-070-0F3243I.A1, PCM-070-0F5443I.A0

MACHINEOVERRIDES =. "imx-boot-container:mx8:mx8m:mx8mp:"

require conf/machine/include/imx-base.inc
include conf/machine/include/phyimx8.inc
require conf/machine/include/tune-cortexa53.inc

MACHINE_FEATURES += " emmc pci can wifi bluetooth"

KERNEL_DEVICETREE = " \
        freescale/imx8mp-phyboard-pollux-rdk.dtb \
        freescale/overlays/imx8mp-phyboard-pollux-peb-av-010.dtbo \
        freescale/overlays/imx8mp-phyboard-pollux-peb-av-012.dtbo \
        freescale/overlays/imx8mp-phyboard-pollux-peb-wlbt-05.dtbo \
        freescale/overlays/imx8mp-phyboard-pollux-1552.1.dtbo \
        freescale/overlays/imx8mp-phycore-no-eth.dtbo \
        freescale/overlays/imx8mp-phycore-no-rtc.dtbo \
        freescale/overlays/imx8mp-phycore-no-spiflash.dtbo \
        freescale/overlays/imx8mp-phycore-rpmsg.dtbo \
        freescale/overlays/imx8mp-vm016-csi1.dtbo \
        freescale/overlays/imx8mp-vm016-csi1-fpdlink.dtbo \
        freescale/overlays/imx8mp-vm016-csi2.dtbo \
        freescale/overlays/imx8mp-vm016-csi2-fpdlink.dtbo \
        freescale/overlays/imx8mp-vm017-csi1.dtbo \
        freescale/overlays/imx8mp-vm017-csi1-fpdlink.dtbo \
        freescale/overlays/imx8mp-vm017-csi2.dtbo \
        freescale/overlays/imx8mp-vm017-csi2-fpdlink.dtbo \
        freescale/overlays/imx8mp-isp-csi1.dtbo \
        freescale/overlays/imx8mp-isp-csi2.dtbo \
        freescale/overlays/imx8mp-isi-csi1.dtbo \
        freescale/overlays/imx8mp-isi-csi2.dtbo \
"

# Set DDR FIRMWARE
DDR_FIRMWARE_NAME = " \
	lpddr4_pmu_train_1d_dmem_202006.bin \
	lpddr4_pmu_train_1d_imem_202006.bin \
	lpddr4_pmu_train_2d_dmem_202006.bin \
	lpddr4_pmu_train_2d_imem_202006.bin \
"

UBOOT_CONFIG ??= "sd fspi"
UBOOT_CONFIG[sd] = "phycore-imx8mp_defconfig,sdcard"
UBOOT_CONFIG[fspi] = "phycore-imx8mp_defconfig"
SPL_BINARY = "spl/u-boot-spl.bin"

# Set u-boot DTB
UBOOT_DTB_NAME = "imx8mp-phyboard-pollux-rdk.dtb"

# Set ATF platform name and load address
ATF_PLATFORM = "imx8mp"
ATF_LOAD_ADDR = "0x970000"

IMX_EXTRA_FIRMWARE = "firmware-imx-8m"

# Set imx-mkimage boot target
IMXBOOT_TARGETS = "flash_evk flash_evk_flexspi"
IMX_BOOT_SOC_TARGET = "iMX8MP"

# Set Serial console
SERIAL_CONSOLES = "115200;ttymxc0"

IMAGE_BOOTLOADER = "imx-boot"

DEFAULTTUNE_mx8 = "aarch64"

IMX_DEFAULT_KERNEL = "linux-imx"

KERNEL_IMAGETYPE = "Image"

LOADADDR = ""

UBOOT_SUFFIX = "bin"
UBOOT_MAKE_TARGET = "all"
```

## conf/machine/phyboard-pollux-imx8mp-3.conf
```bitbake
#@TYPE: Machine
#@NAME: phyboard-pollux-imx8mp-3
#@DESCRIPTION: PHYTEC phyBOARD-Pollux i.MX8M Plus 1-4GB RAM, Pollux PL1552.2
#@ARTICLENUMBERS: PB-03123-001.A3

MACHINEOVERRIDES =. "mx8mp:"

require conf/machine/include/imx-base.inc
include conf/machine/include/phyimx8m.inc

MACHINE_FEATURES += "alsa can fan gpu screen"
MACHINE_FEATURES:append:use-nxp-bsp = " camera tpm2"

KERNEL_DEVICETREE = " \
        freescale/imx8mp-phyboard-pollux-rdk.dtb \
        freescale/imx8mp-phycore-no-eth.dtbo \
"
KERNEL_DEVICETREE:use-mainline-bsp = "freescale/imx8mp-phyboard-pollux-rdk.dtb"

# Set DDR FIRMWARE
DDR_FIRMWARE_NAME = " \
	lpddr4_pmu_train_1d_dmem_202006.bin \
	lpddr4_pmu_train_1d_imem_202006.bin \
	lpddr4_pmu_train_2d_dmem_202006.bin \
	lpddr4_pmu_train_2d_imem_202006.bin \
"
DT_COMPAT = "phytec,imx8mp-phyboard-pollux-rdk"
BRCM4343_FW_NAME = "brcmfmac43430-sdio.${DT_COMPAT}.bin"

UBOOT_CONFIG:use-nxp-bsp ??= "sd fspi"
UBOOT_CONFIG:use-mainline-bsp ??= "sd"
UBOOT_CONFIG[sd] = "phycore-imx8mp_defconfig,sdcard"
UBOOT_CONFIG[fspi] = "phycore-imx8mp_defconfig"
SPL_BINARY = "spl/u-boot-spl.bin"

# Set u-boot DTB
UBOOT_DTB_NAME = "imx8mp-phyboard-pollux-rdk.dtb"
# fdt_addr_r
UBOOT_DTB_LOADADDRESS = "0x48000000"
# fdtoverlay_addr_r
UBOOT_DTBO_LOADADDRESS = "0x49000000"
# kernel_addr_r
UBOOT_ENTRYPOINT:mx8m-generic-bsp = "${UBOOT_LOADADDRESS}"
UBOOT_LOADADDRESS = "0x5A080000"

ATF_PLATFORM = "imx8mp"
ATF_LOAD_ADDR = "0x970000"
ATF_BL32_BASE = "0x7e000000"

OPTEEMACHINE = "imx-mx8mp_phyboard_pollux"

# Set imx-mkimage boot target
IMXBOOT_TARGETS = "flash_evk flash_evk_flexspi"

# Set Serial console
SERIAL_CONSOLES = "115200;ttymxc0"

IMAGE_BOOTLOADER = "imx-boot"

KERNEL_IMAGETYPE = "Image"

UBOOT_SUFFIX = "bin"
UBOOT_MAKE_TARGET = "all"
```

## conf/machine/phyboard-regor-am335x-1.conf
```bitbake
#@TYPE: Machine
#@NAME: phyboard-regor-am335x-1
#@DESCRIPTION: PHYTEC phyBOARD-REGOR AM335x 512MB RAM, 512MB NAND, 8MB SPI flash
#@ARTICLENUMBERS: PB-01802-001.A5

require conf/machine/include/phyam335x.inc

SOC_FAMILY .= ":phyboard-regor-am335x"

MACHINE_FEATURES += "nand"

# Kernel
KERNEL_DEVICETREE = "ti/omap/am335x-regor-rdk.dtb"

# Barebox Config
BAREBOX_BIN = "images/barebox-am33xx-phytec-phycore.img"
BAREBOX_IPL_BIN = "images/barebox-am33xx-phytec-phycore-mlo-512mb.img"
```

## conf/machine/phyboard-regor-r2-am335x-1.conf
```bitbake
#@TYPE: Machine
#@NAME: phyboard-regor-r2-am335x-1
#@DESCRIPTION: PHYTEC phyBOARD-REGOR AM335x 512MiB RAM, 512MiB NAND, 8MiB SPI flash
#@ARTICLENUMBERS: PB-01814-001.A2
#@SUPPORTEDIMAGE: phytec-headless-image

require conf/machine/include/phyam335x.inc

SOC_FAMILY .= ":phyboard-regor-am335x"

# Kernel
KERNEL_DEVICETREE = "am335x-regor-rdk.dtb"

# Barebox Config
BAREBOX_BIN = "images/barebox-am33xx-phytec-phycore.img"
BAREBOX_IPL_BIN = "images/barebox-am33xx-phytec-phycore-r2-mlo.img"
```

## conf/machine/phyboard-rigel-am67xx-1-k3r5.conf
```bitbake
#@TYPE: Machine
#@NAME: phyboard-rigel-am67xx-1-k3r5
#@DESCRIPTION: PHYTEC phyBOARD Rigel AM67x, HS-FS (R5F)
#@ARTICLENUMBERS: PCM-080.A0

require conf/machine/include/phyk3r5.inc

MACHINEOVERRIDES =. "k3r5-am67xx:phyboard-rigel:"

SPL_BINARY = "tiboot3-am67x-hs-fs-phycore-som.bin"

UBOOT_MACHINE = ""
UBOOT_CONFIG = "ethboot usbdfu sd"
UBOOT_CONFIG[sd] = "phycore_am67x_r5_defconfig,sdcard"
UBOOT_CONFIG[usbdfu] = "phycore_am67x_r5_usbdfu_defconfig"
UBOOT_CONFIG[ethboot] = "phycore_am67x_r5_ethboot_defconfig"
```

## conf/machine/phyboard-rigel-am67xx-1.conf
```bitbake
#@TYPE: Machine
#@NAME: phyboard-rigel-am67xx-1
#@DESCRIPTION: PHYTEC phyBOARD Rigel AM67x, HS-FS
#@ARTICLENUMBERS: PCM-080.A0

require conf/machine/include/phyam67xx.inc

MACHINEOVERRIDES =. ":phyboard-rigel:"

MACHINE_FEATURES += "can emmc gpu screen wifi bluetooth pci"

KERNEL_DEVICETREE = " \
    ti/k3-am6754-phyboard-rigel.dtb \
    ${KERNEL_OVERLAYS} \
"

UBOOT_MACHINE = "phycore_am67x_a53_defconfig"
```

## conf/machine/phyboard-segin-imx6ul-1.conf
```bitbake
#@TYPE: Machine
#@NAME: phyboard-segin-imx6ul-1
#@DESCRIPTION: i.MX6 UltraLite, 512MB RAM, NAND
#@ARTICLENUMBERS: PB-02013-001.A0, PB-02013-110I.A0, PCL-063-23300CI.A0
#@SUPPORTEDIMAGE:
#from http://www.phytec.de

require conf/machine/include/phyimx6ul.inc

SOC_FAMILY .= ":mx6ul"
SOC_FAMILY .= ":phyboard-segin-imx6ul"

# Kernel
KERNEL_DEVICETREE = "imx6ul-phytec-phyboard-segin-ff-rdk.dtb"

# Barebox Config
BAREBOX_BIN = "images/barebox-phytec-phycore-imx6ul-512mb.img"

MACHINE_FEATURES += "resistivetouch can alsa"
```

## conf/machine/phyboard-segin-imx6ul-2.conf
```bitbake
#@TYPE: Machine
#@NAME: phyboard-segin-imx6ul-2
#@DESCRIPTION: PHYTEC phyBOARD-Segin i.MX6 UltraLite, 512MB RAM, NAND
#@ARTICLENUMBERS: PB-02013-001.A2, PB-02013-110I.A2, PCL-063-23300CI.A2

require conf/machine/include/phyimx6ul.inc

SOC_FAMILY .= ":phyboard-segin:phyboard-segin-imx6ul"

# Kernel
KERNEL_DEVICETREE = "nxp/imx/imx6ul-phytec-segin-ff-rdk-nand.dtb"

# Barebox Config
BAREBOX_BASE_BIN = "barebox-phytec-phycore-imx6ul-nand-512mb"

MACHINE_FEATURES += "resistivetouch can alsa wifi bluetooth caam nand"
```

## conf/machine/phyboard-segin-imx6ul-3.conf
```bitbake
#@TYPE: Machine
#@NAME: phyboard-segin-imx6ul-3
#@DESCRIPTION: PHYTEC phyBOARD-Segin i.MX6 ULL, 256MB RAM, 128 NAND
#@ARTICLENUMBERS: PB-02013-002.A2, PB-02013-001C.A2, PCL-063-11600CC.A2

require conf/machine/include/phyimx6ul.inc

SOC_FAMILY .= ":phyboard-segin:phyboard-segin-imx6ul"

# Kernel
KERNEL_DEVICETREE = "nxp/imx/imx6ull-phytec-segin-lc-rdk-nand.dtb"

# Barebox Config
BAREBOX_BASE_BIN = "barebox-phytec-phycore-imx6ull-lc-nand-256mb"

MACHINE_FEATURES += "resistivetouch can alsa nand"
```
