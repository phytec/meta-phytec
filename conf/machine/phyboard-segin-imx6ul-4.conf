## conf/machine/phyboard-zeta-imx7d-1.conf
```bitbake
#@TYPE: Machine
#@NAME: phyboard-zeta-imx7d-1
#@DESCRIPTION: PHYTEC phyBOARD-Zeta i.MX7 Dual, 1GB RAM, eMMC
#@ARTICLENUMBERS: PB-01910-004.A0

MACHINEOVERRIDES =. "mx7:mx7d:"

require conf/machine/include/imx-base.inc
require conf/machine/include/phyimx7.inc
include conf/machine/include/arm/armv7a/tune-cortexa7.inc

MACHINE_FEATURES += "can emmc pci resistivetouch"

# Module is part of the kernel defconfig
MACHINE_FEATURES:remove = "nxp8987"

KERNEL_DEVICETREE = " \
	imx7d-phyboard-zeta-kit.dtb \
	imx7d-phyboard-zeta-kit-m4.dtb \
	imx7d-phyboard-zeta-kit-mipi.dtb \
	imx7d-pcm-061-1110110c.dtb \
	imx7d-pcm-061-2111101e.dtb \
	imx7d-pcm-061-2111111e.dtb \
	imx7d-pcm-061-2211101e.dtb \
	imx7d-pcm-061-2211111e.dtb \
	imx7s-pcm-061-0502100e.dtb \
"

UBOOT_CONFIG ??= "sd"
UBOOT_CONFIG[mt41k128m16] = "phycore-imx7d_mt41k128m16_config"
UBOOT_CONFIG[mt41k64m16] = "phycore-imx7s_mt41k64m16_config"
UBOOT_CONFIG[mt41k64m16_nand] = "phycore-imx7s_mt41k64m16_nand_config,ubifs"
UBOOT_CONFIG[sd] = "phycore-imx7_spl_defconfig,sdcard"

UBOOT_BINARY = "u-boot-with-spl.imx"
UBOOT_MAKE_TARGET:remove = "u-boot.imx"

# Set Serial console
SERIAL_CONSOLES = "115200;ttymxc0"

IMX_DEFAULT_KERNEL = "linux-imx"
```

## conf/machine/phycard-imx6-1.conf
```bitbake
#@TYPE: Machine
#@NAME: phycard-imx6-1
#@DESCRIPTION: PHYTEC phyCARD-i.MX6 Quad, PBA-A-03, 1GiB RAM two banks
#@ARTICLENUMBERS: PCA-A-XL3-233BCC.A2
#@SUPPORTEDIMAGE: phytec-qt5demo-image/yogurt

require conf/machine/include/phyimx6qdl.inc

SOC_FAMILY .= ":mx6q"
SOC_FAMILY .= ":phycard-imx6"

# Kernel
KERNEL_DEVICETREE = "imx6q-phytec-phycard-imx6-rdk.dtb"

# Barebox Config
BAREBOX_BIN = "images/barebox-phytec-pbaa03-1gib.img"

# resistivetouch, the rdk has one attached
MACHINE_FEATURES += "resistivetouch alsa"

SERIAL_CONSOLES = "115200;ttymxc2"
```

## conf/machine/phycard-imx6-2.conf
```bitbake
#@TYPE: Machine
#@NAME: phycard-imx6-2
#@DESCRIPTION: PHYTEC phyCARD-i.MX6 Quad 1GB RAM one bank, 1GB NAND
#@ARTICLENUMBERS: PCA-A-XL3-KSP02.A4-A6

require conf/machine/include/phyimx6qdl.inc

SOC_FAMILY .= ":mx6q-generic-bsp"
SOC_FAMILY .= ":phycard-imx6"

MACHINE_FEATURES += "nand"

# Kernel
KERNEL_DEVICETREE = "nxp/imx/imx6q-phytec-phycard.dtb"

# Barebox Config
BAREBOX_BIN = "images/barebox-phytec-phycard-imx6q-1gib-1bank.img"

SERIAL_CONSOLES = "115200;ttymxc2"
```

## conf/machine/phycore-am335x-1.conf
```bitbake
#@TYPE: Machine
#@NAME: phycore-am335x-1
#@DESCRIPTION: PHYTEC phyCORE-AM335x 512MB RAM, 512MB NAND flash, 8MB SPI flash, PCM-953 (Kit)
#@ARTICLENUMBERS: KPCM-051-SYS-LINUX, PCM-051-12102F0C.A3

require conf/machine/include/phyam335x.inc

SOC_FAMILY .= ":phycore-am335x"

# Kernel
KERNEL_DEVICETREE = "ti/omap/am335x-phycore-rdk.dtb"

# Barebox 
BAREBOX_BIN = "images/barebox-am33xx-phytec-phycore.img"
BAREBOX_IPL_BIN = "images/barebox-am33xx-phytec-phycore-mlo-512mb.img"

# resistivetouch, the rdk has one attached
MACHINE_FEATURES += "resistivetouch gpu nand"

DT_OVERLAYS_INSTALL = " \
    am33xx-gpu.dtbo \
    am335x-pcm953-lcd.dtbo \
"
```

## conf/machine/phycore-am335x-2.conf
```bitbake
#@TYPE: Machine
#@NAME: phycore-am335x-2
#@DESCRIPTION:  PHYTEC phyCORE-AM335x 1GB RAM, 1GB NAND flash, 8MB SPI flash, PCM-953
#@ARTICLENUMBERS: PCM-051-23102F0I.A1, PCM-051-22151F0C.A1

require conf/machine/include/phyam335x.inc

SOC_FAMILY .= ":phycore-am335x"

# Kernel
KERNEL_DEVICETREE = "ti/omap/am335x-phycore-rdk.dtb"

# Barebox
BAREBOX_BIN = "images/barebox-am33xx-phytec-phycore.img"
BAREBOX_IPL_BIN = "images/barebox-am33xx-phytec-phycore-mlo-2x512mb.img"

# resistivetouch, the rdk has one attached
MACHINE_FEATURES += "resistivetouch gpu nand"

DT_OVERLAYS_INSTALL = " \
    am33xx-gpu.dtbo \
    am335x-pcm953-lcd.dtbo \
"
```

## conf/machine/phycore-am335x-2012-01.conf
```bitbake
#@TYPE: Machine
#@NAME: phyam335x-flex-13-01, deprecated name: pfla03
#@DESCRIPTION: Machine configuration for the Module PFL-A-03 with baseboard PBA-B-01 1364.4
#from http://www.phytec.de 

require conf/machine/include/am335x.inc

PREFERRED_VERSION_linux-phytec = "3.12%"
KERNEL_DEVICETREE = "am335x-phycore-kit.dtb"
IMAGE_FSTYPES += "tar.gz"
#ubifs
# install the kernel modules to rootfs
MACHINE_EXTRA_RRECOMMENDS += "kernel-modules"

###################
# Barebox Config
###################
# use barebox instead of uboot
PACKAGE_INSTALL_append = " barebox-dev"
# AM335x pre bootloader needs to be configured
BAREBOX_BIN = "images/barebox-am33xx-phytec-phycore.img"
BAREBOX_IPL_BIN = "images/barebox-am33xx-phytec-phycore-mlo.img"
# this line will be overwritten and can be deleted if you supply an environment directory
# to <yocto>/meta-phytec/meta-am335x/recipes-bsp/barebox/env/<machine>/environment
BAREBOX_DEFAULT_ENV = "arch/arm/boards/phytec-core-am335x/defaultenv-phycore-am335x"
```

## conf/machine/phycore-am335x-3.conf
```bitbake
#@TYPE: Machine
#@NAME: phycore-am335x-3
#@DESCRIPTION: PHYTEC phyCORE-AM335x 256MB RAM, 256MB/512MB NAND flash, PCM-953
#@ARTICLENUMBERS: PCM-051-01041E0I.A2

require conf/machine/include/phyam335x.inc

SOC_FAMILY .= ":phycore-am335x"

# Kernel
KERNEL_DEVICETREE = "ti/omap/am335x-phycore-rdk.dtb"

# Barebox
BAREBOX_BIN = "images/barebox-am33xx-phytec-phycore-no-spi.img"
BAREBOX_IPL_BIN = "images/barebox-am33xx-phytec-phycore-mlo-256mb.img"

# resistivetouch, the rdk has one attached
MACHINE_FEATURES += "resistivetouch gpu nand"

DT_OVERLAYS_INSTALL = " \
    am33xx-gpu.dtbo \
    am335x-no-rtc.dtbo \
    am335x-no-spi-nor.dtbo \
    am335x-pcm953-lcd.dtbo \
"
```

## conf/machine/phycore-am335x-4.conf
```bitbake
#@TYPE: Machine
#@NAME: phycore-am335x-4
#@DESCRIPTION:  PHYTEC phyCORE-AM335x 256MB RAM, 128MB NAND flash, PCM-953
#@ARTICLENUMBERS: PCM-051-0005160C.A2, PCM-051-0005160I.A2

require conf/machine/include/phyam335x.inc

SOC_FAMILY .= ":phycore-am335x"

# Kernel
KERNEL_DEVICETREE = "ti/omap/am335x-phycore-rdk.dtb"

# Barebox
BAREBOX_BIN = "images/barebox-am33xx-phytec-phycore-no-spi-no-eeprom.img"
BAREBOX_IPL_BIN = "images/barebox-am33xx-phytec-phycore-mlo-256mb.img"

# resistivetouch, the rdk has one attached
MACHINE_FEATURES += "resistivetouch nand"

DT_OVERLAYS_INSTALL = " \
    am335x-no-eeprom.dtbo \
    am335x-no-rtc.dtbo \
    am335x-no-spi-nor.dtbo \
    am335x-pcm953-lcd.dtbo \
"
```
