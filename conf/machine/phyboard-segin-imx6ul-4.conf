## conf/machine/phyboard-segin-imx6ul-4.conf
```bitbake
#@TYPE: Machine
#@NAME: phyboard-segin-imx6ul-4
#@DESCRIPTION: PHYTEC phyBOARD-Segin i.MX6 UltraLite, 512MB RAM, NAND with RS485
#@ARTICLENUMBERS: PB-02013-XXX.AX, PB-02013-XXXX.AX, PCL-063-23300CI.A2

require conf/machine/include/phyimx6ul.inc

SOC_FAMILY .= ":phyboard-segin:phyboard-segin-imx6ul"

# Kernel
KERNEL_DEVICETREE = "nxp/imx/imx6ul-phytec-segin-ff-rdk-nand-rs485.dtb"

# Barebox Config
BAREBOX_BASE_BIN = "barebox-phytec-phycore-imx6ul-nand-512mb"

MACHINE_FEATURES += "resistivetouch can alsa wifi bluetooth caam nand"
```

## conf/machine/phyboard-segin-imx6ul-5.conf
```bitbake
#@TYPE: Machine
#@NAME: phyboard-segin-imx6ul-5
#@DESCRIPTION: PHYTEC phyBOARD-Segin i.MX6 UltraLite, 512MB RAM, NAND with Wireless LAN
#@ARTICLENUMBERS: PB-02013-003.A0, PB-02013-110I.A2, PCL-063-23300CI.A2
#@SUPPORTEDIMAGE:

require conf/machine/include/phyimx6ul.inc

SOC_FAMILY .= ":mx6ul"
SOC_FAMILY .= ":phyboard-segin-imx6ul"

# Kernel
KERNEL_DEVICETREE = "imx6ul-phytec-phyboard-segin-ff-rdk.dtb"

# Barebox Config
BAREBOX_BIN = "images/barebox-phytec-phycore-imx6ul-512mb.img"

MACHINE_FEATURES += "resistivetouch can alsa wifi"
```

## conf/machine/phyboard-segin-imx6ul-6.conf
```bitbake
#@TYPE: Machine
#@NAME: phyboard-segin-imx6ul-6
#@DESCRIPTION: PHYTEC phyBOARD-Segin i.MX6 ULL, 512MB RAM, NAND
#@ARTICLENUMBERS: PB-02013-001.A5, PB-02013-310I.A0, PCL-063-23900CI.A0

require conf/machine/include/phyimx6ul.inc

SOC_FAMILY .= ":phyboard-segin:phyboard-segin-imx6ul"

# Kernel
KERNEL_DEVICETREE = "nxp/imx/imx6ull-phytec-segin-ff-rdk-nand.dtb"

# Barebox Config
BAREBOX_BASE_BIN = "barebox-phytec-phycore-imx6ull-nand-512mb"

MACHINE_FEATURES += "resistivetouch can alsa wifi bluetooth optee nand"

OPTEEMACHINE = "imx-mx6ullevk"
```

## conf/machine/phyboard-segin-imx6ul-7.conf
```bitbake
#@TYPE: Machine
#@NAME: phyboard-segin-imx6ul-7
#@DESCRIPTION: PHYTEC phyBOARD-Segin i.MX6 ULL, 512MB RAM, eMMC
#@ARTICLENUMBERS: PB-02013-410I.A0, PCL-063-20910CI.A0

require conf/machine/include/phyimx6ul.inc

SOC_FAMILY .= ":phyboard-segin-imx6ul"

# Kernel
KERNEL_DEVICETREE = "imx6ull-phytec-segin-ff-rdk-emmc.dtb"

# Barebox Config
BAREBOX_BASE_BIN = "barebox-phytec-phycore-imx6ull-emmc-512mb"

MACHINE_FEATURES += "resistivetouch can alsa wifi emmc"
```

## conf/machine/phyboard-segin-imx6ul-8.conf
```bitbake
#@TYPE: Machine
#@NAME: phyboard-segin-imx6ul-8
#@DESCRIPTION: PHYTEC phyBOARD-Segin i.MX6 UltraLite, 512 MB RAM, eMMC
#@ARTICLENUMBERS: PB-02013-510I.A0, PCL-063-20420CI.A0

require conf/machine/include/phyimx6ul.inc

SOC_FAMILY .= ":phyboard-segin:phyboard-segin-imx6ul"

# Kernel
KERNEL_DEVICETREE = "nxp/imx/imx6ul-phytec-segin-ff-rdk-emmc.dtb"

# Barebox Config
BAREBOX_BASE_BIN = "barebox-phytec-phycore-imx6ul-emmc-512mb"

MACHINE_FEATURES += "resistivetouch can alsa emmc caam optee"

OPTEEMACHINE = "imx-mx6ulevk"
```

## conf/machine/phyboard-segin-imx91-1.conf
```bitbake
#@TYPE: Machine
#@NAME: phyboard-segin-imx91-1
#@DESCRIPTION: PHYTEC phyBOARD-Segin i.MX91, 1 GB RAM, eMMC, silicon revision A0
#@ARTICLENUMBERS: PB-02029-210I, PCL-077-43020010I

MACHINEOVERRIDES =. "mx91:phyboard-segin:phyboard-segin-imx91:"

include conf/machine/include/imx-base.inc
include conf/machine/include/phyimx91.inc

MACHINE_FEATURES += "screen resistivetouch can alsa emmc"

KERNEL_DEVICETREE = " \
    freescale/imx91-phyboard-segin.dtb \
    freescale/imx91-phyboard-segin-peb-av-02.dtbo \
    freescale/imx91-phyboard-segin-peb-eval-01.dtbo \
    freescale/imx91-phyboard-segin-peb-wlbt-05.dtbo \
"

IMX_DEFAULT_BOOTLOADER = "u-boot-phytec-imx"

IMAGE_BOOTLOADER = "imx-boot"

UBOOT_CONFIG_BASENAME = "imx91-phycore"
UBOOT_DTB_NAME = "${KERNEL_DEVICETREE_BASENAME}.dtb"

LOADADDR = ""
UBOOT_SUFFIX = "bin"
UBOOT_MAKE_TARGET = ""

SPL_BINARY = "spl/u-boot-spl.bin"

UBOOT_CONFIG ??= "sd"
UBOOT_CONFIG[sd]   = "${UBOOT_CONFIG_BASENAME}_defconfig,sdcard"

# Set ATF platform name
ATF_PLATFORM = "imx91"

IMXBOOT_TARGETS = "flash_singleboot"

IMX_BOOT_SOC_TARGET = "iMX91"
IMX_BOOT_SEEK = "32"

# Set Serial console
SERIAL_CONSOLES = "115200;ttyLP0"

# Set DDR FIRMWARE
DDR_FIRMWARE_NAME = " \
    lpddr4_dmem_1d_v202201.bin \
    lpddr4_dmem_2d_v202201.bin \
    lpddr4_imem_1d_v202201.bin \
    lpddr4_imem_2d_v202201.bin \
"
```

## conf/machine/phyboard-segin-imx93-1.conf
```bitbake
#@TYPE: Machine
#@NAME: phyboard-segin-imx93-1
#@DESCRIPTION: PHYTEC phyBOARD-Segin i.MX93, 1 GB RAM, eMMC
#@ARTICLENUMBERS: PB-02029-010I, PCL-077-11231010I

MACHINEOVERRIDES =. "mx93:phyboard-segin:phyboard-segin-imx93:"

include conf/machine/include/imx-base.inc
include conf/machine/include/phyimx93.inc

MACHINE_FEATURES += "screen resistivetouch can alsa emmc"

KERNEL_DEVICETREE = " \
    freescale/imx93-phyboard-segin-rdk.dtb \
    freescale/imx93-peb-av-02.dtb \
"

IMX_DEFAULT_BOOTLOADER = "u-boot-imx"
IMX_DEFAULT_KERNEL = "linux-imx"


IMAGE_BOOTLOADER = "imx-boot"

UBOOT_CONFIG_BASENAME = "phycore-imx93"
UBOOT_DTB_NAME = "${KERNEL_DEVICETREE_BASENAME}.dtb"

LOADADDR = ""
UBOOT_SUFFIX = "bin"
UBOOT_MAKE_TARGET = ""

SPL_BINARY = "spl/u-boot-spl.bin"

UBOOT_CONFIG ??= "sd"
UBOOT_CONFIG[sd]   = "${UBOOT_CONFIG_BASENAME}_defconfig,sdcard"

# Set ATF platform name
ATF_PLATFORM = "imx93"

IMXBOOT_TARGETS = "flash_singleboot"

IMX_BOOT_SOC_TARGET = "iMX9"
IMX_BOOT_SEEK = "32"

# Set Serial console
SERIAL_CONSOLES = "115200;ttyLP0"

# Set DDR FIRMWARE
DDR_FIRMWARE_NAME = " \
    lpddr4_dmem_1d_v202201.bin \
    lpddr4_dmem_2d_v202201.bin \
    lpddr4_imem_1d_v202201.bin \
    lpddr4_imem_2d_v202201.bin \
"

SECO_FIRMWARE_NAME:mx93-generic-bsp = "mx93a0-ahab-container.img"
```

## conf/machine/phyboard-segin-imx93-2.conf
```bitbake
#@TYPE: Machine
#@NAME: phyboard-segin-imx93-2
#@DESCRIPTION: PHYTEC phyBOARD-Segin i.MX93, 1 GB RAM, eMMC, silicon revision A1
#@ARTICLENUMBERS: PB-02029-001, PCL-077-11231010I

MACHINEOVERRIDES =. "mx93:phyboard-segin:phyboard-segin-imx93:"

include conf/machine/include/imx-base.inc
include conf/machine/include/phyimx93.inc

MACHINE_FEATURES += "screen resistivetouch can alsa emmc"

KERNEL_DEVICETREE = " \
    freescale/imx93-phyboard-segin.dtb \
    freescale/imx93-phyboard-segin-peb-av-02.dtbo \
    freescale/imx93-phyboard-segin-peb-eval-01.dtbo \
    freescale/imx93-phyboard-segin-peb-wlbt-05.dtbo \
    freescale/imx93-phycore-npu.dtbo \
    freescale/imx93-phycore-rpmsg.dtbo \
"
KERNEL_DEVICETREE:use-mainline-bsp = " \
    freescale/imx93-phyboard-segin.dtb \
    freescale/imx93-phyboard-segin-peb-eval-01.dtbo \
    freescale/imx93-phyboard-segin-peb-wlbt-05.dtbo \
    freescale/imx93-phycore-rpmsg.dtbo \
"

IMX_DEFAULT_BOOTLOADER = "u-boot-phytec-imx"

IMAGE_BOOTLOADER = "imx-boot"

UBOOT_CONFIG_BASENAME = "imx93-phycore"
UBOOT_DTB_NAME = "${KERNEL_DEVICETREE_BASENAME}.dtb"

UBOOT_SUFFIX = "bin"
UBOOT_MAKE_TARGET = ""

SPL_BINARY = "spl/u-boot-spl.bin"

UBOOT_CONFIG ??= "sd"
UBOOT_CONFIG[sd]   = "${UBOOT_CONFIG_BASENAME}_defconfig,sdcard"

# Set ATF platform name
ATF_PLATFORM = "imx93"
# Used for interoperability with vendor BSP
TFA_INSTALL_SUFFIX = "-${ATF_PLATFORM}"

IMXBOOT_TARGETS = "flash_singleboot"

IMX_BOOT_SOC_TARGET = "iMX9"
IMX_BOOT_SEEK = "32"

# Set Serial console
SERIAL_CONSOLES = "115200;ttyLP0"

# Set DDR FIRMWARE
DDR_FIRMWARE_NAME = " \
    lpddr4_dmem_1d_v202201.bin \
    lpddr4_dmem_2d_v202201.bin \
    lpddr4_imem_1d_v202201.bin \
    lpddr4_imem_2d_v202201.bin \
"
```

## conf/machine/phyboard-segin-stm32mp13x-2.conf
```bitbake
#@TYPE: Machine
#@NAME: phyboard-segin-stm32mp13x-2
#@DESCRIPTION: phyBOARD-Segin full featured STM32MP135F @650Mhz/@1Ghz, 512MB RAM, 4GB eMMC, 4kB EEPROM
#@BOOTSCHEME: SD-Card, eMMC - only OP-TEE boot support
#@ARTICLENUMBERS: PB-02030-001.A0, PB-02030-110I.A0, PCL-076-5141111I.A0

include conf/machine/include/phystm32mp.inc

MACHINEOVERRIDES .= ":stm32mp1common:stm32mp13common:phycore-stm32mp13"

# =========================================================================
# Chip architecture
# =========================================================================
DEFAULTTUNE = "cortexa7thf-neon-vfpv4"
include conf/machine/include/arm/armv7a/tune-cortexa7.inc

# =========================================================================
# boot scheme
# =========================================================================
BOOTSCHEME_LABELS += "optee"

# =========================================================================
# Machine settings
# =========================================================================
# Kernel Device Tree
KERNEL_DEVICETREE = "st/stm32mp135f-phyboard-segin-ff-rdk-emmc-512mb.dtb"

# Bootloaders Device Tree (same DTS name for TF-A, U-Boot and OP-TEE)
BOOTLOADER_DT = "stm32mp135f-phycore-som-emmc-512mb"

# =========================================================================
# Machine features
# =========================================================================
MACHINE_FEATURES += "hdmi"
MACHINE_FEATURES += "phy-expansions"
# Splashscreen enabled
MACHINE_FEATURES:append:openstlinuxcommon = " splashscreen"

# =========================================================================
# Kernel
# =========================================================================
# Kernel config
# Set this address to 0xC2000040, which is 0xC2000000 + 0x40.
# 0xC2000000 is the memory address where U-Boot will copy from flash the file uImage and 0x40 is uImage header size (64Bytes).
# With this value, U-Boot will be able to execute in place the zImage contained in uImage.
ST_KERNEL_LOADADDR   = "0xC2000040"

# Define the devicetree overlays enabled by default
DEFAULT_PHY_EXPANSIONS = "stm32mp135x-phyboard-segin-peb-av-02-lcd"
DEFAULT_PHY_EXPANSIONS += "stm32mp13xx-phyboard-segin-peb-eval-01-leds-buttons"

# =========================================================================
# flashlayout
# =========================================================================
# Define the config labels to use to generate flashlayout file
BOOTDEVICE_LABELS += "emmc"
BOOTDEVICE_LABELS += "sdcard"

# =========================================================================
# HDMI EDID firmware configuration
# =========================================================================
# EDID firmware. This variable can be used to force specific HDMI screen resolution.
#HDMI_EDID_KERNEL_ARGS = "drm_kms_helper.edid_firmware=HDMI-A-1:edid/1280x720.bin"
```

## conf/machine/phyboard-subra-imx6-1.conf
```bitbake
#@TYPE: Machine
#@NAME: phyboard-subra-imx6-1
#@DESCRIPTION:
#@ARTICLENUMBERS: PB-00601-001.A0, PBA-B-05-OEM03.A2, PFL-A-02-0200541.A0
#@SUPPORTEDIMAGE: phytec-qt5demo-image
#from http://www.phytec.de

require conf/machine/include/phyimx6qdl.inc

SOC_FAMILY .= ":mx6dl"
SOC_FAMILY .= ":phyboard-subra-imx6"

# Kernel
KERNEL_DEVICETREE = "imx6dl-phytec-phyboard-subra.dtb imx6dl-phytec-phyboard-subra-wifi.dtb"

# Barebox Config
BAREBOX_BIN = "images/barebox-phytec-phyboard-subra-512mb-1bank.img"

MACHINE_FEATURES += "can wifi"
```

## conf/machine/phyboard-subra-imx6-2.conf
```bitbake
#@TYPE: Machine
#@NAME: phyboard-subra-imx6-2
#@DESCRIPTION: PHYTEC phyBOARD-Subra i.MX6 1GiB RAM, 1GiB NAND
#@ARTICLENUMBERS: PB-00601-003.A0, PBA-B-05-OEM02.A2, PFL-A-02-13237E0.A0

require conf/machine/include/phyimx6qdl.inc

SOC_FAMILY .= ":mx6q"
SOC_FAMILY .= ":phyboard-subra-imx6"

# Kernel
KERNEL_DEVICETREE = "imx6q-phytec-phyboard-subra.dtb imx6q-phytec-phyboard-subra-wifi.dtb"

# Barebox Config
BAREBOX_BIN = "images/barebox-phytec-phyboard-subra-1gib-1bank.img"

MACHINE_FEATURES += "can wifi"
```

## conf/machine/phyboard-wega-1.conf
```bitbake
#@TYPE: Machine
#@NAME: phyBOARD-Wega

require conf/machine/include/phyam335x.inc

# Kernel
PREFERRED_VERSION_linux-ti = "3.12%"
KERNEL_DEVICETREE = "am335x-wega-rdk.dtb"
MACHINE_EXTRA_RRECOMMENDS += "kernel-modules"

# Barebox Config
BAREBOX_BIN = "images/barebox-am33xx-phytec-phycore-no-spi.img"
BAREBOX_IPL_BIN = "images/barebox-am33xx-phytec-phycore-mlo-256mb.img"
BAREBOX_DEFAULT_ENV = ""
```

## conf/machine/phyboard-wega-am335x-1.conf
```bitbake
#@TYPE: Machine
#@NAME: phyboard-wega-am335x-1
#@DESCRIPTION: PHYTEC phyBOARD-WEGA AM335x 256MB RAM, 128MB NAND flash, PEB-AV-01
#@ARTICLENUMBERS: PB-00802-0101C.A1, PB-00802-0200C.A2

require conf/machine/include/phyam335x.inc

SOC_FAMILY .= ":phyboard-wega-am335x"

# Kernel
KERNEL_DEVICETREE = "ti/omap/am335x-wega-rdk.dtb"

# Barebox Config
BAREBOX_BIN = "images/barebox-am33xx-phytec-phycore-no-spi.img"
BAREBOX_IPL_BIN = "images/barebox-am33xx-phytec-phycore-mlo-256mb.img"

MACHINE_FEATURES += "wifi gpu nand"

DT_OVERLAYS_INSTALL = " \
    am33xx-gpu.dtbo \
    am335x-wega-peb-av-01.dtbo \
"
```

## conf/machine/phyboard-wega-am335x-2.conf
```bitbake
#@TYPE: Machine
#@NAME: phyboard-wega-am335x-2
#@DESCRIPTION: PHYTEC phyBOARD-WEGA AM335x 256MB RAM, 128MB NAND flash, PEB-AV-02
#@ARTICLENUMBERS: PB-00802-008.A1, PB-00802-010.A0

require conf/machine/include/phyam335x.inc

SOC_FAMILY .= ":phyboard-wega-am335x"

# Kernel
KERNEL_DEVICETREE = "ti/omap/am335x-wega-rdk.dtb"

# Barebox Config
BAREBOX_BIN = "images/barebox-am33xx-phytec-phycore-no-spi.img"
BAREBOX_IPL_BIN = "images/barebox-am33xx-phytec-phycore-mlo-256mb.img"

MACHINE_FEATURES += "resistivetouch wifi gpu nand"

DT_OVERLAYS_INSTALL = " \
    am33xx-gpu.dtbo \
    am335x-wega-peb-av-02.dtbo \
"
```

## conf/machine/phyboard-wega-am335x-3.conf
```bitbake
#@TYPE: Machine
#@NAME: phyboard-wega-am335x-3
#@DESCRIPTION: PHYTEC phyBOARD-WEGA AM335x 512MB RAM, 512MB NAND flash, 8MB SPI flash, PEB-AV-01
#@ARTICLENUMBERS: PB-00802-310I.A2

require conf/machine/include/phyam335x.inc

SOC_FAMILY .= ":phyboard-wega-am335x"

# Kernel
KERNEL_DEVICETREE = "ti/omap/am335x-wega-rdk.dtb"

# Barebox Config
BAREBOX_BIN = "images/barebox-am33xx-phytec-phycore.img"
BAREBOX_IPL_BIN = "images/barebox-am33xx-phytec-phycore-mlo-512mb.img"

# resistivetouch, the board may have one attached
MACHINE_FEATURES += "resistivetouch wifi gpu nand"

DT_OVERLAYS_INSTALL = " \
    am33xx-gpu.dtbo \
    am335x-spi-nor.dtbo \
    am335x-wega-peb-av-01.dtbo \
"
```

## conf/machine/phyboard-wega-am335x-4.conf
```bitbake
#@TYPE: Machine
#@NAME: phyboard-wega-am335x-4
#@DESCRIPTION: PHYTEC phyBOARD-WEGA AM335x 512MiB RAM, 512MiB NAND flash
#@ARTICLENUMBERS: PB-00802-410C.A0
#@SUPPORTEDIMAGE: phytec-headless-image, phytec-qt5demo-image

require conf/machine/include/phyam335x.inc

SOC_FAMILY .= ":phyboard-wega-am335x"

# Kernel
KERNEL_DEVICETREE = "am335x-wega-eeprom-rtc.dtb"

# Barebox Config
BAREBOX_BIN = "images/barebox-am33xx-phytec-phycore-no-spi.img"
BAREBOX_IPL_BIN = "images/barebox-am33xx-phytec-phycore-mlo-512mb.img"

# resistivetouch, the board may have one attached
MACHINE_FEATURES += "resistivetouch wifi sgx"
```

## conf/machine/phyboard-wega-r2-am335x-1.conf
```bitbake
#@TYPE: Machine
#@NAME: phyboard-wega-r2-am335x-1
#@DESCRIPTION: PHYTEC phyBOARD-WEGA R2 AM335x 256MB RAM, 256MB NAND flash, PEB-AV-01
#@ARTICLENUMBERS: PB-00814-001.A0, PB-00814-002.A0

require conf/machine/include/phyam335x.inc

SOC_FAMILY .= ":phycore-am335x"

# Kernel
KERNEL_DEVICETREE = "ti/omap/am335x-wega-rdk.dtb"

# Barebox
BAREBOX_BIN = "images/barebox-am33xx-phytec-phycore-no-spi.img"
BAREBOX_IPL_BIN = "images/barebox-am33xx-phytec-phycore-r2-mlo.img"

MACHINE_FEATURES += "wifi gpu nand"

DT_OVERLAYS_INSTALL = " \
    am33xx-gpu.dtbo \
    am335x-wega-peb-av-01.dtbo \
"
```
