## conf/machine/phycore-stm32mp1-1.conf
```bitbake
#@TYPE: Machine
#@NAME: phycore-stm32mp1-1
#@DESCRIPTION: PHYTEC phyCORE-STM32MP1 ALPHA1-Kit - stm32mp157aac @650Mhz MPU (old rev), 3D GPU, 1GB RAM, 8GB eMMC
#@BOOTSCHEME: SD-Card and NOR-eMMC (Basic and Trusted boot support)
#@ARTICLENUMBERS: PCM-068-1534-0, PCM-939-1517.1

require conf/machine/include/phytec-machine-extlinux-config-phycore-stm32mp1-1.inc
include conf/machine/include/phytec-machine-common-stm32mp.inc

MACHINEOVERRIDES .= ":phycore"

EULA_FILE_ST:stm32mpcommon = "${PHYCORE_STM32MP_BASE}/conf/eula/${MACHINE}"
EULA_FILE_ST_MD5SUM:stm32mpcommon = "8b505090fb679839cefbcc784afe8ce9"

# =========================================================================
# Chip architecture
# =========================================================================
DEFAULTTUNE = "cortexa7thf-neon-vfpv4"
include conf/machine/include/arm/armv7a/tune-cortexa7.inc

# =========================================================================
# boot scheme
# =========================================================================
BOOTSCHEME_LABELS += "basic"
BOOTSCHEME_LABELS += "trusted"
#BOOTSCHEME_LABELS += "optee"


#PREFERRED_VERSION_u-boot-stm32mp = "2018.11"

# =========================================================================
# Machine settings
# =========================================================================
STM32MP_DT_FILES_PHYCORE += "phycore-stm32mp1-1"

# =========================================================================
# Machine features
# =========================================================================
#MACHINE_FEATURES += "bluetooth"
#MACHINE_FEATURES += "wifi"
MACHINE_FEATURES += "${@'gpu' if d.getVar('ACCEPT_EULA_'+d.getVar('MACHINE')) == '1' else ''}"
# Splashscreen enabled
MACHINE_FEATURES += "splashscreen"

# =========================================================================
# Kernel
# =========================================================================
# Kernel config
# Set this address to 0xC2000040, which is 0xC2000000 + 0x40.
# 0xC2000000 is the memory address where U-Boot will copy from flash the file uImage and 0x40 is uImage header size (64Bytes).
# With this value, U-Boot will be able to execute in place the zImage contained in uImage.
ST_KERNEL_LOADADDR   = "0xC2000040"

# For eval board: auto-load goodix module (touchscreen module)
#KERNEL_MODULE_AUTOLOAD = "goodix"

# Define the devicetree for Linux A7 examples
LINUX_A7_EXAMPLES_DT += "phycore-stm32mp1-1-a7-examples"


#PREFERRED_VERSION_linux-stm32mp = "4.19"

# =========================================================================
# flashlayout
# =========================================================================
# Define the config labels to use to generate flashlayout file
FLASHLAYOUT_CONFIG_LABELS += "nor-emmc"
FLASHLAYOUT_CONFIG_LABELS += "sdcard"

# =========================================================================
# M4 copro
# =========================================================================
# Define the devicetree for M4 example
CUBE_M4_EXAMPLES_DT += "phycore-stm32mp1-1-m4-examples"

# Define specific board reference to use
M4_BOARDS = "STM32MP157C-PHY"

# =========================================================================
# extlinux configuration
# =========================================================================
# As example, modify the default boot config for each target to M4 config
#UBOOT_EXTLINUX_DEFAULT_LABEL_mp1-1_sdcard       = "phycore-stm32mp1-1-m4-examples-sdcard"
#UBOOT_EXTLINUX_DEFAULT_LABEL_mp1-1_sdcard-optee = "phycore-stm32mp1-1-m4-examples-sdcard-optee"

# =========================================================================
# WIC for sdcard raw image
# =========================================================================
WIC_CREATE_EXTRA_ARGS = "--no-fstab-update"
WKS_FILE_DEPENDS ?= " \
    u-boot-stm32mp \
    tf-a-stm32mp \
    ${@bb.utils.contains('BOOTSCHEME_LABELS', 'optee', 'optee-os-stm32mp', '', d)} \
    st-image-bootfs \
    st-image-vendorfs \
    st-image-userfs \
"
# for generated a WIC file, please uncomment the 7 following lines
#IMAGE_FSTYPES += "wic"
#WKS_FILE_openstlinux-tiny += "${@bb.utils.contains('BOOTSCHEME_LABELS', 'optee', \
#                                'sdcard-tiny-phycore-stm32mp1-1-optee-1GB.wks', 'sdcard-tiny-phycore-stm32mp1-1-trusted-1GB.wks', d)}"
#WKS_FILE_openstlinux-eglfs += "${@bb.utils.contains('BOOTSCHEME_LABELS', 'optee', \
#				'sdcard-eglfs-phycore-stm32mp1-1-optee-1GB.wks', 'sdcard-eglfs-phycore-stm32mp1-1-trusted-1GB.wks', d)}"
#WKS_FILE_openstlinux-weston += "${@bb.utils.contains('BOOTSCHEME_LABELS', 'optee', \
#				'sdcard-weston-phycore-stm32mp1-1-optee-1GB.wks', 'sdcard-weston-phycore-stm32mp1-1-trusted-1GB.wks', d)"
```

## conf/machine/phycore-stm32mp1-3.conf
```bitbake
#@TYPE: Machine
#@NAME: phycore-stm32mp1-3
#@DESCRIPTION: Configuration for phyCORE-STM32MP1-3 Sargas Dev Board, full-featured stm32mp157cac @650Mhz MPU, 3D GPU, 1GiB RAM, 8GiB eMMC, 16MB QSPI NOR
#@BOOTSCHEME: SD-Card, eMMC and NOR flash Basic and Trusted boot support
#@ARTICLENUMBERS: PCM-068-025113I.A0/PCM-068-1534-1/PCM-939-1517-2


require conf/machine/include/phytec-machine-extlinux-config-phycore-stm32mp1-3.inc
include conf/machine/include/phytec-machine-common-stm32mp.inc

MACHINEOVERRIDES .= ":phycore"

EULA_FILE_ST_stm32mpcommon = "${PHYCORE_STM32MP_BASE}/conf/eula/${MACHINE}"
EULA_FILE_ST_MD5SUM_stm32mpcommon = "8b505090fb679839cefbcc784afe8ce9"

# =========================================================================
# Chip architecture
# =========================================================================
DEFAULTTUNE = "cortexa7thf-neon-vfpv4"
include conf/machine/include/tune-cortexa7.inc

# =========================================================================
# boot scheme
# =========================================================================
BOOTSCHEME_LABELS += "basic"
BOOTSCHEME_LABELS += "trusted"
#BOOTSCHEME_LABELS += "optee"


#PREFERRED_VERSION_u-boot-stm32mp = "2018.11"

# =========================================================================
# Machine settings
# =========================================================================
STM32MP_DT_FILES_PHYCORE += "phycore-stm32mp1-3"

# =========================================================================
# Machine features
# =========================================================================
MACHINE_FEATURES += "bluetooth"
MACHINE_FEATURES += "wifi"
MACHINE_FEATURES += "hdmi"
MACHINE_FEATURES += "${@'gpu' if d.getVar('ACCEPT_EULA_'+d.getVar('MACHINE')) == '1' else ''}"
# Splashscreen enabled
MACHINE_FEATURES += "splashscreen"

# =========================================================================
# QT parameters
# =========================================================================
QT_QPA_PLATFORM = "eglfs"

# =========================================================================
# Image
# =========================================================================
# Add ubi FSTYPES to default ones for nand volumes
#IMAGE_FSTYPES += "stmultiubi"

# =========================================================================
# Kernel
# =========================================================================
# Kernel config
# Set this address to 0xC2000040, which is 0xC2000000 + 0x40.
# 0xC2000000 is the memory address where U-Boot will copy from flash the file uImage and 0x40 is uImage header size (64Bytes).
# With this value, U-Boot will be able to execute in place the zImage contained in uImage.
ST_KERNEL_LOADADDR   = "0xC2000040"

# For eval board: auto-load goodix module (touchscreen module)
#KERNEL_MODULE_AUTOLOAD = "goodix"

# Define the devicetree for Linux A7 examples
LINUX_A7_EXAMPLES_DT += "phycore-stm32mp1-3-a7-examples"


#PREFERRED_VERSION_linux-stm32mp = "4.19"

# =========================================================================
# flashlayout
# =========================================================================
# Define the config labels to use to generate flashlayout file
FLASHLAYOUT_CONFIG_LABELS += "emmc"
FLASHLAYOUT_CONFIG_LABELS += "nor-emmc"
FLASHLAYOUT_CONFIG_LABELS += "sdcard"

# =========================================================================
# M4 copro
# =========================================================================
# Define the devicetree for M4 example
CUBE_M4_EXAMPLES_DT += "phycore-stm32mp1-3-m4-examples"

# Define specific board reference to use
M4_BOARDS = "STM32MP157C-PHY"

# =========================================================================
# extlinux configuration
# =========================================================================
# As example, modify the default boot config for each target to M4 config
#UBOOT_EXTLINUX_DEFAULT_LABEL_mp1-3_sdcard       = "phycore-stm32mp1-3-m4-examples-sdcard"
#UBOOT_EXTLINUX_DEFAULT_LABEL_mp1-3_sdcard-optee = "phycore-stm32mp1-3-m4-examples-sdcard-optee"

# EDID firmware
HDMI_EDID_KERNEL_ARGS = "drm_kms_helper.edid_firmware=HDMI-A-1:edid/1280x720.bin"

# =========================================================================
# WIC for sdcard raw image
# =========================================================================
WIC_CREATE_EXTRA_ARGS = "--no-fstab-update"
WKS_FILE_DEPENDS ?= " \
    u-boot-stm32mp \
    tf-a-stm32mp \
    ${@bb.utils.contains('BOOTSCHEME_LABELS', 'optee', 'optee-os-stm32mp', '', d)} \
    st-image-bootfs \
    st-image-vendorfs \
    st-image-userfs \
"
# for generated a WIC file, please uncomment the 7 following lines
#IMAGE_FSTYPES += "wic"
#WKS_FILE_openstlinux-tiny += "${@bb.utils.contains('BOOTSCHEME_LABELS', 'optee', \
#                                'sdcard-tiny-phycore-stm32mp1-3-optee-1GB.wks', 'sdcard-tiny-phycore-stm32mp1-3-trusted-1GB.wks', d)}"
#WKS_FILE_openstlinux-eglfs += "${@bb.utils.contains('BOOTSCHEME_LABELS', 'optee', \
#				'sdcard-eglfs-phycore-stm32mp1-3-optee-1GB.wks', 'sdcard-eglfs-phycore-stm32mp1-3-trusted-1GB.wks', d)}"
#WKS_FILE_openstlinux-weston += "${@bb.utils.contains('BOOTSCHEME_LABELS', 'optee', \
#				'sdcard-weston-phycore-stm32mp1-3-optee-1GB.wks', 'sdcard-weston-phycore-stm32mp1-3-trusted-1GB.wks', d)"
```

## conf/machine/phycore-stm32mp1-4.conf
```bitbake
#@TYPE: Machine
#@NAME: phycore-stm32mp1-4
#@DESCRIPTION: PHYTEC phyCORE-STM32MP1 phyBOARD-Sargas full-featured, stm32mp157fac @800Mhz MPU, 3D GPU, 1GB RAM, 8GB eMMC, 16MB QSPI NOR
#@BOOTSCHEME: SD-Card, eMMC and NOR flash (Trusted or OP-TEE boot support)
#@ARTICLENUMBERS: PCM-939.A3, PCM-068-625113X.A1

include conf/machine/include/phytec-machine-common-stm32mp.inc
include conf/machine/include/st-machine-providers-stm32mp.inc

MACHINEOVERRIDES .= ":stm32mp1common:stm32mp15common:phycore-stm32mp15"

# =========================================================================
# Chip architecture
# =========================================================================
DEFAULTTUNE = "cortexa7thf-neon-vfpv4"
include conf/machine/include/arm/armv7a/tune-cortexa7.inc

# =========================================================================
# boot scheme
# =========================================================================
BOOTSCHEME_LABELS += "trusted"
#BOOTSCHEME_LABELS += "optee"

# =========================================================================
# Machine settings
# =========================================================================
# Kernel Device Tree
KERNEL_DT = "stm32mp157f-phyboard-sargas-rdk-emmc"

# Bootloaders Device Tree (same DTS name for U-boot and TF-A)
BOOTLOADER_DT = "stm32mp157f-phycore-som-emmc-1gib"

# =========================================================================
# Machine features
# =========================================================================
MACHINE_FEATURES += "bluetooth"
MACHINE_FEATURES += "wifi"
MACHINE_FEATURES += "hdmi"
MACHINE_FEATURES += "${@'gpu' if d.getVar('ACCEPT_EULA_'+d.getVar('MACHINE')) == '1' else ''}"
MACHINE_FEATURES += "mipi-dsi"
MACHINE_FEATURES += "phy-expansions"
# Splashscreen enabled
MACHINE_FEATURES += "splashscreen"
# M4 copro firmware examples enabled
MACHINE_FEATURES += "m4copro"

# =========================================================================
# Image
# =========================================================================
# Add ubi FSTYPES to default ones for nand volumes
#IMAGE_FSTYPES += "stmultiubi"

# =========================================================================
# Kernel
# =========================================================================
# Kernel config
# Set this address to 0xC2000040, which is 0xC2000000 + 0x40.
# 0xC2000000 is the memory address where U-Boot will copy from flash the file uImage and 0x40 is uImage header size (64Bytes).
# With this value, U-Boot will be able to execute in place the zImage contained in uImage.
ST_KERNEL_LOADADDR   = "0xC2000040"

# Define the devicetree for Linux A7 examples
LINUX_A7_EXAMPLES_DT = "stm32mp157f-phyboard-sargas-rdk-emmc-a7-examples"

# Define the devicetree overlays enabled by default
DEFAULT_PHY_EXPANSIONS = "phyboard-stm32mp1-peb-av02-lcd"

# =========================================================================
# flashlayout
# =========================================================================
# Define the config labels to use to generate flashlayout file
BOOTDEVICE_LABELS += "emmc"
BOOTDEVICE_LABELS += "nor-emmc"
BOOTDEVICE_LABELS += "sdcard"

# =========================================================================
# M4 copro
# =========================================================================
# Define the devicetree for M4 example
CUBE_M4_EXAMPLES_DT = "stm32mp157f-phyboard-sargas-rdk-emmc-m4-examples"

# Define specific board reference to use
M4_BOARDS = "STM32MP15-phyBOARD-Sargas"

# Define the name of default copro firmware that can be executed @boot time
# This name is cherry picked from list defined in m4projects-stm32mp1.bbappend
DEFAULT_COPRO_FIRMWARE = "OpenAMP_TTY_echo"

# =========================================================================
# extlinux configuration
# =========================================================================

# As example, modify the default boot config for each target to M4 config
#UBOOT_EXTLINUX_DEFAULT_LABEL_mp1-4_sdcard       = "phycore-stm32mp15-4-m4-examples-sdcard"
#UBOOT_EXTLINUX_DEFAULT_LABEL_mp1-4_sdcard-optee = "phycore-stm32mp15-4-m4-examples-sdcard-optee"

# =========================================================================
# HDMI EDID firmware configuration
# =========================================================================
# EDID firmware. This variable can be used to force specific HDMI screen resolution.
#HDMI_EDID_KERNEL_ARGS = "drm_kms_helper.edid_firmware=HDMI-A-1:edid/1280x720.bin"
```
