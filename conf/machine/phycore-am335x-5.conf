## conf/machine/phycore-stm32mp1-5.conf
```bitbake
#@TYPE: Machine
#@NAME: phycore-stm32mp1-5
#@DESCRIPTION: PHYTEC phyCORE-STM32MP1 phyBOARD-Sargas full-featured, stm32mp153aac @650Mhz MPU, no 3D GPU, 1GB RAM, 8GB eMMC
#@BOOTSCHEME: SD-Card, eMMC and NOR flash (OP-TEE boot support)
#@ARTICLENUMBERS: PCM-068-325113I.A0, PCM-939-1517.2

include conf/machine/include/phystm32mp.inc

MACHINEOVERRIDES .= ":stm32mp1common:stm32mp15common:phycore-stm32mp15"

# =========================================================================
# Chip architecture
# =========================================================================
DEFAULTTUNE = "cortexa7thf-neon-vfpv4"
include conf/machine/include/arm/armv7a/tune-cortexa7.inc

# =========================================================================
# boot scheme
# =========================================================================
BOOTSCHEME_LABELS = "optee"

# =========================================================================
# Machine settings
# =========================================================================
# Kernel Device Tree
KERNEL_DEVICETREE = "st/stm32mp153a-phyboard-sargas-rdk.dtb"

# Bootloaders Device Tree (same DTS name for U-boot and TF-A)
BOOTLOADER_DT = "stm32mp153a-phycore-som-1gib"

# =========================================================================
# Machine features
# =========================================================================
MACHINE_FEATURES += "bluetooth"
MACHINE_FEATURES += "wifi"
MACHINE_FEATURES += "hdmi"
MACHINE_FEATURES += "phy-expansions"
# Splashscreen enabled
MACHINE_FEATURES:append:openstlinuxcommon = " splashscreen"
# M4 copro firmware examples enabled
MACHINE_FEATURES:append:openstlinuxcommon = " m4copro"

# =========================================================================
# Kernel
# =========================================================================
# Kernel config
# Set this address to 0xC2000040, which is 0xC2000000 + 0x40.
# 0xC2000000 is the memory address where U-Boot will copy from flash the file uImage and 0x40 is uImage header size (64Bytes).
# With this value, U-Boot will be able to execute in place the zImage contained in uImage.
ST_KERNEL_LOADADDR   = "0xC2000040"

# Define the devicetree for Linux A7 examples
LINUX_A7_EXAMPLES_DT = "st/stm32mp153a-phyboard-sargas-rdk-a7-examples"

# Define the devicetree overlays enabled by default
DEFAULT_PHY_EXPANSIONS = "phyboard-stm32mp1-peb-av02-lcd"

# =========================================================================
# flashlayout
# =========================================================================
# Define the config labels to use to generate flashlayout file
BOOTDEVICE_LABELS += "emmc"
BOOTDEVICE_LABELS += "nor-emmc"
BOOTDEVICE_LABELS += "sdcard"

# =========================================================================
# M4 copro
# =========================================================================
# Define the devicetree for M4 example
CUBE_M4_EXAMPLES_DT = "st/stm32mp153a-phyboard-sargas-rdk-m4-examples"

# Define specific board reference to use
M4_BOARDS = "STM32MP15-phyBOARD-Sargas"

# Define the name of default copro firmware that can be executed @boot time
# This name is cherry picked from list defined in m4projects-stm32mp1.bbappend
DEFAULT_COPRO_FIRMWARE = "OpenAMP_TTY_echo"

# =========================================================================
# extlinux configuration
# =========================================================================
# As example, modify the default boot config for each target to M4 config (OpenSTLinux only)
#UBOOT_EXTLINUX_DEFAULT_LABEL_mp1-5_sdcard       = "phycore-stm32mp15-5-m4-examples-sdcard"
#UBOOT_EXTLINUX_DEFAULT_LABEL_mp1-5_sdcard-optee = "phycore-stm32mp15-5-m4-examples-sdcard-optee"

# =========================================================================
# HDMI EDID firmware configuration
# =========================================================================
# EDID firmware. This variable can be used to force specific HDMI screen resolution.
#HDMI_EDID_KERNEL_ARGS = "drm_kms_helper.edid_firmware=HDMI-A-1:edid/1280x720.bin"
```
