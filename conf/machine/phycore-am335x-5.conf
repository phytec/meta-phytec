## conf/machine/phycore-am335x-5.conf
```bitbake
#@TYPE: Machine
#@NAME: phycore-am335x-5
#@DESCRIPTION:  PHYTEC phyCORE-AM335x 256MB RAM, 128MB NAND flash, PCM-953
#@ARTICLENUMBERS: PCM-051-00051F0I.A1

require conf/machine/include/phyam335x.inc

SOC_FAMILY .= ":phycore-am335x"

# Kernel
KERNEL_DEVICETREE = "ti/omap/am335x-phycore-rdk.dtb"

# Barebox
BAREBOX_BIN = "images/barebox-am33xx-phytec-phycore-no-spi.img"
BAREBOX_IPL_BIN = "images/barebox-am33xx-phytec-phycore-mlo-256mb.img"

# resistivetouch, the rdk has one attached
MACHINE_FEATURES += "resistivetouch nand"

DT_OVERLAYS_INSTALL = " \
    am335x-no-spi-nor.dtbo \
    am335x-pcm953-lcd.dtbo \
"
```

## conf/machine/phycore-am335x-6.conf
```bitbake
#@TYPE: Machine
#@NAME: phycore-am335x-6
#@DESCRIPTION: PHYTEC phyCORE-AM335x 1GiB RAM, 512MiB NAND flash, PCM-953
#@ARTICLENUMBERS: PCM-051-42102F0I.A0
#@SUPPORTEDIMAGE: phytec-qt5demo-image

require conf/machine/include/phyam335x.inc

SOC_FAMILY .= ":phycore-am335x"

# Kernel
KERNEL_DEVICETREE = "am335x-phycore-rdk.dtb"

# Barebox
BAREBOX_BIN = "images/barebox-am33xx-phytec-phycore.img"
BAREBOX_IPL_BIN = "images/barebox-am33xx-phytec-phycore-mlo-1024mb.img"

# resistivetouch, the rdk has one attached
MACHINE_FEATURES += "resistivetouch sgx"
```

## conf/machine/phycore-am335x-7.conf
```bitbake
#@TYPE: Machine
#@NAME: phycore-am335x-7
#@DESCRIPTION: PHYTEC phyCORE-AM335x 512MB RAM, 512MB NAND flash, 8MB SPI flash, PCM-953 (WiFi jumpered)
#@ARTICLENUMBERS: PCM-051-12102F0C.A3

require conf/machine/include/phyam335x.inc

SOC_FAMILY .= ":phycore-am335x"

# Kernel
KERNEL_DEVICETREE = "ti/omap/am335x-phycore-rdk-wifi.dtb"

# Barebox
BAREBOX_BIN = "images/barebox-am33xx-phytec-phycore.img"
BAREBOX_IPL_BIN = "images/barebox-am33xx-phytec-phycore-mlo-512mb.img"

# resistivetouch, the rdk has one attached
MACHINE_FEATURES += "resistivetouch wifi gpu nand"
```

## conf/machine/phycore-am57xx-3.conf
```bitbake
#@TYPE: Machine
#@NAME: phycore-am57xx-3
#@DESCRIPTION: PHYTEC phyCORE-AM57x Linux development kit, 2GiB RAM (2 banks), 1GB NAND
#@ARTICLENUMBERS: PCM-057-40A00111I - AM5728 (SOM), PCM-948 (CB)

require conf/machine/include/phyam57xx.inc

UBOOT_MACHINE = "phycore_am57x_nand_defconfig"

KERNEL_DEVICETREE = " \
    am5728-phytec-pcm-948-40A00111I.dtb \
    ti/am57xx-phytec-pcm-948-gpio-fan.dtbo \
    ti/am57xx-phytec-pcm-948-x28-spidev.dtbo \
    ti/am57xx-phytec-pcm-948-lcd-017.dtbo \
    ti/am57xx-phytec-pcm-948-lcd-018.dtbo \
    ti/am57xx-phytec-pcm-948-vm-009.dtbo \
    ti/am57xx-phytec-pcm-948-vm-011.dtbo \
    ti/am57xx-phytec-pcm-948-vm-016.dtbo \
    ti/am57xx-phytec-pcm-948-wlan-wilink8.dtbo \
"

MACHINE_FEATURES += "nand"

# Build ubi image
IMAGE_FSTYPES += "ubi"

# NAND/UBI configuration
MKUBIFS_ARGS = "-m 4096 -c 4083 -e 258048"
UBINIZE_ARGS = "-p 256KiB -m 4096 -s 1024"
```

## conf/machine/phycore-am57xx-4.conf
```bitbake
#@TYPE: Machine
#@NAME: phycore-am57xx-4
#@DESCRIPTION: PHYTEC phyCORE-AM57x Linux development kit (RAM auto-detection), eMMC, with display/graphics, HS (High Secure) SoC
#@ARTICLENUMBERS: PCM-057 (SOM), PCM-948 (CB)

require conf/machine/phycore-am57xx-1.conf
require conf/machine/include/phyam57xx-hs.inc
```

## conf/machine/phycore-am57xx-5.conf
```bitbake
#@TYPE: Machine
#@NAME: phycore-am57xx-5
#@DESCRIPTION: PHYTEC phyCORE-AM57x Linux development kit (RAM auto-detection), eMMC, without display/graphics, HS (High Secure) SoC
#@ARTICLENUMBERS: PCM-057 (SOM), PCM-948 (CB)

require conf/machine/phycore-am57xx-2.conf
require conf/machine/include/phyam57xx-hs.inc
```

## conf/machine/phycore-am57xx-6.conf
```bitbake
#@TYPE: Machine
#@NAME: phycore-am57xx-6
#@DESCRIPTION: PHYTEC phyCORE-AM57x Linux development kit, 2GiB RAM (2 banks), 1GB NAND, HS (High Secure) SoC
#@ARTICLENUMBERS: PCM-057 (SOM), PCM-948 (CB)

require conf/machine/phycore-am57xx-3.conf
require conf/machine/include/phyam57xx-hs.inc
```

## conf/machine/phycore-emmc-am335x-1.conf
```bitbake
#@TYPE: Machine
#@NAME: phycore-emmc-am335x-1
#@DESCRIPTION: PHYTEC phyCORE-AM335x EMMC 1024MB RAM, 4GB EMMC flash, 8MB SPI
#@ARTICLENUMBERS: PCM-062-40143F10I.A1

require conf/machine/include/phyam335x.inc

SOC_FAMILY .= ":phycore-am335x"

# Kernel
KERNEL_DEVICETREE = "ti/omap/am335x-phycore-emmc-rdk.dtb"

# Barebox
BAREBOX_BIN = "images/barebox-am33xx-phytec-phycore-emmc.img"
BAREBOX_IPL_BIN = "images/barebox-am33xx-phytec-phycore-r2-mlo-1024mb.img"

# resistivetouch, the rdk has one attached
MACHINE_FEATURES += "resistivetouch gpu suspend emmc"

# Comment this lines out if you want to create a eMMC production image.
# This is a vfat image which contains only the bootloaders.
#WKS_FILES_ti33x = "am335x-emmc-production.wks"
#IMAGE_BOOT_FILES_ti33x = "barebox.bin MLO"

DT_OVERLAYS_INSTALL = " \
    am33xx-gpu.dtbo \
    am335x-pcm953-lcd.dtbo \
"
```

## conf/machine/phycore-imx8-1.conf
```bitbake
#@TYPE: Machine
#@NAME: phycore-imx8-1
#@DESCRIPTION: PCM-943 Rapid Development Kit board
#@ARTICLENUMBERS: PCM-943, PCM-064
#@SUPPORTEDIMAGE: fsl-image-qt5-validation-imx/fsl-imx-wayland

require conf/machine/include/arm/arch-arm64.inc
require conf/machine/include/imx-base.inc

MACHINEOVERRIDES =. "mx8:mx8qm:"

# Don't include kernels in standard images
RDEPENDS_kernel-base = ""

IMX_DEFAULT_KERNEL_mx8qm = "linux-imx"
KERNEL_IMAGETYPE = "Image"
INTREE_DEFCONFIG_pn-linux-imx ?= "defconfig"
LOADADDR = ""

# We have to disable SERIAL_CONSOLE due to auto-serial-console
SERIAL_CONSOLE = "115200 ttyAMA0"

# we do not want to have getty running on tty1 as we run
# auto-serial-console there
USE_VT = "0"

KERNEL_DEVICETREE = "freescale/phytec-imx8qm-phycore-rdk.dtb"

UBOOT_MAKE_TARGET = "u-boot.bin"
UBOOT_SUFFIX = "bin"
UBOOT_CONFIG ??= "sd"
UBOOT_CONFIG[sd] = "pcm064_defconfig,sdcard"

BOOT_SPACE = "32768"
IMAGE_BOOTLOADER = "imx-boot"
IMX_BOOT_SEEK = "33"

IMXBOOT_TARGETS = "flash"

IMAGE_BOOTFIRMWARE = "firmware-imx"
IMAGE_BOOTFILES += "hdmitxfw.bin dpfw.bin"

SDCARD_GENERATION_COMMAND_mx8 = "generate_imx_sdcard"

BOARD_TYPE = "${MACHINE}"

MACHINEOVERRIDES =. "imx:"
```

## conf/machine/phycore-imx8-2.conf
```bitbake
#@TYPE: Machine
#@NAME: phycore-imx8-2
#@DESCRIPTION: PCM-943 Rapid Development Kit board
#@ARTICLENUMBERS: KPCM-064-SYS-D.A1 (PCM-943, PCM-064)

MACHINEOVERRIDES =. "mx8:mx8qm:"

include conf/machine/include/imx-base.inc
include conf/machine/include/phyimx8.inc
require conf/machine/include/arm/arch-arm64.inc

MACHINE_FEATURES_append = " emmc pci can bluetooth wifi"

# Don't include kernels in standard images
RDEPENDS_${KERNEL_PACKAGE_NAME}-base = ""
RDEPENDS_${KERNEL_PACKAGE_NAME}-image = ""

LOADADDR = ""

# Disable the serial console due to auto-serial-console
SERIAL_CONSOLES = "115200;ttyAMA0"

# we do not want to have getty running on tty1 as we run
# auto-serial-console there
USE_VT = "0"
KERNEL_DEVICETREE = "freescale/phytec-imx8qm-phycore-rdk.dtb"

UBOOT_MAKE_TARGET = "u-boot.bin"
UBOOT_SUFFIX = "bin"
UBOOT_CONFIG ??= "sd"
UBOOT_CONFIG_SD = "pcm064_defconfig"
UBOOT_CONFIG[sd] = "${UBOOT_CONFIG_SD},sdcard"

IMAGE_BOOTLOADER = "imx-boot"

IMAGE_BOOTFILES_DEPENDS += "firmware-imx-8:do_deploy"

BOARD_TYPE = "${MACHINE}"

IMXBOOT_TARGETS_SD = "flash"
IMXBOOT_TARGETS = "${IMXBOOT_TARGETS_SD}"

#WIC
IMAGE_BOOT_FILES = "Image ${@parse_dtbs(d)} hdmitxfw.bin hdmirxfw.bin dpfw.bin"
```

## conf/machine/phycore-imx8x-1.conf
```bitbake
#@TYPE: Machine
#@NAME: phycore-imx8x-1
#@DESCRIPTION: PHYTEC phyCORE i.MX8X
#@ARTICLENUMBERS: PCM-942.A2, PCM-065-QP28NESI2.A0

MACHINEOVERRIDES =. "mx8qxp:mx8qxpc0:"

IMX_DEFAULT_BSP = "nxp"

require conf/machine/include/imx-base.inc
include conf/machine/include/phyimx8x.inc

MACHINE_FEATURES += " camera emmc pci can wifi bluetooth"

KERNEL_DEVICETREE = " \
        freescale/imx8qxp-phytec-pcm-942.dtb \
        freescale/overlays/imx8qxp-phytec-pcm-942-bt.dtbo \
        freescale/overlays/imx8qxp-phytec-pcm-942-gpio-fan.dtbo \
        freescale/overlays/imx8qxp-phytec-pcm-942-lcd-018-lvds0.dtbo \
        freescale/overlays/imx8qxp-phytec-pcm-942-lcd-018-lvds1.dtbo \
        freescale/overlays/imx8qxp-phytec-pcm-942-lvds0-peb-lvds-01.dtbo \
        freescale/overlays/imx8qxp-phytec-pcm-942-lvds1-peb-lvds-01.dtbo \
        freescale/overlays/imx8qxp-phytec-pcm-942-parallel-camera.dtbo \
        freescale/overlays/imx8qxp-phytec-pcm-942-uart2.dtbo \
        freescale/overlays/imx8qxp-phytec-pcm-942-wifi.dtbo \
"

UBOOT_MAKE_TARGET = "u-boot.bin"
UBOOT_SUFFIX = "bin"
UBOOT_CONFIG ??= "sd"
UBOOT_CONFIG[sd] = "phycore-imx8x_defconfig,sdcard"
UBOOT_CONFIG[fspi] = "phycore-imx8x_defconfig"

UBOOT_ENTRYPOINT = "0x96000000"
UBOOT_DTB_LOADADDRESS = "0x83100000"
UBOOT_DTBO_LOADADDRESS = "0x83200000"
UBOOT_RD_LOADADDRESS = "0xA0000000"

# Set Serial console
SERIAL_CONSOLES = "115200;ttyAMA0"

USE_VT = "0"

IMAGE_BOOTLOADER = "imx-boot"

# Set imx-mkimage boot target
IMXBOOT_TARGETS = "${@bb.utils.contains('UBOOT_CONFIG', 'fspi', 'flash_flexspi', 'flash', d)}"

IMX_DEFAULT_BOOTLOADER = "u-boot-phytec-imx"

# Set u-boot DTB
UBOOT_DTB_NAME = "imx8qxp-phycore-kit.dtb"

# Set ATF platform name and load address
ATF_PLATFORM = "imx8qx"

IMX_BOOT_SOC_TARGET = "iMX8QX"
```

## conf/machine/phycore-r2-am335x-1.conf
```bitbake
#@TYPE: Machine
#@NAME: phycore-r2-am335x-1
#@DESCRIPTION:  PHYTEC phyCORE-AM335x R2 512MiB RAM, 512MiB NAND flash, 8MiB SPI, PCM-953 (Kit), PM
#@ARTICLENUMBERS: PCM-060-12102F04I.A0, KPCM-060-SYS-LIN.A0

require conf/machine/include/phyam335x.inc

SOC_FAMILY .= ":phycore-am335x"

# Kernel
KERNEL_DEVICETREE = "am335x-phycore-nand-eeprom-rtc-spi-tmp.dtb"

# Barebox
BAREBOX_BIN = "images/barebox-am33xx-phytec-phycore.img"
BAREBOX_IPL_BIN = "images/barebox-am33xx-phytec-phycore-r2-mlo.img"

# resistivetouch, the rdk has one attached
MACHINE_FEATURES += "resistivetouch sgx suspend"
```

## conf/machine/phycore-r2-am335x-2.conf
```bitbake
#@TYPE: Machine
#@NAME: phycore-r2-am335x-2
#@DESCRIPTION:  PHYTEC phyCORE-AM335x R2 256MiB RAM, 256MiB NAND flash
#@ARTICLENUMBERS: PCM-060-01051E10I.A0
#@SUPPORTEDIMAGE: phytec-headless-image

require conf/machine/include/phyam335x.inc

SOC_FAMILY .= ":phycore-am335x"

# Kernel
KERNEL_DEVICETREE = "am335x-phycore-eeprom.dtb"

# Barebox
BAREBOX_BIN = "images/barebox-am33xx-phytec-phycore-no-spi.img"
BAREBOX_IPL_BIN = "images/barebox-am33xx-phytec-phycore-r2-mlo-256mb.img"

# resistivetouch, the rdk has one attached
MACHINE_FEATURES += "resistivetouch suspend"
```

## conf/machine/phycore-r2-am335x-3.conf
```bitbake
#@TYPE: Machine
#@NAME: phycore-r2-am335x-3
#@DESCRIPTION: PHYTEC phyCORE-AM335x R2 512MB RAM, 512MB NAND flash, 8MB SPI flash, PCM-953
#@ARTICLENUMBERS: PCM-060-12142F10I.A1

require conf/machine/include/phyam335x.inc

SOC_FAMILY .= ":phycore-am335x"

# Kernel
KERNEL_DEVICETREE = "ti/omap/am335x-phycore-rdk.dtb"

# Barebox
BAREBOX_BIN = "images/barebox-am33xx-phytec-phycore.img"
BAREBOX_IPL_BIN = "images/barebox-am33xx-phytec-phycore-r2-mlo.img"

# resistivetouch, the rdk has one attached
MACHINE_FEATURES += "resistivetouch gpu suspend nand"

DT_OVERLAYS_INSTALL = " \
    am33xx-gpu.dtbo \
    am335x-pcm953-lcd.dtbo \
"
```

## conf/machine/phycore-r2-am335x-4.conf
```bitbake
#@TYPE: Machine
#@NAME: phycore-r2-am335x-4
#@DESCRIPTION: PHYTEC phyCORE-AM335x R2 512MB RAM, 512MB NAND flash, PCM-953
#@ARTICLENUMBERS: PCM-060-12052F10I.A1

require conf/machine/include/phyam335x.inc

SOC_FAMILY .= ":phycore-am335x"

# Kernel
KERNEL_DEVICETREE = "ti/omap/am335x-phycore-rdk.dtb"

# Barebox
BAREBOX_BIN = "images/barebox-am33xx-phytec-phycore-no-spi.img"
BAREBOX_IPL_BIN = "images/barebox-am33xx-phytec-phycore-r2-mlo.img"

# resistivetouch, the rdk has one attached
MACHINE_FEATURES += "resistivetouch suspend nand"

DT_OVERLAYS_INSTALL = " \
    am335x-no-spi-nor.dtbo \
    am335x-pcm953-lcd.dtbo \
"
```

## conf/machine/phycore-r2-am335x-5.conf
```bitbake
#@TYPE: Machine
#@NAME: phycore-r2-am335x-5
#@DESCRIPTION: PHYTEC phyCORE-AM335x R2 1GB RAM, 1GB NAND flash, 8MB SPI flash, PCM-953
#@ARTICLENUMBERS: PCM-060-43102F10I.A1

require conf/machine/include/phyam335x.inc

SOC_FAMILY .= ":phycore-am335x"

# Kernel
KERNEL_DEVICETREE = "ti/omap/am335x-phycore-rdk.dtb"

# Barebox
BAREBOX_BIN = "images/barebox-am33xx-phytec-phycore.img"
BAREBOX_IPL_BIN = "images/barebox-am33xx-phytec-phycore-r2-mlo-1024mb.img"

# resistivetouch, the rdk has one attached
MACHINE_FEATURES += "resistivetouch gpu suspend nand"

DT_OVERLAYS_INSTALL = " \
    am33xx-gpu.dtbo \
    am335x-pcm953-lcd.dtbo \
"
```

## conf/machine/phycore-r2-am335x-6.conf
```bitbake
#@TYPE: Machine
#@NAME: phycore-r2-am335x-6
#@DESCRIPTION: PHYTEC phyCORE-AM335x R2 1GB RAM, 1GB NAND flash, PCM-953
#@ARTICLENUMBERS: PCM-060-43002F10I.A0

require conf/machine/include/phyam335x.inc

SOC_FAMILY .= ":phycore-am335x"

# Kernel
KERNEL_DEVICETREE = "ti/omap/am335x-phycore-rdk.dtb"

# Barebox
BAREBOX_BIN = "images/barebox-am33xx-phytec-phycore-no-spi.img"
BAREBOX_IPL_BIN = "images/barebox-am33xx-phytec-phycore-r2-mlo-1024mb.img"

# resistivetouch, the rdk has one attached
MACHINE_FEATURES += "resistivetouch gpu suspend nand"

DT_OVERLAYS_INSTALL = " \
    am33xx-gpu.dtbo \
    am335x-no-spi-nor.dtbo \
    am335x-pcm953-lcd.dtbo \
"
```

## conf/machine/phycore-rk3288-1.conf
```bitbake
# Copyright (C) 2016 Wadim Egorov
# Released under the MIT license (see COPYING.MIT for the terms)

#@TYPE: Machine
#@NAME: phycore-rk3288-1
#@DESCRIPTION: commissioning hardware
#@ARTICLENUMBERS: PCM-059-PROT.A0, PCM-946.A0
#@SUPPORTEDIMAGE: phytec-headless-image

include conf/machine/include/phyrk3288.inc

KERNEL_DEVICETREE = "rk3288-pcm946.dtb"

UBOOT_MACHINE = "phycore-rk3288_defconfig"
```

## conf/machine/phycore-rk3288-2.conf
```bitbake
# Copyright (C) 2016 Wadim Egorov
# Released under the MIT license (see COPYING.MIT for the terms)

#@TYPE: Machine
#@NAME: phycore-rk3288-2
#@DESCRIPTION: PCM-947 Rapid Development Kit board
#@ARTICLENUMBERS: PCM-059-PROT.A0, PCM-947.A0
#@SUPPORTEDIMAGE: phytec-qt5demo-image

include conf/machine/include/phyrk3288.inc

KERNEL_DEVICETREE = "rk3288-phycore-rdk.dtb"

UBOOT_MACHINE = "phycore-rk3288_defconfig"
INTREE_DEFCONFIG_pn-barebox = "rk3288_defconfig"
```

## conf/machine/phycore-rk3288-3.conf
```bitbake
#@TYPE: Machine
#@NAME: phycore-rk3288-3
#@DESCRIPTION: PCM-947 Rapid Development Kit board
#@ARTICLENUMBERS: PCM-059-423011I.A0, PCM-947.A1

include conf/machine/include/phyrk3288.inc

KERNEL_DEVICETREE = "rk3288-phycore-rdk.dtb"

UBOOT_MACHINE = "phycore-rk3288_defconfig"

MACHINE_FEATURES += "emmc"

#Deploy sdcard/emmc images with twice boot and rootfs partitions
WKS_FILES_rk3288 = "rk3288-sdimage.wks"
```

## conf/machine/phycore-rk3288-4.conf
```bitbake
#@TYPE: Machine
#@NAME: phycore-rk3288-4
#@DESCRIPTION: RK3288 Webbox HW, AI Kit 1
#@ARTICLENUMBERS:
#@SUPPORTEDIMAGE: phytec-iotedge-image/yogurt-gateway

include conf/machine/include/phyrk3288.inc

KERNEL_DEVICETREE = "rk3288-wbox.dtb"

UBOOT_MACHINE = "phycore-rk3288_defconfig"

MACHINE_FEATURES += "emmc alsa"

WKS_FILES_rk3288 = "rk3288-sdimage.wks"
```
