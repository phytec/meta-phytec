## conf/machine/include/phytec-machine-storage-device-stm32mp.inc
```bitbake
#@DESCRIPTION: STM32MP machine storage device configuration

# -----------------------------------------------------------------------------
# Define device storage name and type mapping
# -----------------------------------------------------------------------------
DEVICE_STORAGE ?= "EMMC:mmc1, NAND:nand0, NOR:nor0, SDCARD:mmc0"

# -----------------------------------------------------------------------------
# Define device storage name alias
# -----------------------------------------------------------------------------
DEVICE_STORAGE_NAMES += "EMMC"
DEVICE_STORAGE_NAMES += "NAND"
DEVICE_STORAGE_NAMES += "NOR"
DEVICE_STORAGE_NAMES += "SDCARD"

# -----------------------------------------------------------------------------
# Define device storage type
# -----------------------------------------------------------------------------
DEVICE_STORAGE_TYPES += "mmc0"
DEVICE_STORAGE_TYPES += "mmc1"
DEVICE_STORAGE_TYPES += "nand0"
DEVICE_STORAGE_TYPES += "nor0"

python () {
    """
    This function configure dynamically the needed alias between generic storage
    device name and device type.
    Output for this function is the initialization of:
        DEVICE:<device_name> = '<device_type>'
        DEVICE:<device_type> = '<device_name>'
    """
    device_storage_config = d.getVar('DEVICE_STORAGE') or ''
    if not device_storage_config:
        return
    if not device_storage_config.strip():
        return
    if len(device_storage_config.split(',')) > 0:
        # Init supported device storage configuration
        supported_device_names = (d.getVar('DEVICE_STORAGE_NAMES') or '').split()
        supported_device_types = (d.getVar('DEVICE_STORAGE_TYPES') or '').split()
        # Loop for all storage device configurations
        for device_storage in device_storage_config.split(','):
            device_name = device_storage.split(':')[0].strip()
            device_type = device_storage.split(':')[1].strip()
            # Check for configuration consistency
            if device_name and device_type:
                # Make sure configuration is correctly done
                if device_name not in supported_device_names:
                    bb.fatal('Wrong DEVICE_STORAGE configuration: "%s" is not part of supported device name (%s)' % (device_name, supported_device_names))
                if device_type not in supported_device_types:
                    bb.fatal('Wrong DEVICE_STORAGE configuration: "%s" is not part of supported device type (%s)' % (device_type, supported_device_types))
                # Configure alias
                d.setVar('DEVICE:%s' % device_name, device_type)
                d.setVar('DEVICE:%s' % device_type, device_name)
            else:
                bb.fatal('Wrong DEVICE_STORAGE configuration: expecting DEVICE_STORAGE = "<device_name1>:<devie_type1>,<device_name2>:<device_type2>"')
}

# -----------------------------------------------------------------------------
# EMMC
# Extra space is required to store 'Protective MBR' and 'Primary GPT Header'
# Currently the required size is 17 KiB (i.e. 0x4400)
# We need to align this size to get the first offset to use
DEVICE_START_OFFSET:EMMC    ?= "0x00080000"
# 64 Gbit
DEVICE_MAX_OFFSET:EMMC      ?= "0x200000000"
DEVICE_ALIGNMENT_SIZE:EMMC  ?= "0x00080000"

# Specific to EMMC, there are two boot partitions using specific offset to access
DEVICE_START_OFFSET_BOOT0:EMMC ?= "boot1"
DEVICE_START_OFFSET_BOOT1:EMMC ?= "boot2"

# Configure the rootfs partition uid used in gpt partition table for EMMC
DEVICE_PARTUUID_ROOTFS:EMMC ?= "${@d.getVar(d.expand('DEVICE_PARTUUID_ROOTFS:${DEVICE:EMMC}')) or ''}"

# Configure the list of boards that enable EMMC
DEVICE_BOARD_ENABLE:EMMC += "${@bb.utils.contains_any('BOOTDEVICE_LABELS', ['emmc', 'nor-emmc' ], '${STM32MP_DEVICETREE}', '', d)}"

# -----------------------------------------------------------------------------
# NAND
DEVICE_START_OFFSET:NAND   ?= "0x00000000"
# 4 Gbit
DEVICE_MAX_OFFSET_NAND_2_256     ?= "0x20000000"
# 1 Gbit
DEVICE_MAX_OFFSET_NAND_2_64     ?= "0x8000000"
DEVICE_MAX_OFFSET:NAND     ?= "${@bb.utils.contains('BOOTDEVICE_LABELS', 'nand-2-256', '${DEVICE_MAX_OFFSET_NAND_2_256}', '${DEVICE_MAX_OFFSET_NAND_2_64}', d)}"
DEVICE_ALIGNMENT_SIZE:NAND ?= "0x00040000"

# Configure the list of boards that enable NAND
DEVICE_BOARD_ENABLE:NAND   += "${@bb.utils.contains_any('BOOTDEVICE_LABELS', ['nand-2-256', 'nand-2-64' ], '${STM32MP_DEVICETREE}', '', d)}"

# -----------------------------------------------------------------------------
# NOR
DEVICE_START_OFFSET:NOR    ?= "0x00000000"
# 128 Mbit
DEVICE_MAX_OFFSET:NOR      ?= "0x01000000"
DEVICE_ALIGNMENT_SIZE:NOR  ?= "0x00010000"

# Configure the list of boards that enable NOR
DEVICE_BOARD_ENABLE:NOR    += "${@bb.utils.contains_any('BOOTDEVICE_LABELS', ['nor-sdcard', 'nor-emmc' ], '${STM32MP_DEVICETREE}', '', d)}"

# -----------------------------------------------------------------------------
# SDCARD
# Extra space is required to store 'Protective MBR' and 'Primary GPT Header'
# Currently the required size is 17 KiB (i.e. 0x4400)
# We need to align this size to get the first offset to use
DEVICE_START_OFFSET:SDCARD    ?= "0x00004400"
# No limit for SDCARD
DEVICE_MAX_OFFSET:SDCARD      ?= "none"
DEVICE_ALIGNMENT_SIZE:SDCARD  ?= "0x00000200"

# Configure the rootfs partition uid used in gpt partition table for SDCARD
DEVICE_PARTUUID_ROOTFS:SDCARD ?= "${@d.getVar(d.expand('DEVICE_PARTUUID_ROOTFS:${DEVICE:SDCARD}')) or ''}"

# Configure the list of boards that enable SDCARD
DEVICE_BOARD_ENABLE:SDCARD += "${@bb.utils.contains_any('BOOTDEVICE_LABELS', ['sdcard', 'nor-sdcard' ], '${STM32MP_DEVICETREE}', '', d)}"

# -----------------------------------------------------------------------------
# Fixed configuration from U-Boot source code
# -----------------------------------------------------------------------------
DEVICE_PARTUUID_ROOTFS:mmc0 ?= "e91c4e10-16e6-4c0e-bd0e-77becf4a3582"
DEVICE_PARTUUID_ROOTFS:mmc1 ?= "491f6117-415d-4f53-88c9-6e0de54deac6"

DEVICE_TYPEUUID_FIP = "19d5df83-11b0-457b-be2c-7559c13142a5"
DEVICE_PARTUUID_FIP_A = "4fd84c93-54ef-463f-a7ef-ae25ff887087"
DEVICE_PARTUUID_FIP_B = "09c54952-d5bf-45af-acee-335303766fb3"
```

## conf/machine/phyAM335x-HK.conf
```bitbake
#@TYPE: Machine
#@NAME: phyAM335x-HK - PHYTEC TI AM335x Harakiri machine

#@DESCRIPTION: The idea behind this machine comes from the requirement to support all available PHYTEC boards with a minimal set of configuration options. So this machine identifier should build an image which is runnable on all AM335x boards. Dont expect everything to work.

require conf/machine/include/meta-phytec.inc
require conf/machine/include/phytec-common-pkgarch.inc

PREFERRED_PROVIDER_virtual/kernel ?= "linux-yocto"
PREFERRED_VERSION_linux-yocto ?= "3.14%"

MACHINE_FEATURES += "pcbios efi"
MACHINE_FEATURES += "va-impl-intel"
MACHINE_FEATURES += "wifi 3g"

MACHINE_HWCODECS ?= "va-intel gst-va-intel"

MACHINE_EXTRA_RRECOMMENDS += "linux-firmware"

XSERVER ?= "${XSERVER_X86_BASE} \
            ${XSERVER_X86_EXT} \
            ${XSERVER_X86_FBDEV} \
            ${XSERVER_X86_I915} \
            ${XSERVER_X86_I965} \
            ${XSERVER_X86_MODESETTING} \
            ${XSERVER_X86_VESA} \
           "

SYSLINUX_OPTS = "serial 0 115200"
SERIAL_CONSOLE = "115200 ttyS0"
APPEND += "console=ttyS0,115200 console=tty0"
```

## conf/machine/phyboard-alcor-imx6-1.conf
```bitbake
#@TYPE: Machine
#@NAME: phyboard-alcor-imx6-1
#@DESCRIPTION:
#@ARTICLENUMBERS: PB-00301-110C.A0, PBA-B-02-OEM05.A0, PFL-A-02-23237E0.A3
#@SUPPORTEDIMAGE:
#from http://www.phytec.de

require conf/machine/include/phyimx6qdl.inc

SOC_FAMILY .= ":mx6q"
SOC_FAMILY .= ":phyboard-alcor-imx6"

# Kernel
KERNEL_DEVICETREE = "imx6q-phytec-phyboard-alcor.dtb"

# Barebox Config
BAREBOX_BIN = "images/barebox-phytec-phyboard-alcor-1gib.img"

# resistivetouch, the rdk has one attached
MACHINE_FEATURES += "resistivetouch can"
```

## conf/machine/phyboard-electra-am64xx-1-k3r5.conf
```bitbake
#@TYPE: Machine
#@NAME: phyboard-electra-am64xx-1-k3r5
#@DESCRIPTION: PHYTEC phyBOARD-Electra AM64x, 2GB RAM, GP (R5F)
#@ARTICLENUMBERS: KPB-07225-001.A0, PCM-072.A1

require conf/machine/include/phyk3r5.inc

MACHINEOVERRIDES =. "k3r5-am64xx:phyboard-electra:"

# Each SoC variant requires a different SYSFW binary
# Our SoM's are currently available as AM64x GP variants
# Note: Later, AM64x devices will only be available as SR2.0 HS-FS
SPL_BINARY = "tiboot3-am64x-gp-phycore-som.bin"

UBOOT_MACHINE = "phycore_am64x_r5_defconfig"
```

## conf/machine/phyboard-electra-am64xx-1.conf
```bitbake
#@TYPE: Machine
#@NAME: phyboard-electra-am64xx-1
#@DESCRIPTION: PHYTEC phyBOARD-Electra AM64x, 2GB RAM, GP
#@ARTICLENUMBERS: KPB-07225-001.A0, PCM-072.A1

include conf/machine/include/phyam64xx.inc

MACHINEOVERRIDES =. ":phyboard-electra:"

MACHINE_FEATURES += "can emmc pci tpm2"

KERNEL_DEVICETREE = " \
    ti/k3-am642-phyboard-electra-rdk.dtb \
    ${KERNEL_OVERLAYS} \
"

UBOOT_MACHINE = "phycore_am64x_a53_defconfig"
```

## conf/machine/phyboard-electra-am64xx-2-k3r5.conf
```bitbake
#@TYPE: Machine
#@NAME: phyboard-electra-am64xx-2-k3r5
#@DESCRIPTION: PHYTEC phyBOARD-Electra AM64x, 2GB RAM, HS-FS (R5F)
#@ARTICLENUMBERS: KPB-07225-002.A0, PCM-072-42F2DE11I.A0

require conf/machine/include/phyam64xx-k3r5.inc

MACHINEOVERRIDES =. "k3r5-am64xx:phyboard-electra:"

# Each SoC variant requires a different SYSFW binary
# Our SoM's are currently available as AM64x GP variants
# Note: Later, AM64x devices will only be available as SR2.0 HS-FS
SPL_BINARY = "tiboot3-am64x_sr2-hs-fs-phycore-som.bin"

UBOOT_MACHINE = "phycore_am64x_r5_defconfig"
```

## conf/machine/phyboard-electra-am64xx-2.conf
```bitbake
#@TYPE: Machine
#@NAME: phyboard-electra-am64xx-2
#@DESCRIPTION: PHYTEC phyBOARD-Electra AM64x, 2GiB RAM, HS-FS
#@ARTICLENUMBERS: PBA-C-25.A1, PCM-072.A2

include conf/machine/include/phyam64xx.inc

MACHINE_FEATURES += "can emmc pci tpm2"

KERNEL_DEVICETREE = " \
    ti/k3-am642-phyboard-electra-rdk.dtb \
    ti/k3-am64-phyboard-electra-pcie-usb2.dtbo \
    ti/k3-am64-phyboard-electra-rpmsg.dtbo \
    ti/k3-am64-phyboard-electra-x27-uart3-spi1.dtbo \
"

PREFERRED_PROVIDER_virtual/kernel:${MACHINE} = "linux-ti"
PREFERRED_PROVIDER_virtual/bootloader:${MACHINE} = "u-boot-ti"

UBOOT_MACHINE = "phycore_am64x_a53_defconfig"
```

## conf/machine/phyboard-electra-am64xx-3-k3r5.conf
```bitbake
#@TYPE: Machine
#@NAME: phyboard-electra-am64xx-3-k3r5
#@DESCRIPTION: PHYTEC phyBOARD-Electra AM64x, 2GB RAM, HS-SE (R5F)
#@ARTICLENUMBERS: KPB-07225-002.A0, PCM-072-42F2DE11I.A0

require conf/machine/include/phyam64xx-k3r5.inc

MACHINEOVERRIDES =. "k3r5-am64xx:phyboard-electra:secureenforced:"

# Each SoC variant requires a different SYSFW binary
# Our SoM's are currently available as AM64x GP variants
# Note: Later, AM64x devices will only be available as SR2.0 HS-FS
SPL_BINARY = "tiboot3-am64x_sr2-hs-phycore-som.bin"

UBOOT_MACHINE = "phycore_am64x_r5_defconfig"
```

## conf/machine/phyboard-electra-am64xx-3.conf
```bitbake
#@TYPE: Machine
#@NAME: phyboard-electra-am64xx-3
#@DESCRIPTION: PHYTEC phyBOARD-Electra AM64x, 1-2 GB RAM, HS-SE
#@ARTICLENUMBERS: KPB-07225-002.A0, PCM-072-42F2DE11I.A0

include conf/machine/include/phyam64xx.inc

MACHINEOVERRIDES =. ":phyboard-electra:secureenforced:"

MACHINE_FEATURES += "can emmc pci tpm2"

KERNEL_DEVICETREE = " \
    ti/k3-am642-phyboard-electra-rdk.dtb \
    ${KERNEL_OVERLAYS} \
"

UBOOT_MACHINE = "phycore_am64x_a53_defconfig"
```

## conf/machine/phyboard-izar-am68x-1-k3r5.conf
```bitbake
#@TYPE: Machine
#@NAME: phyboard-izar-am68x-1-k3r5
#@DESCRIPTION: PHYTEC phyBOARD-Izar AM68x, 4GiB RAM (R5F)
#@ARTICLENUMBERS: PB-04128-Alpha.A0, PCM-074-PROTO.A0

require conf/machine/include/phyk3r5.inc

SPL_BINARY = "tiboot3-am68x-gp-phycore-som.bin"

UBOOT_MACHINE = "phycore_am68x_r5_defconfig"
```

## conf/machine/phyboard-izar-am68x-1.conf
```bitbake
#@TYPE: Machine
#@NAME: phyboard-izar-am68x-1
#@DESCRIPTION: PHYTEC phyBOARD-Izar AM68x, 4GiB RAM
#@ARTICLENUMBERS: PB-04128-Alpha.A0, PCM-074-PROTO.A0

require conf/machine/include/phyam68x.inc

MACHINE_FEATURES += "can emmc pci tpm2 gpu"

KERNEL_DEVICETREE = " \
    ti/k3-am68-phyboard-izar-rdk.dtb \
    ti/k3-am68-phyboard-izar-pwm-fan.dtbo \
"

UBOOT_MACHINE = "phycore_am68x_a72_defconfig"

BBMULTICONFIG = "k3r5"
```

## conf/machine/phyboard-izar-am68x-2-k3r5.conf
```bitbake
#@TYPE: Machine
#@NAME: phyboard-izar-am68x-2-k3r5
#@DESCRIPTION: PHYTEC phyBOARD-Izar AM68x, 4-8 GB RAM, GP (R5F)
#@ARTICLENUMBERS: PCM-074-1TG634F2I.A1

require conf/machine/include/phyk3r5.inc

SPL_BINARY = "tiboot3-am68x-gp-phycore-som.bin"

UBOOT_MACHINE = "phycore_am68x_r5_defconfig"
```

## conf/machine/phyboard-izar-am68x-2.conf
```bitbake
#@TYPE: Machine
#@NAME: phyboard-izar-am68x-2
#@DESCRIPTION: PHYTEC phyBOARD-Izar AM68x, 4-8 GB RAM, GP
#@ARTICLENUMBERS: PB-04128-001.A1, PCM-074-1TG634F2I.A1

require conf/machine/include/phyam68x.inc

MACHINEOVERRIDES =. "phyboard-izar:"
MACHINE_FEATURES += "camera can emmc pci tpm2 gpu"

UBOOT_MACHINE = "phycore_am68x_a72_defconfig"

BBMULTICONFIG = "k3r5"
```

## conf/machine/phyboard-izar-am68x-3-k3r5.conf
```bitbake
#@TYPE: Machine
#@NAME: phyboard-izar-am68x-3-k3r5
#@DESCRIPTION: PHYTEC phyBOARD-Izar AM68x, 4-8 GB RAM, HS-FS (R5F)
#@ARTICLENUMBERS: PBA-C-27-001.A0, PCM-074-6T0834F2I.A0

require conf/machine/include/phyk3r5.inc

MACHINEOVERRIDES =. "phyboard-izar:"
SPL_BINARY = "tiboot3-am68x-hs-fs-phycore-som.bin"

UBOOT_MACHINE = "phycore_am68x_r5_defconfig"
```

## conf/machine/phyboard-izar-am68x-3.conf
```bitbake
#@TYPE: Machine
#@NAME: phyboard-izar-am68x-3
#@DESCRIPTION: PHYTEC phyBOARD-Izar AM68x, 4-8 GB RAM, HS-FS
#@ARTICLENUMBERS: PCM-074-6T0834F2I.A1, PCM-074-6T0630B2I.A0

require conf/machine/include/phyam68x.inc

MACHINEOVERRIDES =. "phyboard-izar:"
MACHINE_FEATURES += "camera can emmc pci tpm2 gpu"

UBOOT_MACHINE = "phycore_am68x_a72_defconfig"

BBMULTICONFIG = "k3r5"
```

## conf/machine/phyboard-izar-am68x-4-k3r5.conf
```bitbake
#@TYPE: Machine
#@NAME: phyboard-izar-am68x-4-k3r5
#@DESCRIPTION: PHYTEC phyBOARD-Izar AM68x, 4-8 GB RAM, HS-SE (R5F)
#@ARTICLENUMBERS: PCM-074-6T0834F2I.A1, PCM-074-6T0630B2I.A0

require conf/machine/include/phyk3r5.inc

SPL_BINARY = "tiboot3-am68x-hs-phycore-som.bin"

UBOOT_MACHINE = "phycore_am68x_r5_defconfig"
```

## conf/machine/phyboard-izar-am68x-4.conf
```bitbake
#@TYPE: Machine
#@NAME: phyboard-izar-am68x-4
#@DESCRIPTION: PHYTEC phyBOARD-Izar AM68x, 4-8 GB RAM, HS-SE
#@ARTICLENUMBERS: PCM-074-6T0834F2I.A1, PCM-074-6T0630B2I.A0

require conf/machine/include/phyam68x.inc

MACHINE_FEATURES += "camera can emmc pci tpm2 gpu"

UBOOT_MACHINE = "phycore_am68x_a72_defconfig"

BBMULTICONFIG = "k3r5"
```
