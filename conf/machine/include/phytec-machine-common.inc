## conf/machine/include/phytec-machine-common.inc
```bitbake
# add machine override to be used for generic appends
# to guard against interfering with other bsp layers
# remember to use it only only receipts with package
# arch equal to machine arch
MACHINEOVERRIDES =. "phytec-machine:"
```

## conf/machine/include/phytec-machine-extlinux-config-phycore-stm32mp1-1.inc
```bitbake
#@DESCRIPTION: PHYCORE-STM32MP1-1 machine extlinux file configuration

# Set configuration file to monitor
UBOOT_EXTLINUX_CONFIGURE_FILES_append = " ${PHYCORE_STM32MP_BASE}/conf/machine/include/phytec-machine-extlinux-config-phycore-stm32mp1-1.inc:True "

include conf/machine/include/phytec-machine-extlinux-config-stm32mp.inc

# -----------------------------------------------------------------------------
# PHYCORE STM32mp1-1 configuration
# -----------------------------------------------------------------------------
# Define available targets to use
UBOOT_EXTLINUX_CONFIGURED_TARGETS += "mp1-1_sdcard"
UBOOT_EXTLINUX_CONFIGURED_TARGETS += "mp1-1_nor-emmc"
# Define bootprefix for each target
UBOOT_EXTLINUX_BOOTPREFIXES_mp1-1_sdcard       = "${EXTLINUX_BOOTDEVICE_SDCARD}_phycore-stm32mp1-1_"
UBOOT_EXTLINUX_BOOTPREFIXES_mp1-1_nor-emmc = "${EXTLINUX_BOOTDEVICE_NOREMMC}_phycore-stm32mp1-1_"
# Define labels for each target
UBOOT_EXTLINUX_LABELS_mp1-1_sdcard       = "phycore-stm32mp1-1-sdcard"
UBOOT_EXTLINUX_LABELS_mp1-1_nor-emmc = "phycore-stm32mp1-1-nor-emmc"
# Define default boot config for each target
UBOOT_EXTLINUX_DEFAULT_LABEL_mp1-1_sdcard       ?= "phycore-stm32mp1-1-sdcard"
UBOOT_EXTLINUX_DEFAULT_LABEL_mp1-1_nor-emmc ?= "phycore-stm32mp1-1-nor-emmc"
# Define FDT overrides for all labels
UBOOT_EXTLINUX_FDT_phycore-stm32mp1-1-sdcard       = "/phycore-stm32mp1-1.dtb"
UBOOT_EXTLINUX_FDT_phycore-stm32mp1-1-nor-emmc = "/phycore-stm32mp1-1.dtb"
# Define ROOT overrides for all labels
UBOOT_EXTLINUX_ROOT_phycore-stm32mp1-1-sdcard = "${EXTLINUX_ROOT_SDCARD}"
UBOOT_EXTLINUX_ROOT_phycore-stm32mp1-1-nor-emmc = "${EXTLINUX_ROOT_NOREMMC}"
# -----------------------------------------------------------------------------
# Append A7 examples labels for each target
UBOOT_EXTLINUX_LABELS_mp1-1_sdcard       += "phycore-stm32mp1-1-a7-examples-sdcard"
UBOOT_EXTLINUX_LABELS_mp1-1_nor-emmc += "phycore-stm32mp1-1-a7-examples-nor-emmc"
# Define FDT overrides for A7 labels
UBOOT_EXTLINUX_FDT_phycore-stm32mp1-1-a7-examples-sdcard       = "/phycore-stm32mp1-1-a7-examples.dtb"
UBOOT_EXTLINUX_FDT_phycore-stm32mp1-1-a7-examples-nor-emmc = "/phycore-stm32mp1-1-a7-examples.dtb"
# Define ROOT overrides for A7 labels
UBOOT_EXTLINUX_ROOT_phycore-stm32mp1-1-a7-examples-sdcard       = "${EXTLINUX_ROOT_SDCARD}"
UBOOT_EXTLINUX_ROOT_phycore-stm32mp1-1-a7-examples-nor-emmc = "${EXTLINUX_ROOT_NOREMMC}"
# -----------------------------------------------------------------------------
# Append M4 examples labels for each target
UBOOT_EXTLINUX_LABELS_mp1-1_sdcard       += "phycore-stm32mp1-1-m4-examples-sdcard"
UBOOT_EXTLINUX_LABELS_mp1-1_nor-emmc += "phycore-stm32mp1-1-m4-examples-nor-emmc"
# Define FDT overrides for M4 labels
UBOOT_EXTLINUX_FDT_phycore-stm32mp1-1-m4-examples-sdcard       = "/phycore-stm32mp1-1-m4-examples.dtb"
UBOOT_EXTLINUX_FDT_phycore-stm32mp1-1-m4-examples-nor-emmc = "/phycore-stm32mp1-1-m4-examples.dtb"
# Define ROOT overrides for M4 labels
UBOOT_EXTLINUX_ROOT_phycore-stm32mp1-1-m4-examples-sdcard       = "${EXTLINUX_ROOT_SDCARD}"
UBOOT_EXTLINUX_ROOT_phycore-stm32mp1-1-m4-examples-nor-emmc = "${EXTLINUX_ROOT_NOREMMC}"
```

## conf/machine/include/phytec-machine-extlinux-config-phycore-stm32mp1-2.inc
```bitbake
#@DESCRIPTION: phycore-stm32mp1-2 machine extlinux file configuration

# -----------------------------------------------------------------------------
# Append specific examples configs
# -----------------------------------------------------------------------------
# Define new label(s) to append to the label list from current target
# UBOOT_EXTLINUX_TARGETS_EXTRA_CONFIG[extra-target] = "newlabel1 newlabel2"
# This will create new 'extlinux.conf' file with name 'extra-target_extlinux.conf'
# that will use UBOOT_EXTLINUX_LABELS label list defined for current target plus
# the 'newlabel1' and 'newlabel2' labels.
# -----------------------------------------------------------------------------
# Define extra label configuration
UBOOT_EXTLINUX_TARGETS_EXTRA_CONFIG[phycore-stm32mp1-2] += "phycore-stm32mp1-2-a7-examples"
UBOOT_EXTLINUX_TARGETS_EXTRA_CONFIG[phycore-stm32mp1-2] += "phycore-stm32mp1-2-m4-examples"

# -----------------------------------------------------------------------------
# Configure A7 examples labels
# -----------------------------------------------------------------------------
# Define MENU DESCRIPTION overrides for new A7 labels
UBOOT_EXTLINUX_MENU_DESCRIPTION_phycore-stm32mp1-2-a7-examples = "phycore-stm32mp1-2-a7-examples"
# Define FDT overrides for new A7 labels
UBOOT_EXTLINUX_FDT_phycore-stm32mp1-2-a7-examples = "/phycore-stm32mp1-2-a7-examples.dtb"

# -----------------------------------------------------------------------------
# Configure M4 examples labels
# -----------------------------------------------------------------------------
# Define MENU DESCRIPTION overrides for new M4 labels
UBOOT_EXTLINUX_MENU_DESCRIPTION_phycore-stm32mp1-2-m4-examples = "phycore-stm32mp1-2-m4-examples"
# Define FDT overrides for new M4 labels
UBOOT_EXTLINUX_FDT_phycore-stm32mp1-2-m4-examples = "/phycore-stm32mp1-2-m4-examples.dtb"

# -----------------------------------------------------------------------------
# Define FDT override for Default label
# -----------------------------------------------------------------------------
UBOOT_EXTLINUX_FDT_phycore-stm32mp1-2 = "${@bb.utils.contains('MACHINE_FEATURES', 'phy-expansions', '', '/phycore-stm32mp1-2.dtb', d)}"
```

## conf/machine/include/phytec-machine-extlinux-config-phycore-stm32mp1-4.inc
```bitbake
#@DESCRIPTION: phycore-stm32mp1-4 machine extlinux file configuration

# -----------------------------------------------------------------------------
# Append specific examples configs
# -----------------------------------------------------------------------------
# Define new label(s) to append to the label list from current target
# UBOOT_EXTLINUX_TARGETS_EXTRA_CONFIG[extra-target] = "newlabel1 newlabel2"
# This will create new 'extlinux.conf' file with name 'extra-target_extlinux.conf'
# that will use UBOOT_EXTLINUX_LABELS label list defined for current target plus
# the 'newlabel1' and 'newlabel2' labels.
# -----------------------------------------------------------------------------
# Define extra label configuration
UBOOT_EXTLINUX_TARGETS_EXTRA_CONFIG[stm32mp157f-phycore-som-emmc-1gib] += "phycore-stm32mp1-4-a7-examples"
UBOOT_EXTLINUX_TARGETS_EXTRA_CONFIG[stm32mp157f-phycore-som-emmc-1gib] += "phycore-stm32mp1-4-m4-examples"

# -----------------------------------------------------------------------------
# Configure A7 examples labels
# -----------------------------------------------------------------------------
# Define MENU DESCRIPTION overrides for new A7 labels
UBOOT_EXTLINUX_MENU_DESCRIPTION:phycore-stm32mp1-4-a7-examples = "stm32mp157f-phyboard-sargas-rdk-emmc-a7-examples"
# Define FDT overrides for new A7 labels
UBOOT_EXTLINUX_FDT:phycore-stm32mp1-4-a7-examples = "/${LINUX_A7_EXAMPLES_DT}.dtb"

# -----------------------------------------------------------------------------
# Configure M4 examples labels
# -----------------------------------------------------------------------------
# Define MENU DESCRIPTION overrides for new M4 labels
UBOOT_EXTLINUX_MENU_DESCRIPTION:phycore-stm32mp1-4-m4-examples = "stm32mp157f-phyboard-sargas-rdk-emmc-m4-examples"
# Define FDT overrides for new M4 labels
UBOOT_EXTLINUX_FDT:phycore-stm32mp1-4-m4-examples = "/${CUBE_M4_EXAMPLES_DT}.dtb"

# -----------------------------------------------------------------------------
# Define FDT override for Default label
# -----------------------------------------------------------------------------
UBOOT_EXTLINUX_FDT:phycore-stm32mp1-4 = "${@bb.utils.contains('MACHINE_FEATURES', 'phy-expansions', '', '/${KERNEL_DT}.dtb', d)}"
```

## conf/machine/include/phytec-machine-extlinux-config-phycore-stm32mp1-6.inc
```bitbake
#@DESCRIPTION: phycore-stm32mp1-6 machine extlinux file configuration

# -----------------------------------------------------------------------------
# Append specific examples configs
# -----------------------------------------------------------------------------
# Define new label(s) to append to the label list from current target
# UBOOT_EXTLINUX_TARGETS_EXTRA_CONFIG[extra-target] = "newlabel1 newlabel2"
# This will create new 'extlinux.conf' file with name 'extra-target_extlinux.conf'
# that will use UBOOT_EXTLINUX_LABELS label list defined for current target plus
# the 'newlabel1' and 'newlabel2' labels.
# -----------------------------------------------------------------------------
# Define extra label configuration
UBOOT_EXTLINUX_TARGETS_EXTRA_CONFIG[stm32mp153a-phycore-som-nand-512mb] += "phycore-stm32mp1-6-a7-examples"
UBOOT_EXTLINUX_TARGETS_EXTRA_CONFIG[stm32mp153a-phycore-som-nand-512mb] += "phycore-stm32mp1-6-m4-examples"

# -----------------------------------------------------------------------------
# Configure A7 examples labels
# -----------------------------------------------------------------------------
# Define MENU DESCRIPTION overrides for new A7 labels
UBOOT_EXTLINUX_MENU_DESCRIPTION:phycore-stm32mp1-6-a7-examples = "stm32mp153a-phyboard-sargas-rdk-nand-a7-examples"
# Define FDT overrides for new A7 labels
UBOOT_EXTLINUX_FDT:phycore-stm32mp1-6-a7-examples = "/${LINUX_A7_EXAMPLES_DT}.dtb"

# -----------------------------------------------------------------------------
# Configure M4 examples labels
# -----------------------------------------------------------------------------
# Define MENU DESCRIPTION overrides for new M4 labels
UBOOT_EXTLINUX_MENU_DESCRIPTION:phycore-stm32mp1-6-m4-examples = "stm32mp153a-phyboard-sargas-rdk-nand-m4-examples"
# Define FDT overrides for new M4 labels
UBOOT_EXTLINUX_FDT:phycore-stm32mp1-6-m4-examples = "/${CUBE_M4_EXAMPLES_DT}.dtb"

# -----------------------------------------------------------------------------
# Define FDT override for Default label
# -----------------------------------------------------------------------------
UBOOT_EXTLINUX_FDT:phycore-stm32mp1-6 = "${@bb.utils.contains('MACHINE_FEATURES', 'phy-expansions', '', '/${KERNEL_DT}.dtb', d)}"
```

## conf/machine/include/phytec-machine-extlinux-config-phycore-stm32mp1-7.inc
```bitbake
#@DESCRIPTION: STM32MP machine extlinux file configuration

# Set configuration file to monitor
UBOOT_EXTLINUX_CONFIGURE_FILES_append = " ${PHYCORE_STM32MP_BASE}/conf/machine/include/phytec-machine-extlinux-config-phycore-stm32mp1-7.inc:True "

include conf/machine/include/phytec-machine-extlinux-config-stm32mp.inc

# -----------------------------------------------------------------------------
# PHYCORE STM32mp1-7 configuration
# -----------------------------------------------------------------------------
# Define available targets to use
UBOOT_EXTLINUX_CONFIGURED_TARGETS += "mp1-7_sdcard"
UBOOT_EXTLINUX_CONFIGURED_TARGETS += "mp1-7_nand"
UBOOT_EXTLINUX_CONFIGURED_TARGETS += "mp1-7_nor-nand"
# Define bootprefix for each target
UBOOT_EXTLINUX_BOOTPREFIXES_mp1-7_sdcard       = "${EXTLINUX_BOOTDEVICE_SDCARD}_phycore-stm32mp1-7_"
UBOOT_EXTLINUX_BOOTPREFIXES_mp1-7_nand = "${EXTLINUX_BOOTDEVICE_NAND}_phycore-stm32mp1-7_"
UBOOT_EXTLINUX_BOOTPREFIXES_mp1-7_nor-nand = "${EXTLINUX_BOOTDEVICE_NAND}_phycore-stm32mp1-7_"
# Define labels for each target
UBOOT_EXTLINUX_LABELS_mp1-7_sdcard       = "phycore-stm32mp1-7-sdcard"
UBOOT_EXTLINUX_LABELS_mp1-7_nand = "phycore-stm32mp1-7-nand"
UBOOT_EXTLINUX_LABELS_mp1-7_nor-nand = "phycore-stm32mp1-7-nor-nand"
# Define default boot config for each target
UBOOT_EXTLINUX_DEFAULT_LABEL_mp1-7_sdcard       ?= "phycore-stm32mp1-7-sdcard"
UBOOT_EXTLINUX_DEFAULT_LABEL_mp1-7_nand ?= "phycore-stm32mp1-7-nand"
UBOOT_EXTLINUX_DEFAULT_LABEL_mp1-7_nor-nand ?= "phycore-stm32mp1-7-nor-nand"
# Define FDT overrides for all labels
UBOOT_EXTLINUX_FDT_phycore-stm32mp1-7-sdcard       = "/phycore-stm32mp1-7.dtb"
UBOOT_EXTLINUX_FDT_phycore-stm32mp1-7-nand = "/phycore-stm32mp1-7.dtb"
UBOOT_EXTLINUX_FDT_phycore-stm32mp1-7-nor-nand = "/phycore-stm32mp1-7.dtb"
# Define ROOT overrides for all labels
UBOOT_EXTLINUX_ROOT_phycore-stm32mp1-7-sdcard = "${EXTLINUX_ROOT_SDCARD}"
UBOOT_EXTLINUX_ROOT_phycore-stm32mp1-7-nand = "${EXTLINUX_ROOT_NAND}"
UBOOT_EXTLINUX_ROOT_phycore-stm32mp1-7-nor-nand = "${EXTLINUX_ROOT_NAND}"
# -----------------------------------------------------------------------------
# Append A7 examples labels for each target
UBOOT_EXTLINUX_LABELS_mp1-7_sdcard       += "phycore-stm32mp1-7-a7-examples-sdcard"
UBOOT_EXTLINUX_LABELS_mp1-7_nand += "phycore-stm32mp1-7-a7-examples-nand"
UBOOT_EXTLINUX_LABELS_mp1-7_nor-nand += "phycore-stm32mp1-7-a7-examples-nor-nand"
# Define FDT overrides for A7 labels
UBOOT_EXTLINUX_FDT_phycore-stm32mp1-7-a7-examples-sdcard       = "/phycore-stm32mp1-7-a7-examples.dtb"
UBOOT_EXTLINUX_FDT_phycore-stm32mp1-7-a7-examples-nand = "/phycore-stm32mp1-7-a7-examples.dtb"
UBOOT_EXTLINUX_FDT_phycore-stm32mp1-7-a7-examples-nor-nand = "/phycore-stm32mp1-7-a7-examples.dtb"
# Define ROOT overrides for A7 labels
UBOOT_EXTLINUX_ROOT_phycore-stm32mp1-7-a7-examples-sdcard       = "${EXTLINUX_ROOT_SDCARD}"
UBOOT_EXTLINUX_ROOT_phycore-stm32mp1-7-a7-examples-nand = "${EXTLINUX_ROOT_NAND}"
UBOOT_EXTLINUX_ROOT_phycore-stm32mp1-7-a7-examples-nor-nand = "${EXTLINUX_ROOT_NAND}"
# -----------------------------------------------------------------------------
# Append M4 examples labels for each target
UBOOT_EXTLINUX_LABELS_mp1-7_sdcard       += "phycore-stm32mp1-7-m4-examples-sdcard"
UBOOT_EXTLINUX_LABELS_mp1-7_nand += "phycore-stm32mp1-7-m4-examples-nand"
UBOOT_EXTLINUX_LABELS_mp1-7_nor-nand += "phycore-stm32mp1-7-m4-examples-nor-nand"
# Define FDT overrides for M4 labels
UBOOT_EXTLINUX_FDT_phycore-stm32mp1-7-m4-examples-sdcard       = "/phycore-stm32mp1-7-m4-examples.dtb"
UBOOT_EXTLINUX_FDT_phycore-stm32mp1-7-m4-examples-nand = "/phycore-stm32mp1-7-m4-examples.dtb"
UBOOT_EXTLINUX_FDT_phycore-stm32mp1-7-m4-examples-nor-nand = "/phycore-stm32mp1-7-m4-examples.dtb"
# Define ROOT overrides for M4 labels
UBOOT_EXTLINUX_ROOT_phycore-stm32mp1-7-m4-examples-sdcard       = "${EXTLINUX_ROOT_SDCARD}"
UBOOT_EXTLINUX_ROOT_phycore-stm32mp1-7-m4-examples-nand = "${EXTLINUX_ROOT_NAND}"
UBOOT_EXTLINUX_ROOT_phycore-stm32mp1-7-m4-examples-nor-nand = "${EXTLINUX_ROOT_NAND}"
```
