## conf/machine/include/phyam57xx.inc
```bitbake
require phytec-machine-common.inc

require conf/machine/include/am57xx.inc

# Sub-architecture support
MACHINE_SOCARCH = "${TUNE_PKGARCH}-am57xx"
PACKAGE_EXTRA_ARCHS:append = " ${MACHINE_SOCARCH}"

# Add machine features
MACHINE_FEATURES += "can touchscreen resistivetouch wifi bluetooth"

SERIAL_CONSOLES = "115200;ttyS2"

# Install modules in initramfs and roofs
PACKAGE_INSTALL:append = " kernel-modules"

# Install device-trees in rootfs
MACHINE_ESSENTIAL_EXTRA_RDEPENDS += "kernel-devicetree"

# Bootloader and kernel from meta-phytec
PREFERRED_PROVIDER_virtual/bootloader:${MACHINE} = "u-boot-ti"
PREFERRED_PROVIDER_u-boot = "u-boot-ti"
PREFERRED_PROVIDER_virtual/kernel:${MACHINE} = "linux-ti"
# Use standard binutils and gcc and not TI's packages
PREFERRED_RPROVIDER_binutils-cross-canadian-arm ?= "binutils-cross-canadian-arm"
PREFERRED_RPROVIDER_gcc-cross-canadian-arm ?= "gcc-cross-canadian-arm"
# Use standard wpa-supplicant and not the tools provide by wl18xx
PREFERRED_RPROVIDER_wpa-supplicant ?= "wpa-supplicant"
PREFERRED_RPROVIDER_wpa-supplicant-cli ?= "wpa-supplicant"
PREFERRED_RPROVIDER_wpa-supplicant-passphrase ?= "wpa-supplicant"

# Do not install uImage
KERNEL_IMAGETYPES:remove = "uImage"

# Do not build extlinux
UBOOT_EXTLINUX = "0"

# MLO and u-boot.img
IMAGE_BOOT_FILES = "${SPL_BINARY} u-boot.${UBOOT_SUFFIX}"

# WIC
WKS_FILES:am57xx ?= "am57xx-sdimage.wks"

# AM57x has SGX GPU core
PREFERRED_PROVIDER_virtual/gpudriver ?= "ti-sgx-ddk-km"

# Hardware cryptography
KERNEL_MODULE_AUTOLOAD += "cryptodev"

# Vivante GC320 2D accelerator
MACHINE_EXTRA_RRECOMMENDS:append:am57xx = " \
    ${@bb.utils.contains('MACHINE_FEATURES', 'gc320', \
    'ti-gc320-driver ti-gc320-libs-dev', '', d)} \
"

# Set the list of device targets for ti-pdk class recipes
TI_PDK_LIMIT_SOCS = "am571x am572x am574x"
TI_PDK_LIMIT_BOARDS = "evmAM571x evmAM572x idkAM571x idkAM572x idkAM574x"

# Set phytec-eeprom-flashtool to 2.00.01 (APIv1)
PREFERRED_VERSION_phytec-eeprom-flashtool = "2.00.01"
```

## conf/machine/include/phyam62axx-k3r5.inc
```bitbake
require conf/machine/include/phyk3r5.inc

PREFERRED_PROVIDER_virtual/bootloader ?= "u-boot-phytec"
PREFERRED_PROVIDER_u-boot ?= "u-boot-phytec"
```

## conf/machine/include/phyam62axx.inc
```bitbake
require conf/machine/include/phyk3.inc
require conf/machine/include/mc_k3r5.inc
SOC_FAMILY:append = ":am62axx"

TFA_BOARD = "lite"
OPTEEMACHINE = "k3-am62x"

MACHINE_ESSENTIAL_EXTRA_RRECOMMENDS += "cnm-wave-fw"

TFA_K3_SYSTEM_SUSPEND = "1"

MACHINE_FEATURES += "screen touchscreen"

# phyBOARD-Lyra downstream kernel overlays
KERNEL_OVERLAYS_PHYTEC = " \
    ti/k3-am62-phyboard-lyra-m2-cc3351.dtbo \
    ti/k3-am62-phyboard-lyra-vm016-mipi.dtbo \
    ti/k3-am62-phyboard-lyra-x17-spi0.dtbo \
"

# phyBOARD-Lyra overlays
KERNEL_OVERLAYS:phyboard-lyra = " \
    ti/k3-am62x-phyboard-lyra-gpio-fan.dtbo \
    ${@oe.utils.conditional("PREFERRED_PROVIDER_virtual/kernel", "linux-phytec-ti", "${KERNEL_OVERLAYS_PHYTEC}", "", d)} \
"

PREFERRED_PROVIDER_virtual/bootloader ?= "u-boot-phytec"
PREFERRED_PROVIDER_u-boot ?= "u-boot-phytec"
PREFERRED_PROVIDER_ti-sci-fw ?= "ti-firmware-sysfw"
PREFERRED_PROVIDER_ti-dm-fw ?= "ti-firmware-dm"

UBOOT_CAPSULE = "uboot-capsule.bin"
SPL_CAPSULE = "tispl-capsule.bin"
```

## conf/machine/include/phyam62lxx.inc
```bitbake
require conf/machine/include/phyk3.inc

SOC_FAMILY:append = ":am62lxx"

TFA_PLATFORM="am6x"
TFA_BOARD="phyflex-am62l"
OPTEEMACHINE = "k3-am62lx"

MACHINE_FEATURES += "screen touchscreen"

SERIAL_CONSOLES = "115200;ttyS3"
# Drop MAXSIZE
KERNEL_IMAGE_MAXSIZE ?= ""
```

## conf/machine/include/phyam62pxx.inc
```bitbake
require conf/machine/include/phyk3.inc
require conf/machine/include/mc_k3r5.inc
require conf/machine/include/mesa-pvr.inc

SOC_FAMILY:append = ":am62pxx"

TFA_BOARD = "lite"
OPTEEMACHINE = "k3-am62x"

TFA_K3_SYSTEM_SUSPEND = "1"

MACHINE_ESSENTIAL_EXTRA_RRECOMMENDS += "cnm-wave-fw"

MACHINE_FEATURES += "screen touchscreen pcie"

#phyBOARD-Lynx downstream kernel overlays
KERNEL_OVERLAYS_PHYTEC = " \
    ti/k3-am62p5-phyboard-lynx-oldi-lcd185.dtbo \
    ti/k3-am62p5-phyboard-lynx-dsi-lcd282.dtbo \
    ti/k3-am62p5-phyboard-lynx-m2-cc3351.dtbo \
    ti/k3-am62p5-phyboard-lynx-vm016-mipi.dtbo \
"

#phyBOARD_Lynx overlays
KERNEL_OVERLAYS:phyboard-lynx = " \
    ${@oe.utils.conditional("PREFERRED_PROVIDER_virtual/kernel", "linux-phytec-ti", "${KERNEL_OVERLAYS_PHYTEC}", "", d)} \
"
```

## conf/machine/include/phyam62xx-k3r5.inc
```bitbake
require conf/machine/include/phyk3r5.inc

PREFERRED_PROVIDER_virtual/bootloader ?= "u-boot-phytec"
PREFERRED_PROVIDER_u-boot ?= "u-boot-phytec"
PREFERRED_PROVIDER_ti-sci-fw ?= "ti-firmware-sysfw"

UBOOT_CAPSULE:k3r5 = "tiboot3-capsule.bin"
```

## conf/machine/include/phyam62xx.inc
```bitbake
require conf/machine/include/phyk3.inc
require conf/machine/include/mc_k3r5.inc
require conf/machine/include/mesa-pvr.inc
SOC_FAMILY:append = ":am62xx"

TFA_BOARD = "lite"
OPTEEMACHINE = "k3-am62x"

TFA_K3_SYSTEM_SUSPEND = "1"

MACHINE_FEATURES += "screen touchscreen"

# phyBOARD-Lyra downstream kernel overlays
KERNEL_OVERLAYS_PHYTEC = " \
    ti/k3-am62-phyboard-lyra-lpm.dtbo \
    ti/k3-am62-phyboard-lyra-m2-cc3351.dtbo \
    ti/k3-am62-phyboard-lyra-m2-lwb5p.dtbo \
    ti/k3-am62-phyboard-lyra-oldi-lcd185.dtbo \
    ti/k3-am62-phyboard-lyra-oldi-ac200.dtbo \
    ti/k3-am62-phyboard-lyra-oldi-ac209a.dtbo \
    ti/k3-am62-phyboard-lyra-vm016-mipi.dtbo \
    ti/k3-am62-phyboard-lyra-x17-spi0.dtbo \
    ti/k3-am62-phyboard-lyra-x17-evse.dtbo \
"

# phyBOARD-Lyra overlays
KERNEL_OVERLAYS:phyboard-lyra = " \
    ti/k3-am62x-phyboard-lyra-gpio-fan.dtbo \
    ${@oe.utils.conditional("PREFERRED_PROVIDER_virtual/kernel", "linux-phytec-ti", "${KERNEL_OVERLAYS_PHYTEC}", "", d)} \
"

PREFERRED_PROVIDER_virtual/bootloader ?= "u-boot-phytec"
PREFERRED_PROVIDER_u-boot ?= "u-boot-phytec"
PREFERRED_PROVIDER_ti-sci-fw ?= "ti-firmware"
PREFERRED_PROVIDER_ti-dm-fw ?= "ti-firmware"

UBOOT_CAPSULE = "uboot-capsule.bin"
SPL_CAPSULE = "tispl-capsule.bin"
```

## conf/machine/include/phyam64xx.inc
```bitbake
require conf/machine/include/phyk3.inc
require conf/machine/include/mc_k3r5.inc
SOC_FAMILY:append = ":am64xx"

TFA_BOARD = "lite"
OPTEEMACHINE = "k3-am64x"

MACHINE_ESSENTIAL_EXTRA_RRECOMMENDS += "ti-firmware-pru"

MACHINE_FEATURES += "pcie"

BBMULTICONFIG = "k3r5"

# phyBOARD-Electra downstream kernel overlays
KERNEL_OVERLAYS_PHYTEC = " \
    ti/k3-am642-phyboard-electra-peb-c-010.dtbo \
    ti/k3-am642-phyboard-electra-x27-gpio1-spi1-uart3.dtbo \
"

# phyBOARD-Electra overlays
KERNEL_OVERLAYS:phyboard-electra = " \
    ti/k3-am642-phyboard-electra-pcie-usb2.dtbo \
    ti/k3-am642-phyboard-electra-gpio-fan.dtbo \
    ${@oe.utils.conditional("PREFERRED_PROVIDER_virtual/kernel", "linux-phytec", "${KERNEL_OVERLAYS_PHYTEC}", "", d)} \
"

PREFERRED_PROVIDER_virtual/kernel ?= "linux-phytec"
PREFERRED_PROVIDER_virtual/bootloader ?= "u-boot-phytec"
PREFERRED_PROVIDER_u-boot ?= "u-boot-phytec"
PREFERRED_PROVIDER_ti-sci-fw ?= "ti-firmware-sysfw"

UBOOT_CAPSULE = "uboot-capsule.bin"
SPL_CAPSULE = "tispl-capsule.bin"
```

## conf/machine/include/phyam67xx.inc
```bitbake
require conf/machine/include/phyk3.inc
require conf/machine/include/mc_k3r5.inc
require conf/machine/include/mesa-pvr.inc

SOC_FAMILY:append = ":j722s:am67xx"

TFA_BOARD = "lite"
OPTEEMACHINE = "k3-am62x"

TFA_K3_SYSTEM_SUSPEND = "1"

MACHINE_ESSENTIAL_EXTRA_RRECOMMENDS += "cnm-wave-fw"

MACHINE_FEATURES += "screen touchscreen pcie"

#phyBOARD-Rigel downstream kernel overlays
KERNEL_OVERLAYS_PHYTEC = " \
    ti/k3-am6754-phyboard-rigel-dsi-lcd282.dtbo \
    ti/k3-am6754-phyboard-rigel-gpio-fan.dtbo \
    ti/k3-am6754-phyboard-rigel-m2-cc3351.dtbo \
    ti/k3-am6754-phyboard-rigel-mcu-mcans.dtbo \
    ti/k3-am6754-phyboard-rigel-oldi-lcd185.dtbo \
    ti/k3-am6754-phyboard-rigel-vm016-mipi-csi0.dtbo \
    ti/k3-am6754-phyboard-rigel-vm016-mipi-csi1.dtbo \
    ti/k3-am6754-phyboard-rigel-vm016-mipi-csi2.dtbo \
    ti/k3-am6754-phyboard-rigel-vm016-mipi-csi3.dtbo \
"

#phyBOARD_Rigel overlays
KERNEL_OVERLAYS:phyboard-rigel = " \
    ${@oe.utils.conditional("PREFERRED_PROVIDER_virtual/kernel", "linux-phytec-ti", "${KERNEL_OVERLAYS_PHYTEC}", "", d)} \
"
```

## conf/machine/include/phyam68x.inc
```bitbake
require conf/machine/include/phyk3.inc
require conf/machine/include/mc_k3r5.inc
require conf/machine/include/mesa-pvr.inc

SOC_FAMILY:append = ":j721s2"

MACHINE_ESSENTIAL_EXTRA_RRECOMMENDS += "cadence-mhdp-fw cnm-wave-fw"
MACHINE_FEATURES += "fan screen touchscreen pcie"

TFA_BOARD = "generic"
TFA_K3_USART = "0x8"
OPTEEMACHINE = "k3-j784s4"
OPTEE_K3_USART = "0x8"

KERNEL_DEVICETREE = " \
    ti/k3-am68-phyboard-izar.dtb \
    ti/k3-am68-phyboard-izar-dp.dtbo \
    ti/k3-am68-phyboard-izar-pwm-fan.dtbo \
    ti/k3-am68-phyboard-izar-peb-av-15.dtbo \
    ti/k3-am68-phyboard-izar-lvds-ph128800t006.dtbo \
    ti/k3-am68-phyboard-izar-vm016-mipi-csi0.dtbo \
    ti/k3-am68-phyboard-izar-vm016-mipi-csi1.dtbo \
    ti/k3-am68-phyboard-izar-vm017-mipi-csi0.dtbo \
    ti/k3-am68-phyboard-izar-vm017-mipi-csi1.dtbo \
    ti/k3-am68-phyboard-izar-vm020-mipi-csi0.dtbo \
    ti/k3-am68-phyboard-izar-vm020-mipi-csi1.dtbo \
"
```

## conf/machine/include/phyimx6.inc
```bitbake
require phytec-machine-common.inc

# Common settings for phytecs imx6 boards

include conf/machine/include/soc-family.inc

SOC_FAMILY = "imx-generic-bsp:mx6-generic-bsp"

#Bootloader
PREFERRED_PROVIDER_virtual/bootloader ?= "barebox"

# Kernel
PREFERRED_PROVIDER_virtual/kernel ?= "linux-phytec"
KERNEL_IMAGETYPE ?= "zImage"

# dont install kernelimage to rootfs
RRECOMMENDS:${KERNEL_PACKAGE_NAME}-base = ""

# XServer
PREFERRED_PROVIDER_virtual/xserver ?= "xserver-xorg"
# We don't support a Xserver yet.
#XSERVER_DRIVER = "xf86-video-fbdev"
#XSERVER_DRIVER:mx6 = "xf86-video-imxfb-vivante"
#XSERVER = "xserver-xorg \
#           xf86-input-evdev \
#           ${XSERVER_DRIVER}"

# Ship kernel modules
MACHINE_EXTRA_RRECOMMENDS = "kernel-modules"
MACHINE_EXTRA_RDEPENDS = "firmware-imx-sdma-imx6q"

SERIAL_CONSOLES = "115200;ttymxc0"

MACHINE_FEATURES = "apm usbgadget usbhost vfat caam gpu screen"


#WIC
IMAGE_CLASSES += "wic-helper"
EXTERNAL_KERNEL_DEVICETREE ??= ""
IMAGE_BOOT_FILES = "${@bb.utils.contains('DISTRO_FEATURES', 'secureboot', \
    'fitImage', \
    'zImage oftree ${EXTERNAL_KERNEL_DEVICETREE}', d)}"
BAREBOX_BINARY = "${@bb.utils.contains('DISTRO_FEATURES', 'secureboot', \
    'barebox-s.bin', 'barebox.bin', d)}"
WKS_FILES:mx6-generic-bsp ?= "imx6-sdimage.wks"
WKS_BOOTIMAGESIZE ?= "${@bb.utils.contains('DISTRO_FEATURES', 'secureboot', '90', '20', d)}"

# MMC user area bootloader image offset
BOOTLOADER_SEEK:mx6-generic-bsp ?= "1"
# eMMC boot partition bootloader image offset
BOOTLOADER_SEEK_EMMC:mx6-generic-bsp ?= "0"

# Device information used by RAUC and some of its dependencies
EMMC_DEV:mx6-generic-bsp ?= "3"
NAND_DEV:mx6-generic-bsp ?= "0"

# partup
IMAGE_CLASSES += "image-types-partup"
require partup-layout-config.inc

# default images to build
IMAGE_FSTYPES ?= " \
    tar.gz wic wic.bmap partup \
    ${@bb.utils.contains('MACHINE_FEATURES', 'emmc', '', 'ubifs', d)} \
"
IMAGE_FSTYPES:update = " \
    ${@bb.utils.contains('MACHINE_FEATURES', 'emmc', 'partup', 'ubifs', d)} \
"
```

## conf/machine/include/phyimx6qdl.inc
```bitbake
# Common settings for phytecs imx6qdl boards
DEFAULTTUNE ?= "cortexa9thf-neon"

include conf/machine/include/phyimx6.inc
include conf/machine/include/arm/armv7a/tune-cortexa9.inc

SERIAL_CONSOLES ?= "115200;ttymxc3"

# Sub-architecture support
MACHINE_SOCARCH = "${TUNE_PKGARCH}-mx6qdl"
PACKAGE_EXTRA_ARCHS:append = " ${MACHINE_SOCARCH}"

# cpu feature overwrite support
MACHINEOVERRIDES .= ":imxgpu3d"

# Use the expected value of the ubifs filesystem's volume name in the kernel
UBI_VOLNAME = "root"
# The biggest NANDs on current modules are 1GB. With current partition layout,
# this sums up to 7943 LEBs available for the ubifs
MKUBIFS_ARGS = "-F -m 2048 -e 126976 -c 8083"
UBINIZE_ARGS = "-m 2048 -p 128KiB -s 2048 -O 2048"

# mx6 GPU libraries
PREFERRED_PROVIDER_virtual/egl ?= "mesa"
PREFERRED_PROVIDER_virtual/libgles1 ?= "mesa"
PREFERRED_PROVIDER_virtual/libgles2 ?= "mesa"
PREFERRED_PROVIDER_virtual/libgl ?= "mesa"

# Firmware files
MACHINE_EXTRA_RRECOMMENDS:append:mx6q-generic-bsp = " firmware-imx-vpu-mx6q"
MACHINE_EXTRA_RRECOMMENDS:append:mx6dl-generic-bsp = " firmware-imx-vpu-mx6dl"
PREFERRED_VERSION_firmware-imx = "5.4"

# Install devicetree overlays
DT_OVERLAYS_INSTALL = " \
    imx6-cam-0-lvds.dtbo \
    imx6-vm009-0.dtbo \
    imx6-vm010-bw-0.dtbo \
    imx6-vm010-col-0.dtbo \
    imx6-vm011-bw-0.dtbo \
    imx6-vm011-col-0.dtbo \
    imx6-vm012-bw-0.dtbo \
    imx6-vm012-col-0.dtbo \
    imx6-vm016-0.dtbo \
    imx6-vm050-0.dtbo \
"

DT_OVERLAYS_INSTALL:append:phyboard-mira-imx6 = " \
    imx6-phy-adin1300.dtbo \
    imx6-phy-ksz9131.dtbo \
"

DT_OVERLAYS_INSTALL:append:phyboard-nunki-imx6 = " \
    imx6-phy-adin1300.dtbo \
    imx6-phy-ksz9131.dtbo \
"

KERNEL_DEVICETREE:append:phyboard-mira-imx6 = " \
    overlays/imx6-phy-adin1300.dtbo \
    overlays/imx6-phy-ksz9131.dtbo \
"

KERNEL_DEVICETREE:append:phyboard-nunki-imx6 = " \
    overlays/imx6-phy-adin1300.dtbo \
    overlays/imx6-phy-ksz9131.dtbo \
"
```
