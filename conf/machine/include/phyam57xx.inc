## conf/machine/include/phyimx6ul.inc
```bitbake
require phytec-machine-common.inc

# Common settings for phytecs imx6ul boards
include conf/machine/include/soc-family.inc

SOC_FAMILY .= "imx-generic-bsp:mx6ul-generic-bsp"

DEFAULTTUNE ?= "cortexa7thf-neon-vfpv4"
include conf/machine/include/arm/armv7a/tune-cortexa7.inc

SERIAL_CONSOLES ?= "115200;ttymxc0"

# Sub-architecture support
MACHINE_SOCARCH = "${TUNE_PKGARCH}-mx6ul"
PACKAGE_EXTRA_ARCHS:append = " ${MACHINE_SOCARCH}"

#Bootloader
PREFERRED_PROVIDER_virtual/bootloader ?= "barebox"

# Kernel
PREFERRED_PROVIDER_virtual/kernel ?= "linux-phytec"
KERNEL_IMAGETYPE ?= "zImage"

# Ship kernel modules
MACHINE_EXTRA_RRECOMMENDS = "kernel-modules"
MACHINE_EXTRA_RDEPENDS = "firmware-imx-sdma-imx6q"

# dont install kernelimage to rootfs
RRECOMMENDS:${KERNEL_PACKAGE_NAME}-base = ""

# cpu feature overwrite support
MACHINEOVERRIDES .= ":imxpxp"

MACHINE_FEATURES = "apm camera usbgadget usbhost vfat"

QT_QPA_PLATFORM ?= "linuxfb"

# Use the expected value of the ubifs filesystem's volume name in the kernel
UBI_VOLNAME = "root"
# The biggest NANDs on current modules are 1GB. With current partition layout,
# this sums up to 7943 LEBs available for the ubifs
MKUBIFS_ARGS = "-F -m 2048 -e 126976 -c 7943"
UBINIZE_ARGS = "-m 2048 -p 128KiB -s 2048 -O 2048"

#WIC
IMAGE_CLASSES += "wic-helper"
EXTERNAL_KERNEL_DEVICETREE ??= ""
IMAGE_BOOT_FILES = "zImage oftree ${EXTERNAL_KERNEL_DEVICETREE}"
IMAGE_BOOT_FILES:secureboot = "fitImage"
BAREBOX_BINARY = "barebox.bin"
BAREBOX_BINARY:secureboot = "barebox-s.bin"
WKS_FILES:mx6ul-generic-bsp ?= "imx6-sdimage.wks"
WKS_BOOTIMAGESIZE ?= "20"
WKS_BOOTIMAGESIZE:secureboot ?= "60"

# MMC user area bootloader image offset
BOOTLOADER_SEEK:mx6ul-generic-bsp ?= "1"
# eMMC boot partition bootloader image offset
BOOTLOADER_SEEK_EMMC:mx6ul-generic-bsp ?= "0"

# Device information used by RAUC and some of its dependencies
EMMC_DEV:mx6ul-generic-bsp ?= "1"
NAND_DEV:mx6ul-generic-bsp ?= "0"

# partup
IMAGE_CLASSES += "image-types-partup"
require partup-layout-config.inc

# default images to build
IMAGE_FSTYPES ?= " \
    tar.gz wic wic.bmap partup \
    ${@bb.utils.contains('MACHINE_FEATURES', 'emmc', '', 'ubifs', d)} \
"
IMAGE_FSTYPES:update = " \
    ${@bb.utils.contains('MACHINE_FEATURES', 'emmc', 'partup', 'ubifs', d)} \
"

# Avoid pulling package 'gstreamer1.0-plugins-bad-meta' into the image
# 'core-image-sato', because the recipe gstreamer1.0-plugins-bad depends on
# virtual/libgles2.
RRECOMMENDS:gst-examples-bin:remove:pn-gst-examples = "gstreamer1.0-plugins-bad-meta"

# XServer
PREFERRED_PROVIDER_virtual/xserver ?= "xserver-xorg"
# We don't support a Xserver yet.
# Don't build the X server with xwayland support. It depends on libepoxy
# (OpenGL function pointer management library) that depends on EGL.
PACKAGECONFIG:remove:pn-xserver-xorg = "xwayland"

# Disable gstreamer plugins by default
PACKAGECONFIG:pn-gstreamer1.0-plugins-imx = ""

# Install devicetree overlays
DT_OVERLAYS_INSTALL = " \
    imx6ul-vm009.dtbo \
    imx6ul-vm010-bw.dtbo \
    imx6ul-vm010-col.dtbo \
    imx6ul-vm011-bw.dtbo \
    imx6ul-vm011-col.dtbo \
    imx6ul-vm016.dtbo \
"
```

## conf/machine/include/phyimx7.inc
```bitbake
require phytec-machine-common.inc

# Common settings for PHYTEC's i.MX7 boards

PREFERRED_PROVIDER_virtual/kernel = "linux-imx"
PREFERRED_PROVIDER_virtual/bootloader = "u-boot-phytec-imx"
PREFERRED_PROVIDER_u-boot = "u-boot-phytec-imx"

# UBIFS
UBI_VOLNAME = "root"
MKUBIFS_ARGS = "-F -m 2048 -e 126976 -c 1912"
UBINIZE_ARGS = "-m 2048 -p 128KiB -s 2048 -O 2048"

# WIC
IMAGE_CLASSES += "wic-helper"
IMAGE_CLASSES:append:mx7-nxp-bsp = " wic-bootenv-helper"
EXTERNAL_KERNEL_DEVICETREE ??= ""
IMAGE_BOOT_FILES += "oftree ${EXTERNAL_KERNEL_DEVICETREE} bootenv.txt"
WKS_FILES:mx7-nxp-bsp ?= "imx7-sdimage.wks"
WKS_BOOTIMAGESIZE ?= "20"

# MMC user area bootloader image offset
BOOTLOADER_SEEK:mx7-generic-bsp ?= "1"
# eMMC boot partition bootloader image offset
BOOTLOADER_SEEK_EMMC:mx7-generic-bsp ?= "1"

# Device information used by RAUC and some of its dependencies
EMMC_DEV:mx7-generic-bsp ?= "2"

# partup
IMAGE_CLASSES += "image-types-partup"
include partup-layout-config.inc

# Default images to build
IMAGE_FSTYPES = " \
    tar.xz \
    wic \
    ${@bb.utils.contains("MACHINE_FEATURES", "nand", "ubifs", "", d)} \
    ${@bb.utils.contains("MACHINE_FEATURES", "emmc", "partup", "", d)} \
"
IMAGE_FSTYPES:update = "partup"
```

## conf/machine/include/phyimx8.inc
```bitbake
require phytec-machine-common.inc

# Common settings for PHYTEC's i.MX8 boards

PREFERRED_PROVIDER_virtual/bootloader ?= "u-boot-master"
PREFERRED_PROVIDER_virtual/bootloader:mx8-nxp-bsp ?= "u-boot-phytec-imx"
PREFERRED_PROVIDER_virtual/kernel ?= "linux-yocto-dev"
PREFERRED_PROVIDER_virtual/kernel:mx8-nxp-bsp ?= "linux-phytec-imx"
PREFERRED_PROVIDER_imx-boot = "imx-boot-phytec"
PREFERRED_PROVIDER_opencl-headers:imxgpu = "imx-gpu-viv"
PREFERRED_PROVIDER_linux-imx-mfgtool:mx8-nxp-bsp = "linux-imx-mfgtool"
PREFERRED_PROVIDER_virtual/libgles3:mx8-nxp-bsp = "imx-gpu-viv"

# dont install kernelimage to rootfs
RRECOMMENDS:${KERNEL_PACKAGE_NAME}-base = ""

# remove ath10k firmware to save space
MACHINE_FIRMWARE:remove:mx8-nxp-bsp = "linux-firmware-ath10k"

KERNEL_MODULE_AUTOLOAD += " cryptodev"

# Wic
IMAGE_CLASSES += "wic-helper"
IMAGE_CLASSES:append:mx8-nxp-bsp = " wic-imx8-helper"
EXTERNAL_KERNEL_DEVICETREE ??= ""
IMAGE_BOOT_FILES += "oftree ${EXTERNAL_KERNEL_DEVICETREE}"
WKS_FILES:mx8m-generic-bsp ?= "imx8m-sdimage.wks"
WKS_FILES:mx8x-nxp-bsp ?= "imx8x-sdimage.wks"
WKS_BOOTIMAGESIZE ?= "50"
WIC_CREATE_EXTRA_ARGS:remove = "--no-fstab-update"

IMX_DEFAULT_ATF_PROVIDER:use-mainline-bsp ?= "trusted-firmware-a"
# MMC user area bootloader image offset
BOOTLOADER_SEEK:mx8m-generic-bsp ?= "33"
BOOTLOADER_SEEK:mx8mn-generic-bsp ?= "32"
BOOTLOADER_SEEK:mx8mp-generic-bsp ?= "32"
BOOTLOADER_SEEK:mx8x-generic-bsp ?= "32"
# eMMC boot partition bootloader image offset
BOOTLOADER_SEEK_EMMC:mx8m-generic-bsp ?= "33"
BOOTLOADER_SEEK_EMMC:mx8mn-generic-bsp ?= "0"
BOOTLOADER_SEEK_EMMC:mx8mp-generic-bsp ?= "0"

UBOOT_ARCH = "arm64"
UBOOT_BINARY = "flash.bin"

# Device information used by RAUC and some of its dependencies
EMMC_DEV:mx8mq-generic-bsp ?= "0"
EMMC_DEV:mx8mm-generic-bsp ?= "2"
EMMC_DEV:mx8mn-generic-bsp ?= "2"
EMMC_DEV:mx8mp-generic-bsp ?= "2"

# partup
IMAGE_CLASSES += "image-types-partup"
include partup-layout-config.inc

# Default images to build
IMAGE_FSTYPES = "tar.gz wic.xz wic.bmap partup"
IMAGE_FSTYPES:update = "partup"

MACHINE_FEATURES:use-nxp-bsp += "caam optee"
MACHINE_FEATURES:remove:mx8x-nxp-bsp = " optee"

QEMUVERSION = "8.2%"
```

## conf/machine/include/phyimx8m.inc
```bitbake
# Common settings for PHYTEC's i.MX8M boards
include conf/machine/include/phyimx8.inc
require conf/machine/include/arm/armv8a/tune-cortexa53.inc

MACHINE_FEATURES += "emmc pci wifi bluetooth"
MACHINE_FEATURES:remove = "nxp8987"

DEBUG_PREFIX_MAP:remove = "-fcanon-prefix-map"

IMAGE_BOOT_FILES = "fitImage boot.scr.uimg"
IMAGE_BOOT_FILES:mx8m-nxp-bsp = "fitImage overlays.txt boot.scr.uimg"
IMAGE_BOOT_FILES:mx8m-nxp-bsp:secureboot = "fitImage overlays.txt"

# fdt_addr_r
UBOOT_DTB_LOADADDRESS ?= "0x40480000"
# fdtoverlay_addr_r
UBOOT_DTBO_LOADADDRESS ?= "0x404a0000"
# kernel_addr_r
UBOOT_LOADADDRESS ?= "0x40a00000"

KERNEL_CLASSES += "kernel-fitimage"
KERNEL_IMAGETYPES += "fitImage"

ATF_BOOT_UART_BASE = "auto"
TFA_BUILD_TARGET = "bl31"
TFA_PLATFORM = "${ATF_PLATFORM}"

INITRAMFS_MAXSIZE = "262144"
```

## conf/machine/include/phyimx8x.inc
```bitbake
# Common settings for PHYTEC's i.MX8X boards
include conf/machine/include/phyimx8.inc
require conf/machine/include/arm/armv8a/tune-cortexa35.inc
```

## conf/machine/include/phyimx91.inc
```bitbake
require phytec-machine-common.inc

# Common settings for PHYTEC's i.MX91 boards
require conf/machine/include/arm/armv8-2a/tune-cortexa55.inc

PREFERRED_PROVIDER_virtual/bootloader ?= "u-boot-phytec-imx"
PREFERRED_PROVIDER_virtual/kernel ?= "linux-phytec-imx"

# Don't install kernelimage to rootfs
RRECOMMENDS:${KERNEL_PACKAGE_NAME}-base = ""

# Wic
IMAGE_CLASSES += "wic-helper"
IMAGE_CLASSES:append:mx91-nxp-bsp = " wic-bootenv-helper"
WKS_FILES:mx91-generic-bsp ?= "imx9-sdimage.wks"
WKS_BOOTIMAGESIZE ?= "64"

# MMC user area bootloader image offset
BOOTLOADER_SEEK:mx91-generic-bsp ?= "32"
# eMMC boot partition bootloader image offset
BOOTLOADER_SEEK_EMMC:mx91-generic-bsp ?= "0"
# Device information used by RAUC and some of its dependencies
EMMC_DEV:mx91-generic-bsp ?= "0"

IMAGE_BOOT_FILES = "fitImage overlays.txt boot.scr.uimg"
IMAGE_BOOT_FILES:secureboot:mx91-nxp-bsp = "fitImage boot.scr.uimg"

UBOOT_ARCH = "arm64"
UBOOT_LOADADDRESS = "0x88000000"
UBOOT_ENTRYPOINT = "0x88000000"
UBOOT_DTB_LOADADDRESS = "0x8A380000"
UBOOT_DTBO_LOADADDRESS = "0x8A440000"

KERNEL_CLASSES += "kernel-fit-extra-artifacts"
IMAGE_INSTALL:append = "linux-yocto-fitimage"

INITRAMFS_MAXSIZE = "262144"

# partup
IMAGE_CLASSES += "image-types-partup"
include partup-layout-config.inc

IMAGE_FSTYPES = "tar.gz wic.bmap wic.xz partup"
IMAGE_FSTYPES:update = "partup"

MACHINE_FEATURES += "optee wifi bluetooth"

QEMUVERSION = "8.2%"
```

## conf/machine/include/phyimx93.inc
```bitbake
require phytec-machine-common.inc

# Common settings for PHYTEC's i.MX93 boards
require conf/machine/include/arm/armv8-2a/tune-cortexa55.inc

PREFERRED_PROVIDER_virtual/bootloader ?= "u-boot-phytec-imx"
PREFERRED_PROVIDER_virtual/bootloader:use-mainline-bsp ?= "u-boot-master"
PREFERRED_PROVIDER_virtual/kernel ?= "linux-phytec-imx"
PREFERRED_PROVIDER_virtual/kernel:use-mainline-bsp ?= "linux-yocto-dev"

# Don't install kernelimage to rootfs
RRECOMMENDS:${KERNEL_PACKAGE_NAME}-base = ""

# Wic
IMAGE_CLASSES += "wic-helper"
IMAGE_CLASSES:append:mx93-nxp-bsp = " wic-bootenv-helper"
WKS_FILES:mx93-generic-bsp ?= "imx9-sdimage.wks"
WKS_BOOTIMAGESIZE ?= "64"

# MMC user area bootloader image offset
BOOTLOADER_SEEK:mx93-generic-bsp ?= "32"
# eMMC boot partition bootloader image offset
BOOTLOADER_SEEK_EMMC:mx93-generic-bsp ?= "0"
# Device information used by RAUC and some of its dependencies
EMMC_DEV:mx93-generic-bsp ?= "0"

IMAGE_BOOT_FILES = "fitImage bootenv.txt boot.scr.uimg"
IMAGE_BOOT_FILES:secureboot:mx93-nxp-bsp = "fitImage bootenv.txt"
IMAGE_BOOT_FILES:remove:use-mainline-bsp = "bootenv.txt"

UBOOT_ARCH = "arm64"
UBOOT_BINARY:use-mainline-bsp = "flash.bin"
UBOOT_LOADADDRESS = "0x88000000"
UBOOT_ENTRYPOINT = "0x88000000"
UBOOT_DTB_LOADADDRESS = "0x8A380000"
UBOOT_DTBO_LOADADDRESS = "0x8A440000"
UBOOT_PROVIDES_BOOT_CONTAINER:use-mainline-bsp = "1"

# TFA
IMX_DEFAULT_ATF_PROVIDER:use-mainline-bsp ?= "trusted-firmware-a"
TFA_BUILD_TARGET = "bl31"
TFA_PLATFORM = "${ATF_PLATFORM}"

INITRAMFS_MAXSIZE = "262144"

# M33 core demos (bootaux)
WKS_FILE_DEPENDS:append:use-nxp-bsp = " imx-m33-demos"
IMX_M33_DEMO_INSTALL ??= " \
    imx93-11x11-evk_m33_TCM_rpmsg_lite_str_echo_rtos.bin \
    imx93-11x11-evk_m33_TCM_rpmsg_lite_pingpong_rtos_linux_remote.bin \
    imx93-11x11-evk_m33_TCM_power_mode_switch.bin \
"
IMAGE_BOOT_FILES:append:use-nxp-bsp = "${IMX_M33_DEMO_INSTALL}"

# partup
IMAGE_CLASSES += "image-types-partup"
include partup-layout-config.inc

IMAGE_FSTYPES = "tar.gz wic.bmap wic.xz partup"
IMAGE_FSTYPES:update = "partup"

MACHINE_FEATURES += "optee wifi bluetooth"
MACHINE_FEATURES:remove:use-mainline-bsp = " optee"

QEMUVERSION = "8.2%"
```

## conf/machine/include/phyk3.inc
```bitbake
# TI K3 Aarch64 profile for Cortex-A53/A72 cores

SOC_FAMILY = "ti-soc"
require conf/machine/include/soc-family.inc
SOC_FAMILY:append = ":k3"

require conf/machine/include/arm/arch-arm64.inc

require phytec-machine-common.inc

KERNEL_CLASSES += "kernel-fit-extra-artifacts"

UBOOT_ARCH = "arm"
UBOOT_ENTRYPOINT = "0x81000000"
UBOOT_LOADADDRESS = "0x81000000"
UBOOT_RD_LOADADDRESS = "0x84000000"
UBOOT_RD_ENTRYPOINT = "0x84000000"
UBOOT_DTB_LOADADDRESS = "0x83000000"
UBOOT_DTBO_LOADADDRESS = "0x83080000"
UBOOT_DTBO_OFFSET = "0x00010000"

SPL_BINARY = "tispl.bin"
SPL_BINARYNAME = "tispl.bin"
UBOOT_SUFFIX = "img"
UBOOT_BINARY = "u-boot.${UBOOT_SUFFIX}"

EXTRA_IMAGEDEPENDS += "virtual/bootloader"

TFA_PLATFORM = "k3"

do_image_wic[depends] += "ti-boot-container:do_deploy"
do_image_partup[depends] += "ti-boot-container:do_deploy"
do_image_partup[depends] += "phytec-bootenv:do_deploy"

SERIAL_CONSOLES = "115200;ttyS2"

# Install modules in initramfs and roofs
MACHINE_EXTRA_RRECOMMENDS += "kernel-modules"
INITRAMFS_FSTYPES = "cpio.xz"

PREFERRED_PROVIDER_virtual/kernel ??= "linux-phytec-ti"
PREFERRED_PROVIDER_virtual/bootloader ??= "u-boot-phytec-ti"
PREFERRED_PROVIDER_u-boot ??= "u-boot-phytec-ti"
PREFERRED_PROVIDER_ti-sci-fw ??= "ti-sci-fw"
PREFERRED_PROVIDER_ti-dm-fw ??= "ti-dm-fw"

MACHINE_FEATURES = "apm usbgadget usbhost vfat ext2 alsa rtc optee efi"

# dont install kernelimage to rootfs
RRECOMMENDS:${KERNEL_PACKAGE_NAME}-base = ""

KERNEL_IMAGETYPE ?= "Image"
KERNEL_IMAGETYPES ?= "Image"

KERNEL_MODULE_AUTOLOAD += "cryptodev"

WKS_FILE = "${@bb.utils.contains("MACHINE_FEATURES", "efi", "k3-sdimage-efi.wks.in", "k3-sdimage.wks", d)}"
EMMC_DEV = "0"
# eMMC boot partition bootloader image offset
BOOTLOADER_SEEK_EMMC = "0"
# combined bootloader image for RAUC bootloader update
IMAGE_BOOTLOADER = "ti-boot-container"

def make_dtb_boot_files(d):
    # Generate IMAGE_BOOT_FILES entries for device tree files listed in
    # KERNEL_DEVICETREE.
    # Use only the basename for dtb files:
    alldtbs = d.getVar('KERNEL_DEVICETREE')


    # DTBs may be built out of kernel with devicetree.bbclass
    if not alldtbs:
        return ''

    def transform(dtb):
        if not (dtb.endswith('dtb') or dtb.endswith('dtbo')):
            # eg: whatever/bcm2708-rpi-b.dtb has:
            #     DEPLOYDIR file: bcm2708-rpi-b.dtb
            #     destination: bcm2708-rpi-b.dtb
            bb.error("KERNEL_DEVICETREE entry %s is not a .dtb or .dtbo file." % (dtb) )
        return os.path.basename(dtb)

    return ' '.join([transform(dtb) for dtb in alldtbs.split() if dtb])

K3_BOOTLOADER_FILES = "${SPL_BINARYNAME} u-boot.${UBOOT_SUFFIX} tiboot3.bin ti-boot-container.img"

IMAGE_BOOT_FILES = " \
    ${K3_BOOTLOADER_FILES} \
    ${KERNEL_IMAGETYPE} \
    ${@make_dtb_boot_files(d)} oftree \
    overlays.txt \
"
IMAGE_BOOT_FILES:secureboot = " \
    ${K3_BOOTLOADER_FILES} \
    fitImage \
"
IMAGE_EFI_BOOT_FILES ?= "${IMAGE_BOOT_FILES}"

EFI_PROVIDER ?= "grub-efi"

IMAGE_CLASSES += "image-types-partup wic-bootenv-helper"
include partup-layout-config.inc

IMAGE_FSTYPES = "tar.xz wic.xz wic.bmap partup"
IMAGE_FSTYPES:update = "partup"

# OSPI Flash Layout for initramfs
# 0x700000: FDT (max 1 MiB)
# 0x800000: Image (max 26 MiB) - linux-mainline uses defconfig
KERNEL_IMAGE_MAXSIZE ??= "${@oe.utils.conditional("PREFERRED_PROVIDER_virtual/kernel", "linux-mainline", "", "27262", d)}"
# 0x2200000: Initramfs (max 30 MiB)

# initramfs max size is 256 MiB
INITRAMFS_MAXSIZE ?= "262144"
```

## conf/machine/include/phyk3r5.inc
```bitbake
# TI K3 Armv7 profile for Cortex-R5F cores

SOC_FAMILY = "ti-soc"
require conf/machine/include/soc-family.inc
SOC_FAMILY:append = ":k3r5"

# The closest of existing tunes for Cortex-R5F
DEFAULTTUNE = "armv7athf"
require conf/machine/include/arm/armv7a/tune-cortexa8.inc

require phytec-machine-common.inc

# R5 u-boot
SPL_SUFFIX = "bin"
SPL_SYMLINK = "tiboot3.${SPL_SUFFIX}"
UBOOT_SUFFIX = "bin"
UBOOT_BINARY = "u-boot-r5spl.${UBOOT_SUFFIX}"
UBOOT_IMAGE = "u-boot-r5spl-${MAINMACHINE}-${PV}-${PR}.${UBOOT_SUFFIX}"
UBOOT_SYMLINK = "u-boot-r5spl-${MAINMACHINE}.${UBOOT_SUFFIX}"

MACHINE_ESSENTIAL_EXTRA_RDEPENDS += "kernel-devicetree"

PREFERRED_PROVIDER_virtual/kernel ??= "linux-dummy"
PREFERRED_PROVIDER_virtual/bootloader ??= "u-boot-phytec-ti"
PREFERRED_PROVIDER_u-boot ??= "u-boot-phytec-ti"
```
