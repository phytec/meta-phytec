## conf/machine/include/partup-layout-config.inc
```bitbake
PARTUP_ROOTFS_IMAGE_EXT_DEFAULT = "tar.gz"
PARTUP_ROOTFS_IMAGE_EXT_DEFAULT:update = "ext4"
PARTUP_ROOTFS_IMAGE_EXT ?= "${PARTUP_ROOTFS_IMAGE_EXT_DEFAULT}"
PARTUP_ROOT_FS ?= "${@bb.utils.contains('PARTUP_ROOTFS_IMAGE_EXT', 'tar.gz', 'ext4', 'null', d)}"
PARTUP_PACKAGE_FILES = " \
    ${BOOTLOADER_FILE} \
    ${PARTUP_BOOT_FILES} \
    ${IMAGE_LINK_NAME}.${PARTUP_ROOTFS_IMAGE_EXT} \
"
PARTUP_PACKAGE_DEPENDS ?= " \
    virtual/kernel \
    virtual/bootloader \
"

PARTUP_PACKAGE_FILES:append:update = " config-partition.ext4"
PARTUP_PACKAGE_DEPENDS:append:update = " config-partition"
PARTUP_PACKAGE_FILES:append:rauc-appfs = " rauc-appfs-example.tar.gz"
PARTUP_PACKAGE_DEPENDS:append:rauc-appfs = " rauc-appfs-example"

PARTUP_PACKAGE_DEPENDS:append:mx7-generic-bsp = " \
    phytec-bootenv \
"

PARTUP_PACKAGE_DEPENDS:append:mx8m-nxp-bsp = " \
    ${@oe.utils.ifelse(d.getVar('UBOOT_PROVIDES_BOOT_CONTAINER') == '0', '${IMAGE_BOOTLOADER}', '')} \
    phytec-bootenv \
"
PARTUP_PACKAGE_DEPENDS:append:mx9-generic-bsp = " \
    ${@oe.utils.ifelse(d.getVar('UBOOT_PROVIDES_BOOT_CONTAINER') == '0', '${IMAGE_BOOTLOADER}', '')} \
    phytec-bootenv \
"
PARTUP_PACKAGE_DEPENDS:append:mx93-nxp-bsp = " \
    imx-m33-demos \
"

PARTUP_PACKAGE_DEPENDS:append:j721s2 = " \
    phytec-bootenv \
"

PARTUP_LAYOUT_CONFIG ?= "layout-default.yaml"
PARTUP_LAYOUT_CONFIG:k3 ?= "layout-default-k3.yaml"
PARTUP_LAYOUT_CONFIG:update ?= "layout-rauc.yaml"
PARTUP_LAYOUT_CONFIG:update:k3 ?= "layout-rauc-k3.yaml"

PARTUP_SECTIONS += "clean appfs partitions"
PARTUP_SECTION_clean = "${@bb.utils.contains('PREFERRED_PROVIDER_virtual/bootloader', 'barebox', False, True, d)}"
PARTUP_SECTION_appfs = "${@bb.utils.contains('DISTRO_FEATURES', 'rauc-appfs', True, False, d)}"
PARTUP_SECTION_partitions = "1"

PARTUP_BOOT_FILES ??= "${IMAGE_BOOT_FILES}"
PARTUP_ARRAYS += "image_boot_files"
PARTUP_ARRAY_image_boot_files = "${PARTUP_BOOT_FILES}"

BOOTLOADER_SKIP ??= "${@bb.utils.contains('PREFERRED_PROVIDER_virtual/bootloader', 'barebox', 1, 0, d)}"
BOOTLOADER_SEEK ??= "1"
BOOTLOADER_FILE ??= "u-boot.bin"
BOOTLOADER_FILE:k3 ?= ""
BOOTLOADER_FILE:mx6-generic-bsp ?= "${BAREBOX_BINARY}"
BOOTLOADER_FILE:mx6ul-generic-bsp ?= "${BAREBOX_BINARY}"
BOOTLOADER_FILE:mx7-generic-bsp ?= "u-boot-with-spl.imx"
BOOTLOADER_FILE:mx8m-generic-bsp ?= "imx-boot"
BOOTLOADER_FILE:mx9-generic-bsp ?= "imx-boot"
UBOOT_ENV_OFFSET ??= "3840kiB"
UBOOT_ENV_OFFSET:k3 ?= "6656kiB"
UBOOT_ENV_OFFSET:mx9-generic-bsp ?= "7168kiB"
UBOOT_ENV_OFFSET_REDUND ??= "3968kiB"
UBOOT_ENV_OFFSET_REDUND:k3 ?= "6912kiB"
UBOOT_ENV_OFFSET_REDUND:mx91-generic-bsp ?= "7296kiB"
UBOOT_ENV_OFFSET_REDUND:mx93-generic-bsp ?= "7296kiB"
UBOOT_ENV_OFFSET_REDUND:mx95-generic-bsp ?= "7184kiB"
BOOT_PART_OFFSET ??= "4MiB"
BOOT_PART_OFFSET:mx9-generic-bsp ?= "8MiB"

do_layout_config[vardeps] += " \
    BOOTLOADER_SKIP \
    BOOTLOADER_SEEK \
    BOOTLOADER_FILE \
    UBOOT_ENV_OFFSET \
    UBOOT_ENV_OFFSET_REDUND \
    BOOT_PART_OFFSET \
"
```

## conf/machine/include/phyam335x.inc
```bitbake
require phytec-machine-common.inc

#Taken from TI yocto BSP Layer Version 05-2014, original name:ti33xx.inc
SOC_FAMILY = "ti-soc:ti33x"
require conf/machine/include/soc-family.inc
DEFAULTTUNE ?= "cortexa8thf-neon"
require conf/machine/include/arm/armv7a/tune-cortexa8.inc
# List common SoC features
MACHINE_FEATURES = "usbgadget usbhost vfat ext2 screen alsa ethernet can"

# Sub-architecture support adapted fom fsl-arm
MACHINE_SOCARCH = "${TUNE_PKGARCH}-ti33x"
PACKAGE_EXTRA_ARCHS:append = " ${MACHINE_SOCARCH}"

# Bootloader
PREFERRED_PROVIDER_virtual/bootloader ?= "barebox"
PREFERRED_PROVIDER_virtual/prebootloader ?= "barebox-ipl"
BAREBOX_IPL_IMAGE_NAME = "MLO-${MACHINE}-${PKGV}-${PKGR}${IMAGE_VERSION_SUFFIX}"
BAREBOX_IPL_BIN_LINK_NAME = "MLO"

# Kernel 
PREFERRED_PROVIDER_virtual/kernel ?= "linux-phytec"
PREFERRED_PROVIDER_amx3-cm3 ?= "amx3-cm3-phy"
KERNEL_IMAGETYPE ?= "zImage"
# Install modules in initramfs and rootfs
MACHINE_EXTRA_RRECOMMENDS += "kernel-modules"
KERNEL_MODULE_AUTOLOAD += " cryptodev"

SERIAL_CONSOLES ?= "115200;ttyS0"
# dont install kernelimage to rootfs
RRECOMMENDS:${KERNEL_PACKAGE_NAME}-base = ""

# rootfs images
# Use the expected value of the ubifs filesystem's volume name in the kernel
UBI_VOLNAME = "root"
# The biggest NANDs on current modules are 1GB. With current partition layout,
# this sums up to 7943 LEBs available for the ubifs
MKUBIFS_ARGS = "--min-io-size 2048 --leb-size 129024 --max-leb-cnt 7943 --space-fixup"
UBINIZE_ARGS = "--min-io-size 2048 --peb-size 128KiB --sub-page-size 512"

# xserver
PREFERRED_PROVIDER_virtual/xserver ?= "xserver-xorg"
# For built-in LCD, add xf86-input-tslib
XSERVER = "xserver-xorg \
           xf86-input-evdev \
           xf86-input-mouse \
           xf86-video-fbdev \
           xf86-input-keyboard"

# OpenGLES support for AM335x SGX Core
PREFERRED_PROVIDER_virtual/mesa ?= "mesa-pvr"
PREFERRED_PROVIDER_virtual/egl ?= "mesa-pvr"
PREFERRED_PROVIDER_virtual/libgles1 ?= "mesa-pvr"
PREFERRED_PROVIDER_virtual/libgles2 ?= "mesa-pvr"
PREFERRED_PROVIDER_virtual/libgles3 ?= "mesa-pvr"
PREFERRED_PROVIDER_virtual/libgbm ?= "mesa-pvr"
PREFERRED_PROVIDER_virtual/libglx ?= "mesa-pvr"
PREFERRED_PROVIDER_virtual/libgl ?= "mesa-pvr"

PREFERRED_PROVIDER_virtual/gpudriver ?= "ti-sgx-ddk-km"

QT_QPA_DEFAULT_PLATFORM ?= "${@bb.utils.contains('MACHINE_FEATURES', 'gpu', 'eglfs', 'linuxfb', d)}"

#WIC
IMAGE_CLASSES += "wic-helper"
IMAGE_CLASSES += "wic-am335x-helper"
EXTERNAL_KERNEL_DEVICETREE ??= ""
IMAGE_BOOT_FILES = "barebox.bin MLO zImage oftree ${EXTERNAL_KERNEL_DEVICETREE}"
do_image_wic[depends] += "\
    virtual/prebootloader:do_deploy \
"
WKS_FILES:ti33x ?= "am335x-sdimage.wks"
WKS_BOOTIMAGESIZE ?= "20"

# Device information used by RAUC and some of its dependencies
EMMC_DEV:ti33x ?= "1"
NAND_DEV:ti33x ?= "0"

# default images to build
IMAGE_FSTYPES ?= "tar.gz wic wic.bmap ext4 \
    ${@bb.utils.contains('MACHINE_FEATURES', 'emmc', 'emmc', 'ubifs', d)}"
```

## conf/machine/include/phyam57x6.inc
```bitbake
# TI AM57x6 SoCs without display/graphics support
include conf/machine/include/phyam57xx.inc

SOC_FAMILY:append = ":am57x6"

# Remove machine features
MACHINE_FEATURES:remove = "gpu mmip screen resistivetouch gc320"

QT_QPA_PLATFORM = ""
```

## conf/machine/include/phyam57xx-hs.inc
```bitbake
# U-Boot configuration for AM57x HS devices
UBOOT_MACHINE = "phycore_am57x_hs_defconfig"

UBOOT_ENTRYPOINT = "0x82000000"
UBOOT_LOADADDRESS = "0x82000000"
UBOOT_DTB_LOADADDRESS = "0x88000000"
UBOOT_DTBO_LOADADDRESS = "0x88080000"
UBOOT_DTBO_OFFSET = "0x00010000"
UBOOT_RD_LOADADDRESS = "0x84000000"
UBOOT_RD_ENTRYPOINT = "0x84000000"

# Enable binary signing with provided keys
UBOOT_SIGN_ENABLE = "1"
UBOOT_MKIMAGE_DTCOPTS = "-I dts -O dtb -p 2000"
UBOOT_SIGN_KEYDIR = "${TOPDIR}/keys"
UBOOT_SIGN_KEYNAME = "rsa2048_MPK_rel_1"
TI_SECURE_DEV_PKG = "${TOPDIR}/proc-sdk-secdev-01.06.00.05/am5x"

# OPTEE for AM57x
OPTEEMACHINE = "ti-am57xx"
OPTEEFLAVOR = "am57xx"
OPTEEOUTPUTMACHINE = "ti"
OPTEEPAGER = "y"

# FIT image for legacy HS devices
KERNEL_CLASSES += " kernel-fitimage-legacyhs"
KERNEL_IMAGETYPES += " fitImage"
```
