## conf/bblayers.conf.sample
```bitbake
# POKY_BBLAYERS_CONF_VERSION is increased each time build/conf/bblayers.conf
# changes incompatibly
POKY_BBLAYERS_CONF_VERSION = "2"

BBPATH = "${TOPDIR}"
BBFILES ?= ""

OEROOT := "##OEROOT##"
# add BSPDIR variable, as it is needed by recipes of NXP
BSPDIR := "${OEROOT}/../.."

# In our BSPs active layers are defined by the manifest.xml for all BSPs. The
# bblayers.conf gets created by the init_bblayers.py script.
BBLAYERS ?= ""
```

## conf/distro/openstlinux-tiny.conf
```bitbake
#@NAME: openstlinux-tiny
#@DESCRIPTION: PHYTEC custom light distro - no eglfs, no X11, no Wayland

require include/st-default-distro-rules.inc
require include/st-default-distro-providers.inc
require include/openstlinux-tiny.inc

# =========================================================================
# Distribution definition for: st-openstlinux-eglfs
# =========================================================================
DISTRO = "openstlinux-tiny"
DISTRO_NAME = "ST OpenSTLinux - Tiny - (A Yocto Project Based Distro)"

# Warning: TARGET_VENDOR does not contains a valid OS/ARCH name like : linux, arm
# Warning: '-' are forbidden between each word of TARGET_VENDOR
TARGET_VENDOR = "-openstlinux_tiny"
# Warning: '-' are forbidden between each word of SDK_VENDOR
SDK_VENDOR = "-openstlinux_tiny_sdk"

# =========================================================================
# DISTRO features
# =========================================================================
DISTRO_FEATURES_remove = " wayland x11 "
PNBLACKLIST[st-image-core] = "not buildable with yogurt-tiny use st-image-core-minimal"
PNBLACKLIST[st-image-weston] = "not buildable with yogurt-tiny use st-image-core-minimal"
```

## conf/layer.conf
```bitbake
# We have a conf and classes directory, add to BBPATH
BBPATH .= ":${LAYERDIR}"

# We have a recipes directory, add to BBFILES
BBFILES += "${LAYERDIR}/recipes-*/*/*.bb \
            ${LAYERDIR}/recipes-*/*/*.bbappend"


BBFILE_COLLECTIONS += "phytec"
BBFILE_PATTERN_phytec = "^${LAYERDIR}/"
BBFILE_PRIORITY_phytec = "20"
LAYERVERSION_phytec = "2"
LAYERDEPENDS_phytec = "core"
LAYERSERIES_COMPAT_phytec = "scarthgap"

# Additional license directories.
LICENSE_PATH += "${LAYERDIR}/licenses"

PHYCORE_STM32MP_BASE = "${LAYERDIR}"

# only activates content when identified layers are present,
# to ensure yocto compatibility check pass
BBFILES_DYNAMIC += " \
        fsl-bsp-release:${LAYERDIR}/dynamic-layers/fsl-bsp-release/recipes-*/*/*.bb \
        fsl-bsp-release:${LAYERDIR}/dynamic-layers/fsl-bsp-release/recipes-*/*/*.bbappend \
        freescale-layer:${LAYERDIR}/dynamic-layers/freescale-layer/recipes-*/*/*.bb \
        freescale-layer:${LAYERDIR}/dynamic-layers/freescale-layer/recipes-*/*/*.bbappend \
        meta-arm:${LAYERDIR}/dynamic-layers/meta-arm/recipes-*/*/*.bb \
        meta-arm:${LAYERDIR}/dynamic-layers/meta-arm/recipes-*/*/*.bbappend \
        meta-linux-mainline:${LAYERDIR}/dynamic-layers/meta-linux-mainline/*/*/*.bb \
        meta-linux-mainline:${LAYERDIR}/dynamic-layers/meta-linux-mainline/*/*/*.bbappend \
        meta-ti-bsp:${LAYERDIR}/dynamic-layers/meta-ti-bsp/recipes-*/*/*.bb \
        meta-ti-bsp:${LAYERDIR}/dynamic-layers/meta-ti-bsp/recipes-*/*/*.bbappend \
        openembedded-layer:${LAYERDIR}/dynamic-layers/openembedded-layer/recipes-*/*/*.bb \
        openembedded-layer:${LAYERDIR}/dynamic-layers/openembedded-layer/recipes-*/*/*.bbappend \
        stm-st-stm32mp:${LAYERDIR}/dynamic-layers/stm-st-stm32mp/recipes-*/*/*.bb \
        stm-st-stm32mp:${LAYERDIR}/dynamic-layers/stm-st-stm32mp/recipes-*/*/*.bbappend \
"
# layerrecommends need to be in sync with dynamic layers
# if not, the layer index will throw parsing errors
LAYERRECOMMENDS_phytec = "\
    fsl-bsp-release \
    freescale-layer \
    meta-arm \
    meta-linux-mainline \
    meta-ti-bsp \
    openembedded-layer \
    stm-st-stm32mp \
"

BBMASK:append:mx8m-nxp-bsp = " meta-imx/meta-bsp/recipes-graphics/imx-gpu-apitrace/imx-gpu-apitrace_10.0.0.bb"
BBMASK:append:imx-mainline-bsp = "\
    meta-freescale/recipes-security/optee-imx/ \
"
BBMASK:append:k3 = "\
    meta-ti/meta-ti-bsp/recipes-security/optee/ \
    meta-ti/meta-ti-bsp/recipes-bsp/trusted-firmware-a/ \
"
```

## conf/local.conf.sample
```bitbake
MACHINE ?= "UNASSIGNED"

DISTRO ?= "ampliphy"

########################
# global configuration #
########################

# That are the default values of bitbake.  Adapt these to your workspace and
# host preferences.
#DL_DIR = "${TOPDIR}/downloads"
#SSTATE_DIR = "${TOPDIR}/sstate-cache"

# License Handling
#  - Uncomment for i.MX6 proprietary GPU libraries
#LICENSE_FLAGS_WHITELIST += "license-nxp_v14-june-2016_imx-gpu-viv"
#  - Uncomment for Freescale i.MX6 VPU firmware blobs
#LICENSE_FLAGS_WHITELIST += "license-freescale_v12-march-2016_firmware-imx"

# build artifacts are deployed here
DEPLOY_DIR = "${TOPDIR}/deploy"

# enable bitbakes git shallow functionality: this reduces download volume
# from 7.3G to 1.6 G as of sumo. If you need the git history of a project,
# you can run a "git remote update" in the tmp dir, as the remotes are
# correctly specified
BB_GIT_SHALLOW = "1"

# Select configuration UI for linux and barebox recipe. The openembedded
# default is 'menuconfig', 'nconfig' has more features.
# busybox only supports menuconfig
#KCONFIG_CONFIG_COMMAND = "menuconfig"
KCONFIG_CONFIG_COMMAND = "nconfig"
KCONFIG_CONFIG_COMMAND_pn-busybox = "menuconfig"

# SDK will be build for that cpu
#SDKMACHINE ?= "x86_64"

# bitbake disk monitor setup
BB_DISKMON_DIRS ??= "\
    STOPTASKS,${TMPDIR},1G,100K \
    STOPTASKS,${DL_DIR},1G,100K \
    STOPTASKS,${SSTATE_DIR},1G,100K \
    STOPTASKS,/tmp,100M,100K \
    ABORT,${TMPDIR},100M,1K \
    ABORT,${DL_DIR},100M,1K \
    ABORT,${SSTATE_DIR},100M,1K \
    ABORT,/tmp,10M,1K"

#######################
# Image configuration #
#######################

# The following line disables the autostart of the phytec-qtdemo by
# default, but you can start the demo anytime using
#  $ systemctl start phytec-qtdemo.service
#SYSTEMD_AUTO_ENABLE_pn-phytec-qtdemo = "disable"

# You can disable and enable FSTYPES as you wish. e.g. 'ext4'.
# This variable is ordering dependend.
#IMAGE_FSTYPES = "tar.gz wic ubifs emmc"

# To change the variable for any imx8 machine:
#IMAGE_FSTYPES_mx8 = "tar.gz wic ubifs emmc"

# Turn on debugging options of the kernel
#DEBUG_BUILD_pn-linux-mainline = "1"
# Turn on debugging options of the imx kernel
#DEBUG_BUILD_pn-linux-imx = "1"
# Turn on debugging options of the barebox
#DEBUG_BUILD_pn-barebox = "1"

# Include kernel sources in SDK
TOOLCHAIN_TARGET_TASK_append = " kernel-devsrc"

# The default package class of the distro ampliphy is 'package_ipk'. The first
# value is used as the package manager to build the image and sdk. To build
# also tar packages use
#PACKAGE_CLASSES = "package_ipk package_tar"

# Variable IMAGE_ROOTFS_EXTRA_SPACE from poky/meta/conf/documentation.conf:
#   Defines additional free disk space created in the image in Kbytes. By
#   default, this variable is set to '0'.
# This example line adds an additional 512 MiB of free space to the root
# filesystem:
#IMAGE_ROOTFS_EXTRA_SPACE = "524288"

# See http://www.yoctoproject.org/docs/1.8/ref-manual/ref-manual.html#ref-features-image
#   "Through these variables, you can add several different predefined
#    packages such as development utilities or packages with debug information
#    needed to investigate application problems or profile applications
EXTRA_IMAGE_FEATURES = ""
# - "Makes an image suitable for development (e.g. allows root logins without
#    passwords and enables post-installation logging)"
EXTRA_IMAGE_FEATURES += "debug-tweaks"
# - "Installs debug symbol packages for all packages installed in a given
#    image."
#EXTRA_IMAGE_FEATURES += "dbg-pkgs"
# - "Installs debugging tools such as strace and gdb."
#EXTRA_IMAGE_FEATURES += "tools-debug"

######################
# rauc configuration #
######################

# certificate location for signing bundles
#CERT_PATH = "${TOPDIR}/../sources/meta-ampliphy/openssl-ca"

####################
# QT configuration #
####################

# We disable qt widgets per default to save about 10 MB of storage. If
# you need qt widget support, you can enable it with this line
#DISTRO_FEATURES_append = " qtwidgets"

CONF_VERSION = "1"

# Uncomment to accept NXP EULA (needed, if any NXP / freescale layer is used)
# EULA can then be found under ../sources/meta-freescale/EULA
#ACCEPT_FSL_EULA = "1"

# A TISDK BSP requires per default an external toolchain
# Provide a default path that is compatible to our TISDK docker image
TOOLCHAIN_BASE ?= "/opt/PHYTEC_BSPs"
```

## conf/machine/am62lxx-libra-fpsc-1.conf
```bitbake
#@TYPE: Machine
#@NAME: am62lxx-libra-fpsc-1
#@DESCRIPTION: PHYTEC AM62Lx Libra FPSC, 2GB RAM, HS-FS (deprecated)
#@ARTICLENUMBERS: PD-05035-001A.A0, PCL-082-PROTO-001.A0

include conf/machine/am62lxx-phyflex-libra-1.conf
```

## conf/machine/am62lxx-libra-fpsc-2.conf
```bitbake
#@TYPE: Machine
#@NAME: am62lxx-libra-fpsc-2
#@DESCRIPTION: PHYTEC AM62Lx Libra FPSC, 1GB RAM, HS-FS (deprecated)
#@ARTICLENUMBERS: PD-05035-002A.A0, PCL-082-PROTO-002.A0

include conf/machine/am62lxx-phyflex-libra-1.conf
```

## conf/machine/am62lxx-phyflex-libra-rdk-1.conf
```bitbake
#@TYPE: Machine
#@NAME: am62lxx-phyflex-libra-rdk-1
#@DESCRIPTION: PHYTEC AM62Lx phyFLEX Libra FPSC, 1-2GB RAM, HS-FS SR1.0
#@ARTICLENUMBERS: PD-05035-001A.A0, PD-05035-ALPHA.A0, PFL-G-03-PT001.A0, PFL-G-03-PT002.A0

include conf/machine/include/phyam62lxx.inc

MACHINEOVERRIDES =. ":am62lx-libra:"

MACHINE_FEATURES += "can emmc wifi bluetooth"

KERNEL_DEVICETREE = " \
    ti/k3-am62l3-phyflex-libra-rdk.dtb \
    ti/k3-am62l3-phyflex-libra-lvds-ac209.dtbo \
"

UBOOT_MACHINE = "am62lx_phyflex_fpsc_g_defconfig"
```

## conf/machine/am62lxx-phyflex-libra-rdk-2.conf
```bitbake
#@TYPE: Machine
#@NAME: am62lxx-phyflex-libra-rdk-2
#@DESCRIPTION: PHYTEC AM62Lx phyFLEX Libra FPSC, 1-2GB RAM, HS-FS SR1.1
#@ARTICLENUMBERS: PD-05035-ALPHA.A1, PFL-G-03-SP003.A0, PFL-G-03-SP003.A1

include conf/machine/include/phyam62lxx.inc

MACHINEOVERRIDES =. ":am62lx-libra:"

MACHINE_FEATURES += "can emmc wifi bluetooth"

KERNEL_DEVICETREE = " \
    ti/k3-am62l3-phyflex-libra-rdk.dtb \
    ti/k3-am62l3-phyflex-libra-lvds-ac209.dtbo \
"

UBOOT_MACHINE = "am62lx_phyflex_fpsc_g_defconfig"
```

## conf/machine/am62pxx-phyflex-libra-rdk-1-k3r5.conf
```bitbake
#@TYPE: Machine
#@NAME: am62pxx-phyflex-libra-rdk-1-k3r5
#@DESCRIPTION: PHYTEC AM62Px phyFLEX Libra FPSC, 2GB RAM, HS-FS (R5F)
#@ARTICLENUMBERS: PD-05033-ALPHA.A0, PFL-G-06.A0

require conf/machine/include/phyk3r5.inc

MACHINEOVERRIDES =. "k3r5-am62pxx:phyflex-fpsc-g:phyflex-libra-rdk:am62px-phyflex-libra-rdk:"

SPL_BINARY = "tiboot3-am62px-hs-fs-phyflex-fpsc-g.bin"

UBOOT_MACHINE = ""
UBOOT_CONFIG = "sd"
UBOOT_CONFIG[sd] = "am62px_phyflex_fpsc_g_r5_defconfig,sdcard"
```

## conf/machine/am62pxx-phyflex-libra-rdk-1.conf
```bitbake
#@TYPE: Machine
#@NAME: am62pxx-phyflex-libra-rdk-1
#@DESCRIPTION: PHYTEC AM62Px phyFLEX Libra FPSC, 2GB RAM, HS-FS
#@ARTICLENUMBERS: PD-05033-ALPHA.A0, PFL-G-06.A0

require conf/machine/include/phyam62pxx.inc

MACHINEOVERRIDES =. ":phyflex-fpsc-g:phyflex-libra-rdk:am62px-phyflex-libra-rdk:"

MACHINE_FEATURES += "can emmc gpu wifi bluetooth"

KERNEL_DEVICETREE = " \
    ti/k3-am62p5-phyflex-libra-rdk.dtb \
    ${KERNEL_OVERLAYS} \
"

UBOOT_MACHINE = "am62px_phyflex_fpsc_g_a53_defconfig"
```

## conf/machine/beagleboneblack-1.conf
```bitbake
#@TYPE: Machine
#@NAME: beagleboneblack-1
#@DESCRIPTION: BeagleBoard Hardware to crosscheck PHYTEC software, rev. A5C 2GB eMMC
#@ARTICLENUMBERS:

IMAGE_FSTYPES ?= "tar.gz wic emmc"

require conf/machine/include/phyam335x.inc

# Kernel
KERNEL_DEVICETREE = "am335x-boneblack.dtb"

# Barebox
BAREBOX_BIN = "images/barebox-am33xx-beaglebone.img"
BAREBOX_IPL_BIN = "images/barebox-am33xx-beaglebone-mlo.img"

MACHINE_FEATURES += "gpu emmc"
```

## conf/machine/firefly-rk3288-1.conf
```bitbake
# Copyright (C) 2016 Wadim Egorov
# Released under the MIT license (see COPYING.MIT for the terms)

#@TYPE: Machine
#@NAME: firefly-rk3288-1
#@DESCRIPTION: Firefly board with 2G RAM (Version: FR_RK3288_930)
#@ARTICLENUMBERS:
#@SUPPORTEDIMAGE: phytec-headless-image

include conf/machine/include/phyrk3288.inc

PREFERRED_PROVIDER_virtual/bootloader = "u-boot"

KERNEL_DEVICETREE = "rk3288-firefly.dtb"
SERIAL_CONSOLES ??= "115200;ttyS2"

UBOOT_MACHINE = "firefly-rk3288_defconfig"
```

## conf/machine/imx8mp-libra-fpsc-1.conf
```bitbake
#@TYPE: Machine
#@NAME: imx8mp-libra-fpsc-1
#@DESCRIPTION: PHYTEC Libra-i.MX8M Plus FPSC, 2GB RAM, PCM-937-L FPSC 24A.0 PL1618.3
#@ARTICLENUMBERS: KPD-05023-ALPHA.A0

MACHINEOVERRIDES =. "mx8mp:"

require conf/machine/include/imx-base.inc
include conf/machine/include/phyimx8m.inc

MACHINE_FEATURES += "alsa can gpu screen"

KERNEL_DEVICETREE = " \
        freescale/imx8mp-libra-rdk-fpsc.dtb \
        freescale/imx8mp-libra-rdk-fpsc-lvds-etml1010g3dra.dtbo \
"

KERNEL_DEVICETREE:use-nxp-bsp = " \
        freescale/imx8mp-libra-rdk-fpsc.dtb \
        freescale/imx8mp-libra-rdk-fpsc-lvds-etml1010g3dra.dtbo \
        freescale/imx8mp-libra-rdk-fpsc-lvds-ph128800t006-zhc01.dtbo \
"

# Set DDR FIRMWARE
DDR_FIRMWARE_NAME = " \
	lpddr4_pmu_train_1d_dmem_202006.bin \
	lpddr4_pmu_train_1d_imem_202006.bin \
	lpddr4_pmu_train_2d_dmem_202006.bin \
	lpddr4_pmu_train_2d_imem_202006.bin \
"

UBOOT_CONFIG = "sd"
UBOOT_CONFIG[sd] = "imx8mp-libra-fpsc_defconfig,sdcard"
SPL_BINARY = "spl/u-boot-spl.bin"

# Set u-boot DTB
UBOOT_DTB_NAME = "imx8mp-libra-rdk-fpsc.dtb"
# fdt_addr_r
UBOOT_DTB_LOADADDRESS = "0x40480000"
# fdtoverlay_addr_r
UBOOT_DTBO_LOADADDRESS = "0x404a0000"
# kernel_addr_r
UBOOT_ENTRYPOINT:mx8m-generic-bsp = "${UBOOT_LOADADDRESS}"
UBOOT_LOADADDRESS = "0x40a00000"

ATF_PLATFORM = "imx8mp"
ATF_LOAD_ADDR = "0x970000"
ATF_BL32_BASE = "0x7e000000"

OPTEEMACHINE = "imx-mx8mp_libra_fpsc"

# Set imx-mkimage boot target
IMXBOOT_TARGETS = "flash_evk"

# Set Serial console
SERIAL_CONSOLES = "115200;ttymxc3"

IMAGE_BOOTLOADER = "imx-boot"

KERNEL_IMAGETYPE = "Image"

UBOOT_SUFFIX = "bin"
UBOOT_MAKE_TARGET = "all"
```
