## conf/machine/imx8mp-phyflex-libra-rdk-2.conf
```bitbake
#@TYPE: Machine
#@NAME: imx8mp-phyflex-libra-rdk-2
#@DESCRIPTION: PHYTEC Libra phyFLEX-i.MX 8M Plus FPSC, 2GB RAM, PD-05023 FPSC Gamma PL1618.2
#@ARTICLENUMBERS: KPD-05023-ALPHA.A0

MACHINEOVERRIDES =. "mx8mp:phyflex-fpsc-g:phyflex-libra-rdk:imx8mp-phyflex-libra-rdk:"

require conf/machine/include/imx-base.inc
include conf/machine/include/phyimx8m.inc

MACHINE_FEATURES += "alsa can gpu screen"

KERNEL_DEVICETREE = " \
        freescale/imx8mp-phyflex-libra-rdk.dtb \
        freescale/imx8mp-phyflex-libra-rdk-lvds-etml1010g3dra.dtbo \
        freescale/imx8mp-phyflex-libra-rdk-lvds-peb-av-10.dtbo \
        freescale/imx8mp-phyflex-libra-rdk-lvds-ph128800t006-zhc01.dtbo \
        freescale/imx8mp-phyflex-libra-rdk-vm016-csi1.dtbo \
        freescale/imx8mp-phyflex-libra-rdk-vm016-csi1-fpdlink-port0.dtbo \
        freescale/imx8mp-phyflex-libra-rdk-vm016-csi1-fpdlink-port1.dtbo \
        freescale/imx8mp-phyflex-libra-rdk-vm016-csi2.dtbo \
        freescale/imx8mp-phyflex-libra-rdk-vm016-csi2-fpdlink-port0.dtbo \
        freescale/imx8mp-phyflex-libra-rdk-vm016-csi2-fpdlink-port1.dtbo \
        freescale/imx8mp-phyflex-libra-rdk-vm017-csi1.dtbo \
        freescale/imx8mp-phyflex-libra-rdk-vm017-csi1-fpdlink-port0.dtbo \
        freescale/imx8mp-phyflex-libra-rdk-vm017-csi1-fpdlink-port1.dtbo \
        freescale/imx8mp-phyflex-libra-rdk-vm017-csi2.dtbo \
        freescale/imx8mp-phyflex-libra-rdk-vm017-csi2-fpdlink-port0.dtbo \
        freescale/imx8mp-phyflex-libra-rdk-vm017-csi2-fpdlink-port1.dtbo \
        freescale/imx8mp-phyflex-libra-rdk-vm020-csi1.dtbo \
        freescale/imx8mp-phyflex-libra-rdk-vm020-csi1-fpdlink-port0.dtbo \
        freescale/imx8mp-phyflex-libra-rdk-vm020-csi1-fpdlink-port1.dtbo \
        freescale/imx8mp-phyflex-libra-rdk-vm020-csi2.dtbo \
        freescale/imx8mp-phyflex-libra-rdk-vm020-csi2-fpdlink-port0.dtbo \
        freescale/imx8mp-phyflex-libra-rdk-vm020-csi2-fpdlink-port1.dtbo \
"

# Set DDR FIRMWARE
DDR_FIRMWARE_NAME = " \
	lpddr4_pmu_train_1d_dmem_202006.bin \
	lpddr4_pmu_train_1d_imem_202006.bin \
	lpddr4_pmu_train_2d_dmem_202006.bin \
	lpddr4_pmu_train_2d_imem_202006.bin \
"

UBOOT_CONFIG = "sd"
UBOOT_CONFIG[sd] = "imx8mp-phyflex-libra-rdk_defconfig,sdcard"
SPL_BINARY = "spl/u-boot-spl.bin"

# Set u-boot DTB
UBOOT_DTB_NAME = "imx8mp-phyflex-libra-rdk.dtb"
# fdt_addr_r
UBOOT_DTB_LOADADDRESS = "0x40480000"
# fdtoverlay_addr_r
UBOOT_DTBO_LOADADDRESS = "0x404a0000"
# kernel_addr_r
UBOOT_ENTRYPOINT:mx8m-generic-bsp = "${UBOOT_LOADADDRESS}"
UBOOT_LOADADDRESS = "0x40a00000"

ATF_PLATFORM = "imx8mp"
ATF_LOAD_ADDR = "0x970000"

# Set imx-mkimage boot target
IMXBOOT_TARGETS = "flash_evk"

# Set Serial console
SERIAL_CONSOLES = "115200;ttymxc3"

IMAGE_BOOTLOADER = "imx-boot"

KERNEL_IMAGETYPE = "Image"

UBOOT_SUFFIX = "bin"
UBOOT_MAKE_TARGET = "all"
```

## conf/machine/imx93-phyflex-libra-rdk-1.conf
```bitbake
#@TYPE: Machine
#@NAME: imx93-phyflex-libra-rdk-1
#@DESCRIPTION: PHYTEC phyFLEX-i.MX 93 Libra Rapid Development Kit, 1 or 2 GB RAM, eMMC
#@ARTICLENUMBERS: PD-05029-001a, PD-05029-002a, PFL-G-05-PT001, PFL-G-05-PT002

MACHINEOVERRIDES =. "mx93:libra:imx93-phyflex-libra-rdk:"

include conf/machine/include/imx-base.inc
include conf/machine/include/phyimx93.inc

MACHINE_FEATURES += "camera screen can alsa emmc tpm2 wifi bluetooth lwb5p"

KERNEL_DEVICETREE = " \
    freescale/imx93-phyflex-libra-rdk.dtb \
    freescale/imx93-phyflex-libra-rdk-peb-av-10.dtbo \
    freescale/imx93-phyflex-libra-rdk-lvds-ph128800t006-zhc01.dtbo \
    freescale/imx93-phyflex-libra-rdk-vm016.dtbo \
    freescale/imx93-phyflex-libra-rdk-vm020.dtbo \
"

IMX_DEFAULT_BOOTLOADER = "u-boot-phytec-imx"

IMAGE_BOOTLOADER = "imx-boot"

UBOOT_CONFIG_BASENAME = "imx93-phyflex"
UBOOT_DTB_NAME = "${KERNEL_DEVICETREE_BASENAME}.dtb"

LOADADDR = ""
UBOOT_SUFFIX = "bin"
UBOOT_MAKE_TARGET = ""

SPL_BINARY = "spl/u-boot-spl.bin"

UBOOT_CONFIG ??= "sd"
UBOOT_CONFIG[sd]   = "${UBOOT_CONFIG_BASENAME}_defconfig,sdcard"

# Set ATF platform name
ATF_PLATFORM = "imx93"

IMXBOOT_TARGETS = "flash_singleboot"

IMX_BOOT_SOC_TARGET = "iMX9"
IMX_BOOT_SEEK = "32"

# Set Serial console
SERIAL_CONSOLES = "115200;ttyLP3"

# Set DDR FIRMWARE
DDR_FIRMWARE_NAME = " \
    lpddr4_dmem_1d_v202201.bin \
    lpddr4_dmem_2d_v202201.bin \
    lpddr4_imem_1d_v202201.bin \
    lpddr4_imem_2d_v202201.bin \
"

# Set regdomain to ETSI (see lwb-if-regdomain.bb from meta-radio-summit)
LWB_REGDOMAIN ?= "ETSI"
```

## conf/machine/imx95-libra-fpsc-1.conf
```bitbake
#@TYPE: Machine
#@NAME: imx95-libra-fpsc-1
#@DESCRIPTION: PHYTEC i.MX95 Libra FPSC, 8 GB RAM, eMMC, silicon revision A0
#@ARTICLENUMBERS: PCM-937-L-imx95.A2

MACHINEOVERRIDES =. "mx95:libra:imx95-libra-fpsc:"

# WORKAROUND to avoid parser error in imx-isp-phycam
# only i.MX95 is on 6.12.34 (imx-isp_%.3)
# other i.MX are on 6.12.20 (imx-isp_%.2)
#
# and non-applicable patch in libcamera
BBMASK:append = " \
    meta-phytec/dynamic-layers/fsl-bsp-release/recipes-bsp/isp-imx/ \
    meta-ampliphy/dynamic-layers/fsl-bsp-release/recipes-multimedia/libcamera/ \
"

include conf/machine/include/imx-base.inc
require conf/machine/include/phytec-machine-common.inc

# Common settings for PHYTEC's i.MX95 boards
require conf/machine/include/arm/armv8-2a/tune-cortexa55.inc

MACHINE_FEATURES += "alsa bluetooth can caam emmc gpu pci screen serial wifi"

PREFERRED_PROVIDER_virtual/bootloader ?= "u-boot-master"
PREFERRED_PROVIDER_virtual/bootloader:use-nxp-bsp ?= "u-boot-phytec-imx"
PREFERRED_PROVIDER_virtual/kernel ?= "linux-yocto-dev"
PREFERRED_PROVIDER_virtual/kernel:use-nxp-bsp ?= "linux-phytec-imx"
PREFERRED_PROVIDER_virtual/imx-system-manager ?= "imx-sm-phytec"
PREFERRED_PROVIDER_virtual/imx-oei ?= "imx-oei-phytec"

# Don't install kernelimage to rootfs
RRECOMMENDS:${KERNEL_PACKAGE_NAME}-base = ""

# Wic
IMAGE_CLASSES += "wic-helper"
IMAGE_CLASSES:append:mx95-nxp-bsp = " wic-bootenv-helper"
WKS_FILES ?= "imx9-sdimage.wks"
WKS_BOOTIMAGESIZE ?= "64"

# MMC user area bootloader image offset
BOOTLOADER_SEEK ?= "32"
# eMMC boot partition bootloader image offset
BOOTLOADER_SEEK_EMMC ?= "0"
# Device information used by RAUC and some of its dependencies
EMMC_DEV ?= "0"

IMAGE_BOOT_FILES = "fitImage boot.scr.uimg"
IMAGE_BOOT_FILES:use-nxp-bsp = "fitImage bootenv.txt boot.scr.uimg"
IMAGE_BOOT_FILES:secureboot:mx95-nxp-bsp = "fitImage bootenv.txt"
IMAGE_BOOTLOADER = "imx-boot"

INITRAMFS_MAXSIZE = "262144"

# partup
IMAGE_CLASSES += "image-types-partup"
include partup-layout-config.inc

IMAGE_FSTYPES = "tar.gz wic.bmap wic.xz"

# Set Serial console
SERIAL_CONSOLES = "115200;ttyLP6"

# Set ATF platform name
ATF_PLATFORM = "imx95"
ATF_BOOT_UART_BASE = "0x42690000"

OEI_CONFIGS = "ddr tcm"
OEI_CORE = "m33"
OEI_SOC = "mx95"
OEI_BOARD = "mx95libra"

SYSTEM_MANAGER_CONFIG = "mx95libra"
SYSTEM_MANAGER_FIRMWARE_BASENAME = "m33_image"
SYSTEM_MANAGER_FIRMWARE_NAME = "${SYSTEM_MANAGER_FIRMWARE_BASENAME}"

# Set DDR FIRMWARE
DDR_FIRMWARE_NAME = " \
    lpddr5_dmem_qb_v202409.bin \
    lpddr5_dmem_v202409.bin \
    lpddr5_imem_qb_v202409.bin \
    lpddr5_imem_v202409.bin \
"
DDR_TYPE   = "lpddr5"

SPL_BINARY = "spl/u-boot-spl.bin"
UBOOT_ARCH = "arm64"
# NXP bastardizes this variable to contain the U-Boot proper only. Set for mainline only.
UBOOT_BINARY:use-mainline-bsp = "flash.bin"
UBOOT_CONFIG ??= "sd"
UBOOT_CONFIG[sd]   = "${UBOOT_CONFIG_BASENAME}_defconfig,sdcard"
UBOOT_CONFIG_BASENAME = "imx95-libra-fpsc"
UBOOT_DTB_LOADADDRESS = "0xD9000000"
UBOOT_DTB_NAME = "imx95-libra-rdk-fpsc.dtb"
UBOOT_DTBO_LOADADDRESS = "0xD9100000"
UBOOT_ENTRYPOINT = "0xD0000000"
UBOOT_MAKE_TARGET = ""
UBOOT_PROVIDES_BOOT_CONTAINER = "1"
UBOOT_PROVIDES_BOOT_CONTAINER:use-nxp-bsp = "0"
UBOOT_SUFFIX = "bin"

IMX_BOOT_SOC_TARGET = "iMX95"
IMX_BOOT_SEEK = "32"
IMX_DEFAULT_BOOTLOADER = "u-boot-phytec-imx"
# NXP uses mx95-nxp-bsp override, so we have to use it, too (see imx-base-extend.inc)
IMX_EXTRA_FIRMWARE:mx95-nxp-bsp += "imx-oei-phytec"
IMX_EXTRA_FIRMWARE:mx95-nxp-bsp:remove = "imx-oei"
IMXBOOT_TARGETS = "flash_a55"

EXTERNAL_KERNEL_DEVICETREE ??= ""
KERNEL_DEVICETREE = " \
    freescale/imx95-libra-rdk-fpsc.dtb \
"
KERNEL_DEVICETREE:use-nxp-bsp = " \
    freescale/imx95-libra-rdk-fpsc.dtb \
    freescale/imx95-libra-rdk-fpsc-lvds-ph128800t006-zhc01.dtbo \
"
KERNEL_CLASSES += "kernel-fitimage"
KERNEL_IMAGETYPES += "fitImage"

# This variable needs to be set for imx-boot recipe from nxp, image does not get built into imx-boot
M4_DEFAULT_IMAGE_MX95 = "imx95-19x19-evk_m7_TCM_power_mode_switch.bin"
```

## conf/machine/imx95-phyflex-libra-2.conf
```bitbake
#@TYPE: Machine
#@NAME: imx95-phyflex-libra-2
#@DESCRIPTION: PHYTEC Libra phyFLEX-i.MX 95 FPSC, 8 GB RAM, e.MMC, silicon revision B0
#@ARTICLENUMBERS: PD-05032-001.A2

MACHINEOVERRIDES =. "mx95:phyflex-fpsc-g:libra:imx95-phyflex-libra:"

include conf/machine/include/imx-base.inc
require conf/machine/include/partup-layout-config.inc
require conf/machine/include/phytec-machine-common.inc

# Common settings for PHYTEC's i.MX95 boards
require conf/machine/include/arm/armv8-2a/tune-cortexa55.inc

MACHINE_FEATURES += "bluetooth can caam emmc gpu pci screen serial tpm2 wifi"
PREFERRED_PROVIDER_virtual/bootloader = "u-boot-master"
PREFERRED_PROVIDER_virtual/bootloader:use-nxp-bsp = "u-boot-phytec-imx"
PREFERRED_PROVIDER_virtual/kernel = "linux-yocto-dev"
PREFERRED_PROVIDER_virtual/kernel:use-nxp-bsp = "linux-phytec-imx"
PREFERRED_PROVIDER_virtual/imx-system-manager = "imx-sm-phytec"
PREFERRED_PROVIDER_virtual/imx-oei = "imx-oei-phytec"
SYSTEM_MANAGER_RPROVIDER:use-nxp-bsp = "imx-sm-phytec"

# Don't install kernelimage to rootfs
RRECOMMENDS:${KERNEL_PACKAGE_NAME}-base = ""

IMAGE_CLASSES += "wic-helper image-types-partup"
IMAGE_CLASSES:append:mx95-nxp-bsp = " wic-bootenv-helper"
IMAGE_FSTYPES = "tar.gz wic.bmap wic.xz partup"
IMAGE_FSTYPES:update = "partup"
WKS_FILES ?= "imx9-sdimage.wks"
WKS_BOOTIMAGESIZE ?= "64"

# MMC user area bootloader image offset
BOOTLOADER_SEEK ?= "32"
# eMMC boot partition bootloader image offset
BOOTLOADER_SEEK_EMMC ?= "0"
# Device information used by RAUC and some of its dependencies
EMMC_DEV ?= "0"

IMAGE_BOOT_FILES = "fitImage boot.scr.uimg"
IMAGE_BOOT_FILES:use-nxp-bsp = "fitImage overlays.txt boot.scr.uimg"
IMAGE_BOOT_FILES:secureboot:mx95-nxp-bsp = "fitImage overlays.txt"
# Used only for NXP BSP
IMAGE_BOOTLOADER = "imx-boot"

INITRAMFS_MAXSIZE = "262144"

# Set Serial console
SERIAL_CONSOLES = "115200;ttyLP3"

# Set ATF platform name
ATF_PLATFORM = "imx95"
# for trusted-firmware-a
TFA_PLATFORM = "${ATF_PLATFORM}"
ATF_BOOT_UART_BASE = "0x42690000"

OEI_CONFIGS = "ddr tcm"
OEI_CORE = "m33"
OEI_SOC = "mx95"
OEI_BOARD = "mx95libra"

SYSTEM_MANAGER_CONFIG = "mx95libra"
SYSTEM_MANAGER_FIRMWARE_BASENAME = "m33_image"
SYSTEM_MANAGER_FIRMWARE_NAME = "${SYSTEM_MANAGER_FIRMWARE_BASENAME}"

# Set DDR FIRMWARE
DDR_FIRMWARE_NAME = " \
    lpddr5_dmem_qb_v202409.bin \
    lpddr5_dmem_v202409.bin \
    lpddr5_imem_qb_v202409.bin \
    lpddr5_imem_v202409.bin \
"
DDR_TYPE   = "lpddr5"

SPL_BINARY = "spl/u-boot-spl.bin"
UBOOT_ARCH = "arm64"
# NXP bastardizes this variable to contain the U-Boot proper only. Set for mainline only.
UBOOT_BINARY:use-mainline-bsp = "flash.bin"
UBOOT_CONFIG ??= "sd"
UBOOT_CONFIG[sd]   = "${UBOOT_CONFIG_BASENAME}_defconfig,sdcard"
UBOOT_CONFIG_BASENAME = "imx95-phyflex-libra-rdk"
UBOOT_DTB_LOADADDRESS = "0xD9000000"
UBOOT_DTB_NAME = "imx95-phyflex-libra-rdk.dtb"
UBOOT_DTBO_LOADADDRESS = "0xD9100000"
UBOOT_ENTRYPOINT = "0xD0000000"
UBOOT_MAKE_TARGET = ""
UBOOT_PROVIDES_BOOT_CONTAINER = "1"
UBOOT_PROVIDES_BOOT_CONTAINER:use-nxp-bsp = "0"
UBOOT_SUFFIX = "bin"

IMX_BOOT_SOC_TARGET = "iMX95"
IMX_BOOT_SEEK = "32"
IMX_DEFAULT_BOOTLOADER = "u-boot-phytec-imx"
# NXP uses mx95-nxp-bsp override, so we have to use it, too (see imx-base-extend.inc)
IMX_EXTRA_FIRMWARE:mx95-nxp-bsp += "imx-oei-phytec"
IMX_EXTRA_FIRMWARE:mx95-nxp-bsp:remove = "imx-oei"
IMX_SOC_REV = "B0"
IMXBOOT_TARGETS = "flash_a55"

EXTERNAL_KERNEL_DEVICETREE ??= ""
KERNEL_CLASSES += "kernel-fitimage"
KERNEL_IMAGETYPES += "fitImage"
KERNEL_DEVICETREE = " \
    freescale/imx95-phyflex-libra-rdk.dtb \
    freescale/imx95-phyflex-libra-rdk-lvds-ph128800t006-zhc01.dtbo \
    freescale/imx95-phyflex-libra-rdk-neoisp.dtbo \
    freescale/imx95-phyflex-libra-rdk-peb-av-10-ph128800t006-zhc01.dtbo \
    freescale/imx95-phyflex-libra-rdk-peb-av-10.dtbo \
    freescale/imx95-phyflex-libra-rdk-vm016-csi1.dtbo \
    freescale/imx95-phyflex-libra-rdk-vm016-csi2.dtbo \
    freescale/imx95-phyflex-libra-rdk-vm016-fpdlink-port0-csi1.dtbo \
    freescale/imx95-phyflex-libra-rdk-vm016-fpdlink-port0-csi2.dtbo \
    freescale/imx95-phyflex-libra-rdk-vm016-fpdlink-port1-csi1.dtbo \
    freescale/imx95-phyflex-libra-rdk-vm016-fpdlink-port1-csi2.dtbo \
    freescale/imx95-phyflex-libra-rdk-vm017-csi1.dtbo \
    freescale/imx95-phyflex-libra-rdk-vm017-csi2.dtbo \
    freescale/imx95-phyflex-libra-rdk-vm017-fpdlink-port0-csi1.dtbo \
    freescale/imx95-phyflex-libra-rdk-vm017-fpdlink-port0-csi2.dtbo \
    freescale/imx95-phyflex-libra-rdk-vm017-fpdlink-port1-csi1.dtbo \
    freescale/imx95-phyflex-libra-rdk-vm017-fpdlink-port1-csi2.dtbo \
    freescale/imx95-phyflex-libra-rdk-vm020-csi1.dtbo \
    freescale/imx95-phyflex-libra-rdk-vm020-csi2.dtbo \
    freescale/imx95-phyflex-libra-rdk-vm020-fpdlink-port0-csi1.dtbo \
    freescale/imx95-phyflex-libra-rdk-vm020-fpdlink-port0-csi2.dtbo \
    freescale/imx95-phyflex-libra-rdk-vm020-fpdlink-port1-csi1.dtbo \
    freescale/imx95-phyflex-libra-rdk-vm020-fpdlink-port1-csi2.dtbo \
"

# This variable needs to be set for imx-boot recipe from nxp, image does not get built into imx-boot
M4_DEFAULT_IMAGE_MX95 = "imx95-19x19-evk_m7_TCM_power_mode_switch.bin"
```

## conf/machine/include/am335x.inc
```bitbake
#Taken from TI yocto BSP Layer Version 05-2014, original name:ti33xx.inc
SOC_FAMILY = "ti33x"

require conf/machine/include/soc-family.inc
require conf/machine/include/tune-cortexa8.inc

PREFERRED_PROVIDER_virtual/xserver = "xserver-xorg"

# For built-in LCD, add xf86-input-tslib
XSERVER = "xserver-xorg \
           xf86-input-evdev \
           xf86-input-mouse \
           xf86-video-fbdev \
           xf86-input-keyboard"

# Default to external video, change to smallscreen for built-in LCD
GUI_MACHINE_CLASS = "smallscreen"

# Default providers
PREFERRED_PROVIDER_virtual/kernel ?= "linux-ti"
PREFERRED_PROVIDER_virtual/bootloader ?= "barebox"
KERNEL_IMAGETYPE ?= "zImage"
PACKAGE_INSTALL_append = " kernel-modules"
SERIAL_CONSOLES ?= "115200;ttyO0"

#UBOOT_ARCH = "arm"
#UBOOT_MACHINE = "am335x_evm_config"

#UBOOT_ENTRYPOINT = "0x80008000"
#UBOOT_LOADADDRESS = "0x80008000"

# Use the expected value of the ubifs filesystem's volume name in the kernel
# and u-boot.
#UBI_VOLNAME = "rootfs"

BAREBOX_DEFAULT_DEFCONFIG = "am335x_defconfig"
BAREBOX_IPL_DEFAULT_DEFCONFIG = "am335x_mlo_defconfig"
BAREBOX_IPL_BIN_DEPLOY = "MLO-${MACHINE}-${PV}-${PR}.img"
BAREBOX_IPL_BIN_SYMLINK = "MLO"

# List common SoC features, may need to add touchscreen for specific machines
MACHINE_FEATURES = "kernel26 apm usbgadget usbhost vfat ext2 screen alsa ethernet sgx"
```

## conf/machine/include/imx-base.inc
```bitbake
# Provides the i.MX common settings

include conf/machine/include/soc-family.inc
```

## conf/machine/include/mc_k3r5.inc
```bitbake
BBMULTICONFIG += "k3r5"

do_image[mcdepends] += "mc::k3r5:virtual/bootloader:do_deploy"
```
