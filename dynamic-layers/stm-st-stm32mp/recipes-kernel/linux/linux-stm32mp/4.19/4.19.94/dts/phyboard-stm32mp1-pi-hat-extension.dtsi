// SPDX-License-Identifier: (GPL-2.0+ OR BSD-3-Clause)
/*
 * Copyright (C) PHYTEC GmbH 2019 - All Rights Reserved
 * Author: Dom VOVARD <dom.vovard@linrt.com>.
 * Device tree expansion file example to configure Raspberry PI HAT pinout
 */


&spi1 {
        status = "okay";
};

&sdmmc3 {
	pinctrl-names = "default", "opendrain", "sleep";
	pinctrl-0 = <&sdmmc3_b4_pins_a>;
	pinctrl-1 = <&sdmmc3_b4_od_pins_a>;
	pinctrl-2 = <&sdmmc3_b4_sleep_pins_a>;
	st,neg-edge;
	bus-width = <4>;
	max-frequency = <10000000>;
	vmmc-supply = <&v3v3>;
	status = "disabled";
};

&i2c1 {
        status = "okay";
};

&usart1 {
        status = "okay";
};

