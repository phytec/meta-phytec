// SPDX-License-Identifier: (GPL-2.0+ OR BSD-3-Clause)
/*
 * Copyright (C) PHYTEC GmbH 2019-2020 - All Rights Reserved
 * Author: Christophe PARANT <c.parant@phytec.fr>.
 * Devicetree expansion for PEB-WLBT-05 module - Bluetooth function using usart1
 */


&gpio_keys {
	enter {
		status = "disabled"; //disable PA14 (key enter) as input event
	};
};


&usart1 {
        status = "okay";
	st,hw-flow-ctrl;

	bluetooth {
		shutdown-gpios = <&gpioa 14 (GPIO_ACTIVE_HIGH|GPIO_OPEN_DRAIN)>;
		compatible = "brcm,bcm43438-bt";
		max-speed = <3000000>;
	};
};
